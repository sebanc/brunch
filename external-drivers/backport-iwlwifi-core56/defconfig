## external-drivers/backport-iwlwifi/Kconfig.local
```kconfig
config BACKPORTED_BACKPORT_DIR
	tristate
	default BACKPORT_DIR
config BACKPORTED_BACKPORTS_VERSION
	tristate
	default BACKPORTS_VERSION
config BACKPORTED_BACKPORTED_KERNEL_VERSION
	tristate
	default BACKPORTED_KERNEL_VERSION
config BACKPORTED_BACKPORTED_KERNEL_NAME
	tristate
	default BACKPORTED_KERNEL_NAME
config BACKPORTED_WIRELESS
	tristate
	default WIRELESS
config BACKPORTED_NET_CORE
	tristate
	default NET_CORE
config BACKPORTED_EXPERT
	tristate
	default EXPERT
config BACKPORTED_BP_MODULES
	tristate
	default BP_MODULES
config BACKPORTED_BPAUTO_BUILD_NLATTR
	tristate
	default BPAUTO_BUILD_NLATTR
config BACKPORTED_BPAUTO_BUILD_CORDIC
	tristate
	default BPAUTO_BUILD_CORDIC
config BACKPORTED_BPAUTO_CORDIC
	tristate
	default BPAUTO_CORDIC
config BACKPORTED_BPAUTO_MII
	tristate
	default BPAUTO_MII
config BACKPORTED_BPAUTO_BUILD_LEDS
	tristate
	default BPAUTO_BUILD_LEDS
config BACKPORTED_BPAUTO_NEW_LEDS
	tristate
	default BPAUTO_NEW_LEDS
config BACKPORTED_BPAUTO_LEDS_CLASS
	tristate
	default BPAUTO_LEDS_CLASS
config BACKPORTED_BPAUTO_LEDS_TRIGGERS
	tristate
	default BPAUTO_LEDS_TRIGGERS
config BACKPORTED_BPAUTO_USERSEL_BUILD_ALL
	tristate
	default BPAUTO_USERSEL_BUILD_ALL
config BACKPORTED_BPAUTO_WANT_DEV_COREDUMP
	tristate
	default BPAUTO_WANT_DEV_COREDUMP
config BACKPORTED_BPAUTO_BUILD_WANT_DEV_COREDUMP
	tristate
	default BPAUTO_BUILD_WANT_DEV_COREDUMP
config BACKPORTED_BPAUTO_RHASHTABLE
	tristate
	default BPAUTO_RHASHTABLE
config BACKPORTED_BPAUTO_BUCKET_LOCKS
	tristate
	default BPAUTO_BUCKET_LOCKS
config BACKPORTED_BPAUTO_REFCOUNT
	tristate
	default BPAUTO_REFCOUNT
config BACKPORTED_BPAUTO_SYSTEM_DATA_VERIFICATION
	tristate
	default BPAUTO_SYSTEM_DATA_VERIFICATION
config BACKPORTED_BPAUTO_BUILD_SYSTEM_DATA_VERIFICATION
	tristate
	default BPAUTO_BUILD_SYSTEM_DATA_VERIFICATION
config BACKPORTED_BPAUTO_PUBLIC_KEY
	tristate
	default BPAUTO_PUBLIC_KEY
config BACKPORTED_BPAUTO_ASN1_DECODER
	tristate
	default BPAUTO_ASN1_DECODER
config BACKPORTED_BPAUTO_PKCS7
	tristate
	default BPAUTO_PKCS7
config BACKPORTED_BPAUTO_CRYPTO_LIB_ARC4
	tristate
	default BPAUTO_CRYPTO_LIB_ARC4
config BACKPORTED_BPAUTO_BUILD_CRYPTO_LIB_ARC4
	tristate
	default BPAUTO_BUILD_CRYPTO_LIB_ARC4
config BACKPORTED_CFG80211
	tristate
	default CFG80211
config BACKPORTED_NL80211_TESTMODE
	tristate
	default NL80211_TESTMODE
config BACKPORTED_CFG80211_DEVELOPER_WARNINGS
	tristate
	default CFG80211_DEVELOPER_WARNINGS
config BACKPORTED_CFG80211_CERTIFICATION_ONUS
	tristate
	default CFG80211_CERTIFICATION_ONUS
config BACKPORTED_CFG80211_REQUIRE_SIGNED_REGDB
	tristate
	default CFG80211_REQUIRE_SIGNED_REGDB
config BACKPORTED_CFG80211_USE_KERNEL_REGDB_KEYS
	tristate
	default CFG80211_USE_KERNEL_REGDB_KEYS
config BACKPORTED_CFG80211_EXTRA_REGDB_KEYDIR
	tristate
	default CFG80211_EXTRA_REGDB_KEYDIR
config BACKPORTED_CFG80211_REG_CELLULAR_HINTS
	tristate
	default CFG80211_REG_CELLULAR_HINTS
config BACKPORTED_CFG80211_REG_RELAX_NO_IR
	tristate
	default CFG80211_REG_RELAX_NO_IR
config BACKPORTED_CFG80211_DEFAULT_PS
	tristate
	default CFG80211_DEFAULT_PS
config BACKPORTED_CFG80211_DEBUGFS
	tristate
	default CFG80211_DEBUGFS
config BACKPORTED_CFG80211_CRDA_SUPPORT
	tristate
	default CFG80211_CRDA_SUPPORT
config BACKPORTED_CFG80211_WEXT
	tristate
	default CFG80211_WEXT
config BACKPORTED_CFG80211_WEXT_EXPORT
	tristate
	default CFG80211_WEXT_EXPORT
config BACKPORTED_LIB80211
	tristate
	default LIB80211
config BACKPORTED_LIB80211_CRYPT_WEP
	tristate
	default LIB80211_CRYPT_WEP
config BACKPORTED_LIB80211_CRYPT_CCMP
	tristate
	default LIB80211_CRYPT_CCMP
config BACKPORTED_LIB80211_CRYPT_TKIP
	tristate
	default LIB80211_CRYPT_TKIP
config BACKPORTED_LIB80211_DEBUG
	tristate
	default LIB80211_DEBUG
config BACKPORTED_MAC80211
	tristate
	default MAC80211
config BACKPORTED_MAC80211_HAS_RC
	tristate
	default MAC80211_HAS_RC
config BACKPORTED_MAC80211_RC_MINSTREL
	tristate
	default MAC80211_RC_MINSTREL
config BACKPORTED_MAC80211_RC_DEFAULT_MINSTREL
	tristate
	default MAC80211_RC_DEFAULT_MINSTREL
config BACKPORTED_MAC80211_RC_DEFAULT
	tristate
	default MAC80211_RC_DEFAULT
config BACKPORTED_MAC80211_MESH
	tristate
	default MAC80211_MESH
config BACKPORTED_MAC80211_LEDS
	tristate
	default MAC80211_LEDS
config BACKPORTED_MAC80211_DEBUGFS
	tristate
	default MAC80211_DEBUGFS
config BACKPORTED_MAC80211_MESSAGE_TRACING
	tristate
	default MAC80211_MESSAGE_TRACING
config BACKPORTED_MAC80211_DEBUG_MENU
	tristate
	default MAC80211_DEBUG_MENU
config BACKPORTED_MAC80211_NOINLINE
	tristate
	default MAC80211_NOINLINE
config BACKPORTED_MAC80211_VERBOSE_DEBUG
	tristate
	default MAC80211_VERBOSE_DEBUG
config BACKPORTED_MAC80211_MLME_DEBUG
	tristate
	default MAC80211_MLME_DEBUG
config BACKPORTED_MAC80211_STA_DEBUG
	tristate
	default MAC80211_STA_DEBUG
config BACKPORTED_MAC80211_HT_DEBUG
	tristate
	default MAC80211_HT_DEBUG
config BACKPORTED_MAC80211_OCB_DEBUG
	tristate
	default MAC80211_OCB_DEBUG
config BACKPORTED_MAC80211_IBSS_DEBUG
	tristate
	default MAC80211_IBSS_DEBUG
config BACKPORTED_MAC80211_PS_DEBUG
	tristate
	default MAC80211_PS_DEBUG
config BACKPORTED_MAC80211_MPL_DEBUG
	tristate
	default MAC80211_MPL_DEBUG
config BACKPORTED_MAC80211_MPATH_DEBUG
	tristate
	default MAC80211_MPATH_DEBUG
config BACKPORTED_MAC80211_MHWMP_DEBUG
	tristate
	default MAC80211_MHWMP_DEBUG
config BACKPORTED_MAC80211_MESH_SYNC_DEBUG
	tristate
	default MAC80211_MESH_SYNC_DEBUG
config BACKPORTED_MAC80211_MESH_CSA_DEBUG
	tristate
	default MAC80211_MESH_CSA_DEBUG
config BACKPORTED_MAC80211_MESH_PS_DEBUG
	tristate
	default MAC80211_MESH_PS_DEBUG
config BACKPORTED_MAC80211_TDLS_DEBUG
	tristate
	default MAC80211_TDLS_DEBUG
config BACKPORTED_MAC80211_DEBUG_COUNTERS
	tristate
	default MAC80211_DEBUG_COUNTERS
config BACKPORTED_MAC80211_STA_HASH_MAX_SIZE
	tristate
	default MAC80211_STA_HASH_MAX_SIZE
config BACKPORTED_WLAN
	tristate
	default WLAN
config BACKPORTED_WIRELESS_WDS
	tristate
	default WIRELESS_WDS
config BACKPORTED_PCMCIA_RAYCS
	tristate
	default PCMCIA_RAYCS
config BACKPORTED_PCMCIA_WL3501
	tristate
	default PCMCIA_WL3501
config BACKPORTED_MAC80211_HWSIM
	tristate
	default MAC80211_HWSIM
config BACKPORTED_USB_NET_RNDIS_WLAN
	tristate
	default USB_NET_RNDIS_WLAN
config BACKPORTED_VIRT_WIFI
	tristate
	default VIRT_WIFI
config BACKPORTED_WLAN_VENDOR_INTEL
	tristate
	default WLAN_VENDOR_INTEL
config BACKPORTED_IWLWIFI
	tristate
	default IWLWIFI
config BACKPORTED_IWLWIFI_LEDS
	tristate
	default IWLWIFI_LEDS
config BACKPORTED_IWLDVM
	tristate
	default IWLDVM
config BACKPORTED_IWLMVM
	tristate
	default IWLMVM
config BACKPORTED_IWLWIFI_OPMODE_MODULAR
	tristate
	default IWLWIFI_OPMODE_MODULAR
config BACKPORTED_IWLWIFI_BCAST_FILTERING
	tristate
	default IWLWIFI_BCAST_FILTERING
config BACKPORTED_IWLWIFI_DEBUG
	tristate
	default IWLWIFI_DEBUG
config BACKPORTED_IWLWIFI_DEBUGFS
	tristate
	default IWLWIFI_DEBUGFS
config BACKPORTED_IWLWIFI_DEVICE_TRACING
	tristate
	default IWLWIFI_DEVICE_TRACING
```

## external-drivers/ipts/Kconfig
```kconfig
# SPDX-License-Identifier: GPL-2.0-or-later

config MISC_IPTS
	tristate "Intel Precise Touch & Stylus"
	depends on INTEL_MEI
	help
	  Say Y here if your system has a touchscreen using Intels
	  Precise Touch & Stylus (IPTS) technology.

	  If unsure say N.

	  To compile this driver as a module, choose M here: the
	  module will be called ipts.

	  Building this driver alone will not give you a working touchscreen.
	  It only exposed a userspace API that can be used by a daemon to
	  receive and process data from the touchscreen hardware.
```

## external-drivers/ipts/src/Kconfig
```kconfig
# SPDX-License-Identifier: GPL-2.0-or-later

config HID_IPTS
	tristate "Intel Precise Touch & Stylus"
	depends on INTEL_MEI
	depends on HID
	help
	  Say Y here if your system has a touchscreen using Intels
	  Precise Touch & Stylus (IPTS) technology.

	  If unsure say N.

	  To compile this driver as a module, choose M here: the
	  module will be called ipts.
```

## external-drivers/ithc/src/Kconfig
```kconfig
config HID_ITHC
	tristate "Intel Touch Host Controller"
	depends on PCI
	depends on HID
	help
	  Say Y here if your system has a touchscreen using Intels
	  Touch Host Controller (ITHC / IPTS) technology.

	  If unsure say N.

	  To compile this driver as a module, choose M here: the
	  module will be called ithc.
```

## external-drivers/rtl8723de/Kconfig
```kconfig
config RTL8723DE
	tristate "Realtek 8723DE PCI WiFi"
	depends on PCI
	---help---
	  Help message of RTL8723DE
```

## external-drivers/rtl8812au/Kconfig
```kconfig
config RTL8812AU
	tristate "Realtek 8812A USB WiFi"
	depends on USB
	select WIRELESS_EXT
	help
	  Help message of RTL8812AU
```

## external-drivers/rtl8814au/Kconfig
```kconfig
config RTL8814AU
	tristate "Realtek 8814A USB WiFi"
	depends on USB
	select WIRELESS_EXT
	help
	  Help message of RTL8814AU
```

## external-drivers/rtl8821ce/Kconfig
```kconfig
config RTL8821CE
	tristate "Realtek 8821C PCI WiFi"
	depends on PCI
	---help---
	  Help message of RTL8821CE
```

## external-drivers/rtl8821cu/Kconfig
```kconfig
config RTL8821CU
	tristate "Realtek 8821C USB WiFi"
	depends on USB
	select WIRELESS_EXT
	help
	  Help message of RTL8821CU
```

## external-drivers/rtl88x2bu/Kconfig
```kconfig
config RTL8822BU
	tristate "Realtek 8822B USB WiFi"
	depends on USB
	---help---
	  RTL88X2BU driver updated for current kernels.
```

## kernel-4.19/Documentation/devicetree/bindings/devfreq/mt8183-cci-devfreq.txt
```
* Mediatek Cache Coherent Interconnect(CCI) frequency device

Required properties:
- compatible: should contain "mediatek,mt8183-cci" for frequency scaling of CCI
- clocks: for frequency scaling of CCI
- clock-names: for frequency scaling of CCI driver to reference
- regulator: for voltage scaling of CCI
- operating-points-v2: for frequency scaling of CCI opp table

Example:
	cci: cci {
		compatible = "mediatek,cci";
		clocks = <&apmixedsys CLK_APMIXED_CCIPLL>;
		clock-names = "cci_clock";
		operating-points-v2 = <&cci_opp>;
	};

	&cci {
		proc-supply = <&mt6358_vproc12_reg>;
	};
```

## kernel-4.19/Documentation/devicetree/bindings/display/bridge/ite,it6505.txt
```
iTE it6505 DP bridge bindings

Required properties:
        - compatible: "ite,it6505"
        - reg: i2c address of the bridge
        - ovdd-supply: I/O voltage
        - pwr18-supply: Core voltage
        - interrupts: interrupt specifier of INT pin
        - reset-gpios: gpio specifier of RESET pin

Example:
	it6505dptx: it6505dptx@5c {
                compatible = "ite,it6505";
                status = "okay";
                interrupt-parent = <&pio>;
                interrupts = <152 IRQ_TYPE_EDGE_RISING 152 0>;
                reg = <0x5c>;
                pinctrl-names = "default";
                pinctrl-0 = <&it6505_pins>;
                ovdd-supply = <&mt6358_vsim1_reg>;
                pwr18-supply = <&it6505_pp18_reg>;
                reset-gpios = <&pio 179 1>;
                hpd-gpios = <&pio 9 0>;
                extcon = <&usbc_extcon>;
                port {
                        it6505_in: endpoint {
                                remote-endpoint = <&dpi_out>;
                        };
                };
        };
```

## kernel-4.19/Documentation/devicetree/bindings/display/panel/boe,tv101wum-nl6.txt
```
Boe Corporation 10.1" WUXGA TFT LCD panel

Required properties:
- compatible: should be "boe,tv101wum-nl6"
- reg: the virtual channel number of a DSI peripheral
- enable-gpios: a GPIO spec for the enable pin
- pp1800-supply: core voltage supply
- avdd-supply: phandle of the regulator that provides positive voltage
- avee-supply: phandle of the regulator that provides negative voltage
- backlight: phandle of the backlight device attached to the panel

The device node can contain one 'port' child node with one child
'endpoint' node, according to the bindings defined in
media/video-interfaces.txt. This node should describe panel's video bus.

Example:
&dsi {
	...
	panel@0 {
		compatible = "boe,tv101wum-nl6";
		reg = <0>;
		enable-gpios = <&pio 45 0>;
		avdd-supply = <&ppvarn_lcd>;
		avee-supply = <&ppvarp_lcd>;
		pp1800-supply = <&pp1800_lcd>;
		backlight = <&backlight_lcd0>;
		status = "okay";
		port {
			panel_in: endpoint {
				remote-endpoint = <&dsi_out>;
			};
		};
	};
};
```

## kernel-4.19/Documentation/devicetree/bindings/media/i2c/ov02a10.txt
```
* Omnivision OV02A10 MIPI CSI-2 sensor

Required Properties:
- compatible: shall be "ovti,ov02a10"
- clocks: reference to the eclk input clock
- clock-names: shall be "eclk"
- dovdd-supply: Digital I/O voltage supply, 1.8 volts
- avdd-supply: Analog voltage supply, 2.8 volts
- dvdd-supply: Digital core voltage supply, 1.8 volts
- powerdown-gpios: reference to the GPIO connected to the powerdown pin,
		   if any. This is an active low signal to the OV02A10.
- reset-gpios: reference to the GPIO connected to the reset pin, if any.
	       This is an active high signal to the OV02A10.

Optional Properties:
- rotation: as defined in
	    Documentation/devicetree/bindings/media/video-interfaces.txt,
	    valid values are 0 (sensor mounted upright) and 180 (sensor
	    mounted upside down).

The device node shall contain one 'port' child node with an
'endpoint' subnode for its digital output video port,
in accordance with the video interface bindings defined in
Documentation/devicetree/bindings/media/video-interfaces.txt.

Example:
&i2c4 {
	ov02a10: camera-sensor@3d {
		compatible = "ovti,ov02a10";
		reg = <0x3d>;
		pinctrl-names = "default";
		pinctrl-0 = <&camera_pins_cam1_mclk_on>;

		clocks = <&topckgen CLK_TOP_MUX_CAMTG2>,
			<&topckgen CLK_TOP_UNIVP_192M_D8>;
		clock-names = "eclk", "freq_mux";
		clock-frequency = <24000000>;

		dovdd-supply = <&mt6358_vcamio_reg>;
		avdd-supply = <&mt6358_vcama1_reg>;
		dvdd-supply = <&mt6358_vcn18_reg>;
		powerdown-gpios = <&pio 107 GPIO_ACTIVE_LOW>;
		reset-gpios = <&pio 109 GPIO_ACTIVE_HIGH>;
		rotation = <180>;

		port {
			/* MIPI CSI-2 bus endpoint */
			ov02a10_core: endpoint {
				remote-endpoint = <&ov02a10_0>;
				link-frequencies = /bits/ 64 <390000000>;
			};
		};
	};
};
```
