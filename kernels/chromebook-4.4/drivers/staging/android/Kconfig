## kernels/kernel-chromebook-4.4/drivers/misc/throttler/Kconfig
```kconfig
# SPDX-License-Identifier: GPL-2.0

menuconfig THROTTLER
	bool "Throttler support"
	depends on OF
	depends on PM_DEVFREQ
	help
	  This option enables core support for non-thermal throttling of CPUs
	  and devfreq devices.

	  Note that you also need a event monitor module usually called
	  *_throttler.

if THROTTLER

menuconfig THROTTLER_DEBUG
	bool "Enable throttler debugging"
	help
	  This option enables throttler debugging features like additional
	  logging and a debugfs attribute for setting the logging level.

	  Choose N unless you want to debug throttler drivers.

config CROS_EC_THROTTLER
	tristate "Throttler event monitor for the Chrome OS Embedded Controller"
	depends on MFD_CROS_EC
	help
	  This driver adds support to throttle the system in reaction to
	  Chrome OS EC events.

	  To compile this driver as a module, choose M here: the
	  module will be called cros_ec_throttler.

endif # THROTTLER
```

## kernels/kernel-chromebook-5.4/Documentation/devicetree/bindings/arm/mediatek/mediatek,camsys.txt
```
MediaTek CAMSYS controller
============================

The MediaTek camsys controller provides various clocks to the system.

Required Properties:

- compatible: Should be one of:
	- "mediatek,mt6765-camsys", "syscon"
	- "mediatek,mt6779-camsys", "syscon"
	- "mediatek,mt8183-camsys", "syscon"
	- "mediatek,mt8192-camsys", "syscon"
	- "mediatek,mt8192-camsys_rawa", "syscon"
	- "mediatek,mt8192-camsys_rawb", "syscon"
	- "mediatek,mt8192-camsys_rawc", "syscon"
- #clock-cells: Must be 1

The camsys controller uses the common clk binding from
Documentation/devicetree/bindings/clock/clock-bindings.txt
The available clocks are defined in dt-bindings/clock/mt*-clk.h.

Example:

camsys: camsys@1a000000  {
	compatible = "mediatek,mt8183-camsys", "syscon";
	reg = <0 0x1a000000  0 0x1000>;
	#clock-cells = <1>;
};

camsys_rawa: syscon@1a04f000 {
	compatible = "mediatek,mt8192-camsys_rawa", "syscon";
	reg = <0 0x1a04f000 0 0x1000>;
	#clock-cells = <1>;
};

camsys_rawb: syscon@1a06f000 {
	compatible = "mediatek,mt8192-camsys_rawb", "syscon";
	reg = <0 0x1a06f000 0 0x1000>;
	#clock-cells = <1>;
};

camsys_rawc: syscon@1a08f000 {
	compatible = "mediatek,mt8192-camsys_rawc", "syscon";
	reg = <0 0x1a08f000 0 0x1000>;
	#clock-cells = <1>;
};
```

## kernels/kernel-chromebook-5.4/Documentation/devicetree/bindings/arm/mediatek/mediatek,mdpsys.yaml
```yaml
# SPDX-License-Identifier: (GPL-2.0 OR BSD-2-Clause)
%YAML 1.2
---
$id: http://devicetree.org/schemas/arm/mediatek/mediatek,mdpsys.yaml#
$schema: http://devicetree.org/meta-schemas/core.yaml#

title: MediaTek MDPSYS Controller

maintainers:
  - Weiyi Lu <weiyi.lu@mediatek.com>

description:
  The Mediatek mdpsys controller provides functional configurations and clocks to the system.

properties:
  compatible:
    items:
      - enum:
          - mediatek,mt8192-mdpsys
      - const: syscon

  reg:
    maxItems: 1

  '#clock-cells':
    const: 1

required:
  - compatible
  - reg

examples:
  - |
    mdpsys: syscon@1f000000 {
        compatible = "mediatek,mt8192-mdpsys", "syscon";
        reg = <0 0x1f000000 0 0x1000>;
        #clock-cells = <1>;
    };
```

## kernels/kernel-chromebook-5.4/Documentation/devicetree/bindings/gpu/arm,mali-midgard.yaml
```yaml
# SPDX-License-Identifier: GPL-2.0-only
%YAML 1.2
---
$id: http://devicetree.org/schemas/gpu/arm,mali-midgard.yaml#
$schema: http://devicetree.org/meta-schemas/core.yaml#

title: ARM Mali Midgard GPU

maintainers:
  - Rob Herring <robh@kernel.org>

properties:
  $nodename:
    pattern: '^gpu@[a-f0-9]+$'
  compatible:
    oneOf:
      - items:
          - enum:
             - allwinner,sun50i-h6-mali
          - const: arm,mali-t720
      - items:
          - enum:
             - amlogic,meson-gxm-mali
          - const: arm,mali-t820
      - items:
          - enum:
             - rockchip,rk3288-mali
          - const: arm,mali-t760
      - items:
          - enum:
             - rockchip,rk3399-mali
          - const: arm,mali-t860
      - items:
          - enum:
             - samsung,exynos5250-mali
          - const: arm,mali-t604
      - items:
          - enum:
             - samsung,exynos5433-mali
          - const: arm,mali-t760

          # "arm,mali-t624"
          # "arm,mali-t628"
          # "arm,mali-t830"
          # "arm,mali-t880"

  reg:
    maxItems: 1

  interrupts:
    items:
      - description: Job interrupt
      - description: MMU interrupt
      - description: GPU interrupt

  interrupt-names:
    items:
      - const: job
      - const: mmu
      - const: gpu

  clocks:
    minItems: 1
    maxItems: 2

  clock-names:
    minItems: 1
    items:
      - const: core
      - const: bus

  mali-supply:
    maxItems: 1

  resets:
    minItems: 1
    maxItems: 2

  operating-points-v2: true

  power_model:
    type: object
    description:
      Subnode with power model parameters. Note that this model was designed
      for the Juno platform, and may not be suitable for other platforms.

    properties:
      compatible:
        contains:
          const: arm,mali-simple-power-model

      dynamic-coefficient:
        description:
          Coefficient, in pW/(Hz V^2), which is multiplied by v^2*f to calculate
          the dynamic power consumption.
        $ref: /schemas/types.yaml#/definitions/int32

      static-coefficient:
        description:
          Coefficient, in uW/V^3, which is multiplied by v^3 to calculate the
          static power consumption.
        $ref: /schemas/types.yaml#/definitions/int32

      ts:
        description:
          An array containing coefficients for the temperature scaling factor.
          This is used to scale the static power by a factor of tsf/1000000,
          where tsf = ts[3]*T^3 + ts[2]*T^2 + ts[1]*T + ts[0], and
          T = temperature in degrees.
        $ref: /schemas/types.yaml#/definitions/int32

      thermal-zone:
        description:
          A string identifying the thermal zone used for the GPU

    required:
      - compatible
      - dynamic-coefficient
      - static-coefficient
      - ts
      - thermal-zone

  "#cooling-cells":
    const: 2

required:
  - compatible
  - reg
  - interrupts
  - interrupt-names
  - clocks

allOf:
  - if:
      properties:
        compatible:
          contains:
            const: allwinner,sun50i-h6-mali
    then:
      properties:
        clocks:
          minItems: 2
      required:
        - clock-names
        - resets
  - if:
      properties:
        compatible:
          contains:
            const: amlogic,meson-gxm-mali
    then:
      properties:
        resets:
          minItems: 2
      required:
        - resets

examples:
  - |
    #include <dt-bindings/interrupt-controller/irq.h>
    #include <dt-bindings/interrupt-controller/arm-gic.h>

    gpu@ffa30000 {
      compatible = "rockchip,rk3288-mali", "arm,mali-t760";
      reg = <0xffa30000 0x10000>;
      interrupts = <GIC_SPI 6 IRQ_TYPE_LEVEL_HIGH>,
             <GIC_SPI 7 IRQ_TYPE_LEVEL_HIGH>,
             <GIC_SPI 8 IRQ_TYPE_LEVEL_HIGH>;
      interrupt-names = "job", "mmu", "gpu";
      clocks = <&cru 0>;
      mali-supply = <&vdd_gpu>;
      operating-points-v2 = <&gpu_opp_table>;
      power-domains = <&power 0>;
      #cooling-cells = <2>;
    };

    gpu_opp_table: opp_table0 {
      compatible = "operating-points-v2";

      opp@533000000 {
        opp-hz = /bits/ 64 <533000000>;
        opp-microvolt = <1250000>;
      };
      opp@450000000 {
        opp-hz = /bits/ 64 <450000000>;
        opp-microvolt = <1150000>;
      };
      opp@400000000 {
        opp-hz = /bits/ 64 <400000000>;
        opp-microvolt = <1125000>;
      };
      opp@350000000 {
        opp-hz = /bits/ 64 <350000000>;
        opp-microvolt = <1075000>;
      };
      opp@266000000 {
        opp-hz = /bits/ 64 <266000000>;
        opp-microvolt = <1025000>;
      };
      opp@160000000 {
        opp-hz = /bits/ 64 <160000000>;
        opp-microvolt = <925000>;
      };
      opp@100000000 {
        opp-hz = /bits/ 64 <100000000>;
        opp-microvolt = <912500>;
      };
    };

...
```

## kernels/kernel-chromebook-5.4/Documentation/devicetree/bindings/media/mediatek-vcodec-decoder.txt
```
Mediatek Video Decoder

Mediatek Video Decoder is the video decode hw present in Mediatek SoCs which
supports high resolution decoding functionalities. Required  master and
component node properties:

Master properties:
- compatible :
  "mediatek,mt8173-vcodec-dec" for MT8173 decoder.
  "mediatek,mt8183-vcodec-dec" for MT8183 decoder.
  "mediatek,mt8192-vcodec-dec" for MT8192 decoder.
- reg : Physical base address of the video decoder registers and length of
  memory mapped region.
- iommus : should point to the respective IOMMU block with master port as
  argument, see Documentation/devicetree/bindings/iommu/mediatek,iommu.txt
  for details.
One of the two following nodes:
- mediatek,vpu : the node of the video processor unit, if using VPU.
- mediatek,scp : the node of the SCP unit, if using SCP.

component properties(core and lat):
- compatible(core) : "mediatek,mtk-vcodec-core" core hardware decoder
  "mediatek,mtk-vcodec-core" for core hardware decoder.
- compatible(lat) : "mediatek,mtk-vcodec-lat" lat hardware decoder
  "mediatek,mtk-vcodec-lat" for lat hardware decoder.
- reg : Physical base address of the video decoder registers and length of
  memory mapped region.
- interrupts : interrupt number to the cpu.
- clocks : list of clock specifiers, corresponding to entries in
  the clock-names property.
- clock-names: decoder must contain "vcodecpll", "univpll_d2",
  "clk_cci400_sel", "vdec_sel", "vdecpll", "vencpll", "venc_lt_sel",
  "vdec_bus_clk_src".
- iommus : should point to the respective IOMMU block with master port as
  argument, see Documentation/devicetree/bindings/iommu/mediatek,iommu.txt
  for details.
- dma-ranges : describes how the physical address space of the IOMMU maps
  to memory.

Example for no lat:
vcodec_dec: vcodec@16000000 {
    compatible = "mediatek,mt8173-vcodec-dec";
    reg = <0 0x16000000 0 0x100>,	/* VDEC_SYS */
          <0 0x16021000 0 0x800>,	/* VDEC_LD */
          <0 0x16021800 0 0x800>,	/* VDEC_TOP */
          <0 0x16022000 0 0x1000>,	/* VDEC_CM */
          <0 0x16023000 0 0x1000>,	/* VDEC_AD */
          <0 0x16024000 0 0x1000>,	/* VDEC_AV */
          <0 0x16025000 0 0x1000>,	/* VDEC_PP */
          <0 0x16026800 0 0x800>,	/* VDEC_HWD */
          <0 0x16027000 0 0x800>,	/* VDEC_HWQ */
          <0 0x16027800 0 0x800>,	/* VDEC_HWB */
          <0 0x16028400 0 0x400>;	/* VDEC_HWG */
    mediatek,larb = <&larb1>;
    iommus = <&iommu M4U_PORT_HW_VDEC_MC_EXT>;
    mediatek,vpu = <&vpu>;
  };

vcodec_core: core@0x16020000 {
    compatible = "mediatek,mtk-vcodec-core";
    reg = <0 0x16020000 0 0x1000>;	/* VDEC_MISC */
    interrupts = <GIC_SPI 204 IRQ_TYPE_LEVEL_LOW>;
    iommus = <&iommu M4U_PORT_HW_VDEC_MC_EXT>,
             <&iommu M4U_PORT_HW_VDEC_PP_EXT>,
             <&iommu M4U_PORT_HW_VDEC_AVC_MV_EXT>,
             <&iommu M4U_PORT_HW_VDEC_PRED_RD_EXT>,
             <&iommu M4U_PORT_HW_VDEC_PRED_WR_EXT>,
             <&iommu M4U_PORT_HW_VDEC_UFO_EXT>,
             <&iommu M4U_PORT_HW_VDEC_VLD_EXT>,
             <&iommu M4U_PORT_HW_VDEC_VLD2_EXT>;
    power-domains = <&scpsys MT8173_POWER_DOMAIN_VDEC>;
    clocks = <&apmixedsys CLK_APMIXED_VCODECPLL>,
             <&topckgen CLK_TOP_UNIVPLL_D2>,
             <&topckgen CLK_TOP_CCI400_SEL>,
             <&topckgen CLK_TOP_VDEC_SEL>,
             <&topckgen CLK_TOP_VCODECPLL>,
             <&apmixedsys CLK_APMIXED_VENCPLL>,
             <&topckgen CLK_TOP_VENC_LT_SEL>,
             <&topckgen CLK_TOP_VCODECPLL_370P5>;
    clock-names = "vcodecpll",
                  "univpll_d2",
                  "clk_cci400_sel",
                  "vdec_sel",
                  "vdecpll",
                  "vencpll",
                  "venc_lt_sel",
                  "vdec_bus_clk_src";
    assigned-clocks = <&topckgen CLK_TOP_VENC_LT_SEL>,
                      <&topckgen CLK_TOP_CCI400_SEL>,
                      <&topckgen CLK_TOP_VDEC_SEL>,
                      <&apmixedsys CLK_APMIXED_VCODECPLL>,
                      <&apmixedsys CLK_APMIXED_VENCPLL>;
    assigned-clock-parents = <&topckgen CLK_TOP_VCODECPLL_370P5>,
                             <&topckgen CLK_TOP_UNIVPLL_D2>,
                             <&topckgen CLK_TOP_VCODECPLL>;
    assigned-clock-rates = <0>, <0>, <0>, <1482000000>, <800000000>;
  };

Example for with lat:
vcodec_dec: vcodec_dec@16000000 {
    compatible = "mediatek,mt8192-vcodec-dec";
    reg = <0 0x16000000 0 0x1000>;		/* VDEC_SYS */
    mediatek,scp = <&scp>;
    iommus = <&iommu0 M4U_PORT_L4_VDEC_MC_EXT>;
    dma-ranges = <0x1 0x0 0x0 0x40000000 0x0 0xfff00000>;
  };

vcodec_lat: vcodec_lat@0x16010000 {
    compatible = "mediatek,mtk-vcodec-lat";
    reg = <0 0x16010000 0 0x800>;		/* VDEC_MISC */
    interrupts = <GIC_SPI 426 IRQ_TYPE_LEVEL_HIGH 0>;
    iommus = <&iommu0 M4U_PORT_L5_VDEC_LAT0_VLD_EXT>,
         <&iommu0 M4U_PORT_L5_VDEC_LAT0_VLD2_EXT>,
         <&iommu0 M4U_PORT_L5_VDEC_LAT0_AVC_MV_EXT>,
         <&iommu0 M4U_PORT_L5_VDEC_LAT0_PRED_RD_EXT>,
         <&iommu0 M4U_PORT_L5_VDEC_LAT0_TILE_EXT>,
         <&iommu0 M4U_PORT_L5_VDEC_LAT0_WDMA_EXT>,
         <&iommu0 M4U_PORT_L5_VDEC_LAT0_RG_CTRL_DMA_EXT>,
         <&iommu0 M4U_PORT_L5_VDEC_UFO_ENC_EXT>;
    dma-ranges = <0x1 0x0 0x0 0x40000000 0x0 0xfff00000>;
    clocks = <&topckgen CLK_TOP_VDEC_SEL>,
         <&vdecsys_soc CLK_VDEC_SOC_VDEC>,
         <&vdecsys_soc CLK_VDEC_SOC_LAT>,
         <&vdecsys_soc CLK_VDEC_SOC_LARB1>,
         <&topckgen CLK_TOP_MAINPLL_D4>;
    clock-names = "vdec-sel", "vdec-soc-vdec", "vdec-soc-lat", "vdec-vdec", "vdec-top";
    assigned-clocks = <&topckgen CLK_TOP_VDEC_SEL>;
    assigned-clock-parents = <&topckgen CLK_TOP_MAINPLL_D4>;
    power-domains = <&scpsys MT8192_POWER_DOMAIN_VDEC>;
  };

vcodec_core: vcodec_core@0x16025000 {
    compatible = "mediatek,mtk-vcodec-core";
    reg = <0 0x16025000 0 0x1000>;		/* VDEC_CORE_MISC */
    interrupts = <GIC_SPI 425 IRQ_TYPE_LEVEL_HIGH 0>;
    iommus = <&iommu0 M4U_PORT_L4_VDEC_MC_EXT>,
         <&iommu0 M4U_PORT_L4_VDEC_UFO_EXT>,
         <&iommu0 M4U_PORT_L4_VDEC_PP_EXT>,
         <&iommu0 M4U_PORT_L4_VDEC_PRED_RD_EXT>,
         <&iommu0 M4U_PORT_L4_VDEC_PRED_WR_EXT>,
         <&iommu0 M4U_PORT_L4_VDEC_PPWRAP_EXT>,
         <&iommu0 M4U_PORT_L4_VDEC_TILE_EXT>,
         <&iommu0 M4U_PORT_L4_VDEC_VLD_EXT>,
         <&iommu0 M4U_PORT_L4_VDEC_VLD2_EXT>,
         <&iommu0 M4U_PORT_L4_VDEC_AVC_MV_EXT>,
         <&iommu0 M4U_PORT_L4_VDEC_RG_CTRL_DMA_EXT>;
    dma-ranges = <0x1 0x0 0x0 0x40000000 0x0 0xfff00000>;
    clocks = <&topckgen CLK_TOP_VDEC_SEL>,
         <&vdecsys CLK_VDEC_VDEC>,
         <&vdecsys CLK_VDEC_LAT>,
         <&vdecsys CLK_VDEC_LARB1>,
         <&topckgen CLK_TOP_MAINPLL_D4>;
    clock-names = "vdec-sel", "vdec-soc-vdec", "vdec-soc-lat", "vdec-vdec", "vdec-top";
    assigned-clocks = <&topckgen CLK_TOP_VDEC_SEL>;
    assigned-clock-parents = <&topckgen CLK_TOP_MAINPLL_D4>;
    power-domains = <&scpsys MT8192_POWER_DOMAIN_VDEC2>;
 };
```
