// SPDX-License-Identifier: (GPL-2.0 OR MIT)
/*
 * Copyright 2021 Google LLC
 */

/dts-v1/;
#include "mt8183-kukui-jacuzzi-bellis.dtsi"
#include "mt8183-kukui-audio-da7219-rt1015p.dtsi"

/ {
	model = "Google bellis sku0 board";
	compatible = "google,bellis-rev0-sku0",
		"google,bellis", "mediatek,mt8183";
};

&i2c_tunnel {
	google,remote-bus = <2>;
};
