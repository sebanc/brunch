/*
 * Google Gru-Scarlet Rev4+ (SKU-6) board device tree source
 *
 * Copyright 2017 Google, Inc
 *
 * This file is dual-licensed: you can use it either under the terms
 * of the GPL or the X11 license, at your option. Note that this dual
 * licensing only applies to this file, and not this project as a
 * whole.
 *
 *  a) This file is free software; you can redistribute it and/or
 *     modify it under the terms of the GNU General Public License as
 *     published by the Free Software Foundation; either version 2 of the
 *     License, or (at your option) any later version.
 *
 *     This file is distributed in the hope that it will be useful,
 *     but WITHOUT ANY WARRANTY; without even the implied warranty of
 *     MERCHANTABILITY or FITNESS FOR A PARTICULAR PURPOSE.  See the
 *     GNU General Public License for more details.
 *
 *  Or, alternatively,
 *
 *  b) Permission is hereby granted, free of charge, to any person
 *     obtaining a copy of this software and associated documentation
 *     files (the "Software"), to deal in the Software without
 *     restriction, including without limitation the rights to use,
 *     copy, modify, merge, publish, distribute, sublicense, and/or
 *     sell copies of the Software, and to permit persons to whom the
 *     Software is furnished to do so, subject to the following
 *     conditions:
 *
 *     The above copyright notice and this permission notice shall be
 *     included in all copies or substantial portions of the Software.
 *
 *     THE SOFTWARE IS PROVIDED "AS IS", WITHOUT WARRANTY OF ANY KIND,
 *     EXPRESS OR IMPLIED, INCLUDING BUT NOT LIMITED TO THE WARRANTIES
 *     OF MERCHANTABILITY, FITNESS FOR A PARTICULAR PURPOSE AND
 *     NONINFRINGEMENT. IN NO EVENT SHALL THE AUTHORS OR COPYRIGHT
 *     HOLDERS BE LIABLE FOR ANY CLAIM, DAMAGES OR OTHER LIABILITY,
 *     WHETHER IN AN ACTION OF CONTRACT, TORT OR OTHERWISE, ARISING
 *     FROM, OUT OF OR IN CONNECTION WITH THE SOFTWARE OR THE USE OR
 *     OTHER DEALINGS IN THE SOFTWARE.
 */

/dts-v1/;

#include "rk3399-gru-scarlet.dtsi"

/ {
	model = "Google Scarlet";
	compatible = "google,scarlet-rev15-sku2", "google,scarlet-rev14-sku2",
		     "google,scarlet-rev13-sku2", "google,scarlet-rev12-sku2",
		     "google,scarlet-rev11-sku2", "google,scarlet-rev10-sku2",
		     "google,scarlet-rev9-sku2",  "google,scarlet-rev8-sku2",
		     "google,scarlet-rev7-sku2",  "google,scarlet-rev6-sku2",
		     "google,scarlet-rev5-sku2",  "google,scarlet-rev4-sku2",
		     "google,scarlet-rev15-sku4", "google,scarlet-rev14-sku4",
		     "google,scarlet-rev13-sku4", "google,scarlet-rev12-sku4",
		     "google,scarlet-rev11-sku4", "google,scarlet-rev10-sku4",
		     "google,scarlet-rev9-sku4",  "google,scarlet-rev8-sku4",
		     "google,scarlet-rev7-sku4",  "google,scarlet-rev6-sku4",
		     "google,scarlet-rev5-sku4",  "google,scarlet-rev4-sku4",
		     "google,scarlet-rev15-sku6", "google,scarlet-rev15",
		     "google,scarlet-rev14-sku6", "google,scarlet-rev14",
		     "google,scarlet-rev13-sku6", "google,scarlet-rev13",
		     "google,scarlet-rev12-sku6", "google,scarlet-rev12",
		     "google,scarlet-rev11-sku6", "google,scarlet-rev11",
		     "google,scarlet-rev10-sku6", "google,scarlet-rev10",
		     "google,scarlet-rev9-sku6",  "google,scarlet-rev9",
		     "google,scarlet-rev8-sku6",  "google,scarlet-rev8",
		     "google,scarlet-rev7-sku6",  "google,scarlet-rev7",
		     "google,scarlet-rev6-sku6",  "google,scarlet-rev6",
		     "google,scarlet-rev5-sku6",  "google,scarlet-rev5",
		     "google,scarlet-rev4-sku6",  "google,scarlet-rev4",
		     "google,scarlet", "google,gru", "rockchip,rk3399";
};

&mipi_panel {
	compatible = "innolux,p097pfg";
	/delete-property/ power-supply;
	avdd-supply = <&ppvarp_lcd>;
	avee-supply = <&ppvarn_lcd>;
};
