// SPDX-License-Identifier: (GPL-2.0+ OR MIT)
/*
 * Google CoachZ board device tree source
 *
 * Copyright 2020 Google LLC.
 */

#include "sc7180-trogdor-coachz-r1.dts"
#include "sc7180-trogdor-lte-sku.dtsi"

/ {
	model = "Google CoachZ (rev1+) with LTE";
	compatible = "google,coachz-sku0", "qcom,sc7180";
};
