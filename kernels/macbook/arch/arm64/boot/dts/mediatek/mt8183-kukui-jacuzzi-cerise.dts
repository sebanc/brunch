// SPDX-License-Identifier: (GPL-2.0 OR MIT)
/*
 * Copyright 2021 Google LLC
 */

/dts-v1/;
#include "mt8183-kukui-jacuzzi-cerise.dtsi"
#include "mt8183-kukui-audio-da7219-rt1015p.dtsi"

/ {
	model = "Google cerise board";
	compatible = "google,cerise-sku0", "google,cerise", "mediatek,mt8183";
};

&mt6358codec {
	mediatek,dmic-mode = <1>; /* one-wire */
};

&touchscreen {
	status = "disabled";
};

&qca_wifi {
	qcom,ath10k-calibration-variant = "GO_CERISE";
};
