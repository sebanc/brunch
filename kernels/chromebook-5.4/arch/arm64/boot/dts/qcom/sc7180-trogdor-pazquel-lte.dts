// SPDX-License-Identifier: (GPL-2.0+ OR MIT)
/*
 * Google Pazquel board device tree source
 *
 * Copyright 2021 Google LLC.
 */

#include "sc7180-trogdor-pazquel.dts"
#include "sc7180-trogdor-lte-sku.dtsi"

/ {
	model = "Google Pazquel with LTE";
	compatible = "google,pazquel-sku0", "google,pazquel-sku2", "qcom,sc7180";
};
