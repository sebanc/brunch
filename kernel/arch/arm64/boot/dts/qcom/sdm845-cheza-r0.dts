// SPDX-License-Identifier: (GPL-2.0+ OR MIT)
/*
 * Google Cheza board device tree source
 *
 * Copyright 2018 Google LLC.
 */

/dts-v1/;

/ {
	model = "!!!!! NOTE Google Cheza (rev0) is NOT SUPPORTED ANYMORE !!!!";
	compatible = "google,cheza-rev0", "google,cheza", "qcom,sdm845";
};
