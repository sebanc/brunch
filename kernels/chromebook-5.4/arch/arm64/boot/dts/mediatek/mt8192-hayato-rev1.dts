// SPDX-License-Identifier: (GPL-2.0 OR MIT)
/*
 * Copyright 2020 Google LLC
 */
/dts-v1/;
#include "mt8192-asurada.dtsi"
#include "mt8192-asurada-audio-rt1015p-rt5682.dtsi"

/ {
	model = "MediaTek Hayato rev1 board";
	compatible = "google,hayato-rev1", "google,hayato", "mediatek,mt8192";
};
