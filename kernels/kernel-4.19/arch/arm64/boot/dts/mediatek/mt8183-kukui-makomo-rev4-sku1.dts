// SPDX-License-Identifier: (GPL-2.0 OR MIT)
/*
 * Copyright 2021 Google LLC
 */

/dts-v1/;
#include "mt8183-kukui-makomo.dtsi"
#include "mt8183-kukui-audio-ts3a227e-rt1015p.dtsi"

/ {
	model = "Google makomo rev4/rev5 sku1 board";
	compatible = "google,makomo-rev4-sku1", "google,makomo-rev5-sku1",
		"google,makomo", "mediatek,mt8183";
};

&qca_wifi {
	qcom,ath10k-calibration-variant = "GO_FENNEL14";
};

&mmc1_pins_uhs {
	pins_clk {
		drive-strength = <MTK_DRIVE_6mA>;
	};
};
