## kernel/Documentation/devicetree/bindings/gpu/arm,mali-midgard.txt
```
ARM Mali Midgard GPU
====================

Required properties:

- compatible :
  * Must contain one of the following:
    + "arm,mali-t604"
    + "arm,mali-t624"
    + "arm,mali-t628"
    + "arm,mali-t720"
    + "arm,mali-t760"
    + "arm,mali-t820"
    + "arm,mali-t830"
    + "arm,mali-t860"
    + "arm,mali-t880"
  * which must be preceded by one of the following vendor specifics:
    + "amlogic,meson-gxm-mali"
    + "rockchip,rk3288-mali"
    + "rockchip,rk3399-mali"

- reg : Physical base address of the device and length of the register area.

- interrupts : Contains the three IRQ lines required by Mali Midgard devices.

- interrupt-names : Contains the names of IRQ resources in the order they were
  provided in the interrupts property. Must contain: "job", "mmu", "gpu".


Optional properties:

- clocks : Phandle to clock for the Mali Midgard device.

- mali-supply : Phandle to regulator for the Mali device. Refer to
  Documentation/devicetree/bindings/regulator/regulator.txt for details.

- operating-points-v2 : Refer to Documentation/devicetree/bindings/opp/opp.txt
  for details.

- #cooling-cells: Refer to Documentation/devicetree/bindings/thermal/thermal.txt
  for details.

- power_model : Sets power model parameters. Note that this model was designed for the Juno
	        platform, and may not be suitable for other platforms. A structure containing :
	- compatible: Should be arm,mali-simple-power-model
	- dynamic-coefficient: Coefficient, in pW/(Hz V^2), which is multiplied
	  by v^2*f to calculate the dynamic power consumption.
	- static-coefficient: Coefficient, in uW/V^3, which is multiplied by
	  v^3 to calculate the static power consumption.
	- ts: An array containing coefficients for the temperature scaling
	  factor. This is used to scale the static power by a factor of
	  tsf/1000000, where tsf = ts[3]*T^3 + ts[2]*T^2 + ts[1]*T + ts[0],
	  and T = temperature in degrees.
	- thermal-zone: A string identifying the thermal zone used for the GPU

Example for a Mali-T760:

gpu@ffa30000 {
	compatible = "rockchip,rk3288-mali", "arm,mali-t760";
	reg = <0xffa30000 0x10000>;
	interrupts = <GIC_SPI 6 IRQ_TYPE_LEVEL_HIGH>,
		     <GIC_SPI 7 IRQ_TYPE_LEVEL_HIGH>,
		     <GIC_SPI 8 IRQ_TYPE_LEVEL_HIGH>;
	interrupt-names = "job", "mmu", "gpu";
	clocks = <&cru ACLK_GPU>;
	mali-supply = <&vdd_gpu>;
	operating-points-v2 = <&gpu_opp_table>;
	power-domains = <&power RK3288_PD_GPU>;
	#cooling-cells = <2>;
};

gpu_opp_table: opp_table0 {
	compatible = "operating-points-v2";

	opp@533000000 {
		opp-hz = /bits/ 64 <533000000>;
		opp-microvolt = <1250000>;
	};
	opp@450000000 {
		opp-hz = /bits/ 64 <450000000>;
		opp-microvolt = <1150000>;
	};
	opp@400000000 {
		opp-hz = /bits/ 64 <400000000>;
		opp-microvolt = <1125000>;
	};
	opp@350000000 {
		opp-hz = /bits/ 64 <350000000>;
		opp-microvolt = <1075000>;
	};
	opp@266000000 {
		opp-hz = /bits/ 64 <266000000>;
		opp-microvolt = <1025000>;
	};
	opp@160000000 {
		opp-hz = /bits/ 64 <160000000>;
		opp-microvolt = <925000>;
	};
	opp@100000000 {
		opp-hz = /bits/ 64 <100000000>;
		opp-microvolt = <912500>;
	};
};
```

## kernel/Documentation/devicetree/bindings/iio/proximity/sx932x.txt
```
Semtech's SX9320/SX9321/SX9324 capacitive proximity button device driver

Required properties:
	- compatible: must be "semtech,sx9320 or sx9321 or sx9324"
	- reg: i2c address where to find the device
	- interrupt-parent : should be the phandle for the interrupt controller
	- interrupts : the sole interrupt generated by the device
	- semtech,register-prefix: the string prefixing all register names in the

	Refer to interrupt-controller/interrupts.txt for generic
	interrupt client node bindings.

Optional properties:
	- semtech,adv_ctrl10: Initial value for register AdvCtrl10.
	- semtech,afe_ctrl4: Initial value for register AfeCtrl4.
	- semtech,afe_ctrl7: Initial value for register AfeCtrl7.
	- semtech,afe_ctrl9: Initial value for register AfeCtrl9.
	- semtech,prox_ctrl0: Initial value for register ProxCtrl0.
	- semtech,prox_ctrl1: Initial value for register ProxCtrl1.
	- semtech,prox_ctrl2: Initial value for register ProxCtrl2.
	- semtech,prox_ctrl4: Initial value for register ProxCtrl4.
	- semtech,prox_ctrl5: Initial value for register ProxCtrl5.
	- semtech,prox_ctrl6: Initial value for register ProxCtrl6.
	- semtech,prox_ctrl7: Initial value for register Prox_Trl7.
	- semtech,adv_ctrl16: Initial value for register AdvCtrl16.
	- semtech,adv_ctrl17: Initial value for register AdvCtrl17.
	- semtech,adv_ctrl18: Initial value for register AdvCtrl18.
	- semtech,gnrl_ctrl1: Initial value for register GnrlCtrl1.

	Refer to the data sheet for register definitions.

Example:

sx9310@28 {
	compatible = "semtech,sx9320";
	reg = <0x28>;
	interrupt-parent = <&gpio2>;
	interrupts = <16 IRQ_TYPE_LEVEL_LOW>;
};

Driver supports ACPI bindings. We can store registers configuration obtained
from per-model SAR sensor calibration. Refer to the data sheet for meaning.

ACPI name is STH9320 or STH9321 or STH9324.

Example:
    chip drivers/i2c/generic
            register "hid" = ""STH9321""
            register "name" = ""SEMTECH SX9321""
            register "desc" = ""SAR Proximity Sensor""
            register "irq" = "ACPI_IRQ_LEVEL_LOW(GPP_A18_IRQ)"
            register "device_present_gpio" = "GPP_B20"
            device i2c 28 on end
    end
```

## kernel/Documentation/devicetree/bindings/media/i2c/dongwoon,dw9768.txt
```
Dongwoon Anatech DW9768 camera voice coil lens driver

DW9768 is a 10-bit DAC with current sink capability. It is intended
for driving voice coil lenses in camera modules.

Mandatory properties:

- compatible: "dongwoon,dw9768"
- reg: I²C slave address
```

## kernel/Documentation/devicetree/bindings/media/mediatek,mt8183-mdp3.txt
```
* Mediatek Media Data Path 3

Media Data Path 3 (MDP3) is used for scaling and color space conversion.

Required properties (controller node):
- compatible: "mediatek,mt8183-mdp"
- mediatek,scp: the node of system control processor (SCP), using the
  remoteproc & rpmsg framework, see
  Documentation/devicetree/bindings/remoteproc/mtk,scp.txt for details.
- mediatek,mmsys: the node of mux(multiplexer) controller for HW connections.
- mediatek,mm-mutex: the node of sof(start of frame) signal controller.
- mediatek,mailbox-gce: the node of global command engine (GCE), used to
  read/write registers with critical time limitation, see
  Documentation/devicetree/bindings/mailbox/mtk-gce.txt for details.
- mboxes: mailbox number used to communicate with GCE.
- gce-subsys: sub-system id corresponding to the register address.
- gce-event-names: in use event name list, used to correspond to event IDs.
- gce-events: in use event IDs list, all IDs are defined in
  'dt-bindings/gce/mt8183-gce.h'.

Required properties (all function blocks, child node):
- compatible: Should be one of
        "mediatek,mt8183-mdp-rdma"  - read DMA
        "mediatek,mt8183-mdp-rsz"   - resizer
        "mediatek,mt8183-mdp-wdma"  - write DMA
        "mediatek,mt8183-mdp-wrot"  - write DMA with rotation
        "mediatek,mt8183-mdp-ccorr" - color correction with 3X3 matrix
- reg: Physical base address and length of the function block register space
- clocks: device clocks, see
  Documentation/devicetree/bindings/clock/clock-bindings.txt for details.
- power-domains: a phandle to the power domain, see
  Documentation/devicetree/bindings/power/power_domain.txt for details.
- mediatek,mdp-id: HW index to distinguish same functionality modules.

Required properties (DMA function blocks, child node):
- compatible: Should be one of
        "mediatek,mt8183-mdp-rdma"
        "mediatek,mt8183-mdp-wdma"
        "mediatek,mt8183-mdp-wrot"
- iommus: should point to the respective IOMMU block with master port as
  argument, see Documentation/devicetree/bindings/iommu/mediatek,iommu.txt
  for details.
- mediatek,larb: must contain the local arbiters in the current Socs, see
  Documentation/devicetree/bindings/memory-controllers/mediatek,smi-larb.txt
  for details.

Required properties (input path selection node):
- compatible:
        "mediatek,mt8183-mdp-dl"    - MDP direct link input source selection
- reg: Physical base address and length of the function block register space
- clocks: device clocks, see
  Documentation/devicetree/bindings/clock/clock-bindings.txt for details.
- mediatek,mdp-id: HW index to distinguish same functionality modules.

Required properties (ISP PASS2 (DIP) module path selection node):
- compatible:
        "mediatek,mt8183-mdp-imgi"  - input DMA of ISP PASS2 (DIP) module for raw image input
- reg: Physical base address and length of the function block register space
- mediatek,mdp-id: HW index to distinguish same functionality modules.

Required properties (SW node):
- compatible: Should be one of
        "mediatek,mt8183-mdp-exto"  - output DMA of ISP PASS2 (DIP) module for yuv image output
        "mediatek,mt8183-mdp-path"  - MDP output path selection
- mediatek,mdp-id: HW index to distinguish same functionality modules.

Example:
		mdp_camin@14000000 {
			compatible = "mediatek,mt8183-mdp-dl";
			mediatek,mdp-id = <0>;
			reg = <0 0x14000000 0 0x1000>;
			mediatek,gce-client-reg = <&gce SUBSYS_1400XXXX 0 0x1000>;
			clocks = <&mmsys CLK_MM_MDP_DL_TXCK>,
				<&mmsys CLK_MM_MDP_DL_RX>;
		};

		mdp_camin2@14000000 {
			compatible = "mediatek,mt8183-mdp-dl";
			mediatek,mdp-id = <1>;
			reg = <0 0x14000000 0 0x1000>;
			mediatek,gce-client-reg = <&gce SUBSYS_1400XXXX 0 0x1000>;
			clocks = <&mmsys CLK_MM_IPU_DL_TXCK>,
				<&mmsys CLK_MM_IPU_DL_RX>;
		};

		mdp_rdma0: mdp_rdma0@14001000 {
			compatible = "mediatek,mt8183-mdp-rdma",
				     "mediatek,mt8183-mdp3";
			mediatek,scp = <&scp>;
			mediatek,mdp-id = <0>;
			reg = <0 0x14001000 0 0x1000>;
			mediatek,gce-client-reg = <&gce SUBSYS_1400XXXX 0x1000 0x1000>;
			power-domains = <&scpsys MT8183_POWER_DOMAIN_DISP>;
			clocks = <&mmsys CLK_MM_MDP_RDMA0>,
				<&mmsys CLK_MM_MDP_RSZ1>;
			iommus = <&iommu M4U_PORT_MDP_RDMA0>;
			mediatek,larb = <&larb0>;
			mediatek,mmsys = <&mmsys>;
			mediatek,mm-mutex = <&mutex>;
			mediatek,mailbox-gce = <&gce>;
			mboxes = <&gce 20 CMDQ_THR_PRIO_LOWEST 0>,
				<&gce 21 CMDQ_THR_PRIO_LOWEST 0>,
				<&gce 22 CMDQ_THR_PRIO_LOWEST 0>,
				<&gce 23 CMDQ_THR_PRIO_LOWEST 0>;
			gce-subsys = <&gce 0x14000000 SUBSYS_1400XXXX>,
				<&gce 0x14010000 SUBSYS_1401XXXX>,
				<&gce 0x14020000 SUBSYS_1402XXXX>,
				<&gce 0x15020000 SUBSYS_1502XXXX>;
			mediatek,gce-events = <CMDQ_EVENT_MDP_RDMA0_SOF>,
				<CMDQ_EVENT_MDP_RDMA0_EOF>,
				<CMDQ_EVENT_MDP_RSZ0_SOF>,
				<CMDQ_EVENT_MDP_RSZ1_SOF>,
				<CMDQ_EVENT_MDP_TDSHP_SOF>,
				<CMDQ_EVENT_MDP_WROT0_SOF>,
				<CMDQ_EVENT_MDP_WROT0_EOF>,
				<CMDQ_EVENT_MDP_WDMA0_SOF>,
				<CMDQ_EVENT_MDP_WDMA0_EOF>,
				<CMDQ_EVENT_ISP_FRAME_DONE_P2_0>,
				<CMDQ_EVENT_ISP_FRAME_DONE_P2_1>,
				<CMDQ_EVENT_ISP_FRAME_DONE_P2_2>,
				<CMDQ_EVENT_ISP_FRAME_DONE_P2_3>,
				<CMDQ_EVENT_ISP_FRAME_DONE_P2_4>,
				<CMDQ_EVENT_ISP_FRAME_DONE_P2_5>,
				<CMDQ_EVENT_ISP_FRAME_DONE_P2_6>,
				<CMDQ_EVENT_ISP_FRAME_DONE_P2_7>,
				<CMDQ_EVENT_ISP_FRAME_DONE_P2_8>,
				<CMDQ_EVENT_ISP_FRAME_DONE_P2_9>,
				<CMDQ_EVENT_ISP_FRAME_DONE_P2_10>,
				<CMDQ_EVENT_ISP_FRAME_DONE_P2_11>,
				<CMDQ_EVENT_ISP_FRAME_DONE_P2_12>,
				<CMDQ_EVENT_ISP_FRAME_DONE_P2_13>,
				<CMDQ_EVENT_ISP_FRAME_DONE_P2_14>,
				<CMDQ_EVENT_WPE_A_DONE>,
				<CMDQ_EVENT_SPE_B_DONE>;
		};

		mdp_imgi@15020000 {
			compatible = "mediatek,mt8183-mdp-imgi";
			mediatek,mdp-id = <0>;
			reg = <0 0x15020000 0 0x1000>;
			mediatek,gce-client-reg = <&gce SUBSYS_1502XXXX 0 0x1000>;
		};

		mdp_img2o@15020000 {
			compatible = "mediatek,mt8183-mdp-exto";
			mediatek,mdp-id = <1>;
		};

		mdp_rsz0: mdp_rsz0@14003000 {
			compatible = "mediatek,mt8183-mdp-rsz";
			mediatek,mdp-id = <0>;
			reg = <0 0x14003000 0 0x1000>;
			mediatek,gce-client-reg = <&gce SUBSYS_1400XXXX 0x3000 0x1000>;
			clocks = <&mmsys CLK_MM_MDP_RSZ0>;
		};

		mdp_rsz1: mdp_rsz1@14004000 {
			compatible = "mediatek,mt8183-mdp-rsz";
			mediatek,mdp-id = <1>;
			reg = <0 0x14004000 0 0x1000>;
			mediatek,gce-client-reg = <&gce SUBSYS_1400XXXX 0x4000 0x1000>;
			clocks = <&mmsys CLK_MM_MDP_RSZ1>;
		};

		mdp_wrot0: mdp_wrot0@14005000 {
			compatible = "mediatek,mt8183-mdp-wrot";
			mediatek,mdp-id = <0>;
			reg = <0 0x14005000 0 0x1000>;
			mediatek,gce-client-reg = <&gce SUBSYS_1400XXXX 0x5000 0x1000>;
			clocks = <&mmsys CLK_MM_MDP_WROT0>;
			iommus = <&iommu M4U_PORT_MDP_WROT0>;
			mediatek,larb = <&larb0>;
		};

		mdp_path0_sout@14005000 {
			compatible = "mediatek,mt8183-mdp-path";
			mediatek,mdp-id = <0>;
		};

		mdp_wdma: mdp_wdma@14006000 {
			compatible = "mediatek,mt8183-mdp-wdma";
			mediatek,mdp-id = <0>;
			reg = <0 0x14006000 0 0x1000>;
			mediatek,gce-client-reg = <&gce SUBSYS_1400XXXX 0x6000 0x1000>;
			clocks = <&mmsys CLK_MM_MDP_WDMA0>;
			iommus = <&iommu M4U_PORT_MDP_WDMA0>;
			mediatek,larb = <&larb0>;
		};

		mdp_path1_sout@14006000 {
			compatible = "mediatek,mt8183-mdp-path";
			mediatek,mdp-id = <1>;
		};

		mdp_ccorr: mdp_ccorr@1401c000 {
			compatible = "mediatek,mt8183-mdp-ccorr";
			mediatek,mdp-id = <0>;
			reg = <0 0x1401c000 0 0x1000>;
			mediatek,gce-client-reg = <&gce SUBSYS_1401XXXX 0xc000 0x1000>;
			clocks = <&mmsys CLK_MM_MDP_CCORR>;
		};
```
