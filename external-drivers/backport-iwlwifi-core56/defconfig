## kernel-4.19/Documentation/devicetree/bindings/net/phy.txt
```
PHY nodes

Required properties:

 - interrupts : interrupt specifier for the sole interrupt.
 - reg : The ID number for the phy, usually a small integer

Optional Properties:

- compatible: Compatible list, may contain
  "ethernet-phy-ieee802.3-c22" or "ethernet-phy-ieee802.3-c45" for
  PHYs that implement IEEE802.3 clause 22 or IEEE802.3 clause 45
  specifications. If neither of these are specified, the default is to
  assume clause 22.

  If the PHY reports an incorrect ID (or none at all) then the
  "compatible" list may contain an entry with the correct PHY ID in the
  form: "ethernet-phy-idAAAA.BBBB" where
     AAAA - The value of the 16 bit Phy Identifier 1 register as
            4 hex digits. This is the chip vendor OUI bits 3:18
     BBBB - The value of the 16 bit Phy Identifier 2 register as
            4 hex digits. This is the chip vendor OUI bits 19:24,
            followed by 10 bits of a vendor specific ID.

  The compatible list should not contain other values than those
  listed here.

- max-speed: Maximum PHY supported speed (10, 100, 1000...)

- leds: Subnode with configuration of the PHY LEDs.

  Required subnode properties:

  - reg: The ID number of the LED, typically corresponds to a hardware ID.

  Optional subnode properties:

  - linux,default-trigger: This parameter, if present, is a string specifying
                           the trigger assigned to the LED. Supported triggers
			   are:

      "none" - LED will be solid off
      "phy-link" - LED will be solid on when a link is active
      "phy-link-10m" - LED will be solid on when a 10Mb/s link is active
      "phy-link-100m" - LED will be solid on when a 100Mb/s link is active
      "phy-link-1g" - LED will be solid on when a 1Gb/s link is active
      "phy-link-10g" - LED will be solid on when a 10Gb/s link is active
      "phy-link-activity" - LED will be on when link is active and blink
                            off with activity.
      "phy-link-10m-activity" - LED will be on when 10Mb/s link is active
                                and blink off with activity.
      "phy-link-100m-activity" - LED will be on when 100Mb/s link is
                                 active and blink off with activity.
      "phy-link-1g-activity" - LED will be on when 1Gb/s link is active
                               and blink off with activity.
      "phy-link-10g-activity" - LED will be on when 10Gb/s link is active
                                and blink off with activity.

- broken-turn-around: If set, indicates the PHY device does not correctly
  release the turn around line low at the end of a MDIO transaction.

- enet-phy-lane-swap: If set, indicates the PHY will swap the TX/RX lanes to
  compensate for the board being designed with the lanes swapped.

- enet-phy-lane-no-swap: If set, indicates that PHY will disable swap of the
  TX/RX lanes. This property allows the PHY to work correcly after e.g. wrong
  bootstrap configuration caused by issues in PCB layout design.

- eee-broken-100tx:
- eee-broken-1000t:
- eee-broken-10gt:
- eee-broken-1000kx:
- eee-broken-10gkx4:
- eee-broken-10gkr:
  Mark the corresponding energy efficient ethernet mode as broken and
  request the ethernet to stop advertising it.

- phy-is-integrated: If set, indicates that the PHY is integrated into the same
  physical package as the Ethernet MAC. If needed, muxers should be configured
  to ensure the integrated PHY is used. The absence of this property indicates
  the muxers should be configured so that the external PHY is used.

- reset-gpios: The GPIO phandle and specifier for the PHY reset signal.

- reset-assert-us: Delay after the reset was asserted in microseconds.
  If this property is missing the delay will be skipped.

- reset-deassert-us: Delay after the reset was deasserted in microseconds.
  If this property is missing the delay will be skipped.

Example:

ethernet-phy@0 {
	compatible = "ethernet-phy-id0141.0e90", "ethernet-phy-ieee802.3-c22";
	interrupt-parent = <&PIC>;
	interrupts = <35 IRQ_TYPE_EDGE_RISING>;
	reg = <0>;

	reset-gpios = <&gpio1 4 GPIO_ACTIVE_LOW>;
	reset-assert-us = <1000>;
	reset-deassert-us = <2000>;

	leds {
		#address-cells = <1>;
		#size-cells = <0>;

		led@0 {
			reg = <0>;
			linux,default-trigger = "phy-link-1g";
		};

		led@1 {
			reg = <1>;
			linux,default-trigger = "phy-link-100m-activity";
		};
	};
};
```

## kernel-4.19/Documentation/devicetree/bindings/soc/rockchip/rk3288-service-bus.txt
```
* Rockchip rk3288 Interconnect Service Bus

This device contains registers to control the memory scheduler on
rk3288 SoCs.  It is accessed during DDRFreq transitions and also at
suspend/resume.

Downstream this is sometimes referred to as the NoC (network on chip).


Required Properties:

- compatible: GRF should be one of the following:
   - compatible = "rockchip,rk3288-service-bus", "syscon";
- reg: physical base address of the controller and length of memory mapped
  region.

Example:

	service_bus: syscon@ffac0000 {
		compatible = "rockchip,rk3288-service-bus", "syscon";
		reg = <0x0 0xffac0000 0x0 0x2000>;
	};
```
