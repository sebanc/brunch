## kernel-chromebook-5.4/drivers/media/platform/camx/Kconfig
```kconfig
#
# Qualcomm camera configuration
#

menuconfig SPECTRA_CAMERA
	bool "Qualcomm Technologies, Inc. Spectra Camera"
	depends on (ARCH_QCOM)
	depends on (MEDIA_SUPPORT && MEDIA_CONTROLLER && V4L_PLATFORM_DRIVERS)
	depends on (VIDEO_DEV && VIDEO_V4L2=y)
	depends on ARM64
	depends on !COMPILE_TEST
	depends on SC_CAMCC_7180
	help
	  Say Y here to enable selecting the video adapters for
	  Qualcomm Technologies, Inc. Spectra camera and video capture.
	  Enabling this adds support for the camera driver stack including sensor,
	  IFE and postprocessing drivers.

if SPECTRA_CAMERA

config QTI_CAMERA_SYNC
        bool "Qualcomm camera SYNC driver"
	default y
        help
	  Say Y here to enable selecting module
          Support for camera drivers synchronization

config QTI_CAMERA_SMMU
        bool "Qualcomm System Memory Management Unit (SMMU)"
	default y
	depends on (IOMMU_DMA)
        help
	  Say Y here to enable selecting module
          Support for memory pools and context banks

config QTI_CAMERA_CRM
        bool "Qualcomm Camera Request Manager (CRM)"
	default y
	depends on (QTI_CAMERA_SYNC && QTI_CAMERA_SMMU)
	select VIDEOBUF2_DMA_SG
        help
	  Say Y here to enable selecting module
          Support for camera drivers memory requests

config QTI_ISP
        bool "Qualcomm ISP drivers"
	depends on (QTI_CAMERA_SYNC && QTI_CAMERA_SMMU && QTI_CAMERA_CRM)
	default y
        help
	  Say Y here to enable selecting module
	  Support for the ISP engine

if QTI_ISP
	config QTI_MIPI_PHY
		bool "Qualcomm MIPI C-PHY driver"
		default y
		depends on (QTI_ISP)
		help
		  Say Y here to enable selecting module
		  Support for MIPI Combo CSI physical interfaces

	config QTI_PPI
		bool "Qualcomm PPI driver"
		default y
		depends on (QTI_ISP)
		help
		  Say Y here to enable selecting module
		  Support for the PPI interfaces

	config QTI_CSID
		bool "Qualcomm CSIDx driver"
		default y
		depends on (QTI_ISP)
		help
		  Say Y here to enable selecting module
		  Support for the CSIDx engines

	config QTI_VFE
		bool "Qualcomm VFEx driver"
		default y
		depends on (QTI_ISP)
		help
		  Say Y here to enable selecting module
		  Support for the VFEx engines

	config QTI_VFE_LITE
		bool "Qualcomm Lite VFEx driver"
		default y
		depends on (QTI_ISP)
		help
		  Say Y here to enable selecting module
		  Support for the Lite IFEx engines
endif

config QTI_ICP_A5
        bool "Qualcomm ICP/A5 driver"
	depends on (QTI_CAMERA_SYNC && QTI_CAMERA_SMMU && QTI_CAMERA_CRM)
	default y
        help
	  Say Y here to enable selecting module
          Support for the ICP/A5 engine

if QTI_ICP_A5
	config QTI_IPE
		bool "Qualcomm IPE driver"
		default y
		depends on (QTI_ICP_A5)
		help
		  Say Y here to enable selecting module
		  Support for the IPE engines

	config QTI_BPS
		bool "Qualcomm BPS driver"
		default y
		depends on (QTI_ICP_A5)
		help
		  Say Y here to enable selecting module
		  Support for the BPS engine
endif

config QTI_CPAS
        bool "Qualcomm CPAS driver"
	default y
	depends on (QTI_CAMERA_SYNC && QTI_CAMERA_SMMU && QTI_CAMERA_CRM)
	depends on QCOM_CLK_RPMH
	depends on INTERCONNECT_QCOM_SC7180
        help
	  Say Y here to enable selecting module
          Support for CDMx engines SW interface

if QTI_CPAS
	config QTI_CDM
		bool "Qualcomm CDMx driver"
		default y
		depends on (QTI_CPAS)
		help
		  Say Y here to enable selecting module
		  Support for the CDMx engine
endif

config QTI_JPEG
        bool "Qualcomm JPEG driver"
	default n
	depends on (QTI_CAMERA_SYNC && QTI_CAMERA_SMMU && QTI_CAMERA_CRM)
        help
	  Say Y here to enable selecting module
          Support for the JPEG engine

config QTI_FD
        bool "Qualcomm FD driver"
	default n
	depends on (QTI_CAMERA_SYNC && QTI_CAMERA_SMMU && QTI_CAMERA_CRM)
        help
	  Say Y here to enable selecting module
          Support for the FD engine

config QTI_LRME
        bool "Qualcomm LRME driver"
	default n
	depends on (QTI_CAMERA_SYNC && QTI_CAMERA_SMMU && QTI_CAMERA_CRM)
        help
	  Say Y here to enable selecting module
          Support for the LRME engine

config QTI_SENSORS
        bool "Qualcomm sensor drivers"
	default y
	depends on (QTI_CAMERA_SYNC && QTI_CAMERA_SMMU && QTI_CAMERA_CRM)
        help
	  Say Y here to enable selecting module
          Support for the Sensors and Actuator etc

	if QTI_SENSORS
		config QTI_EEPROM
			bool "Camera EEPROM driver"
			default y
			help
			  Say Y here to enable selecting module
			  Support for the Camera eeprom driver

		config QTI_ACTUATOR
			bool "Camera Actuator driver"
			default n
			help
			  Say Y here to enable selecting module
			  Support for the Camera actuator driver

		config QTI_FLASH
			bool "Camera FLASH driver"
			default n
			help
			  Say Y here to enable selecting module
			  Support for the Camera Flash driver

		config QTI_IR_LED
			bool "Camera IR Led driver"
			default n
			help
			  Say Y here to enable selecting module
			  Support for the Camera Infrared Led driver

		choice
			prompt "Select interface"
			help
			  Select physical interface for real devices or Virtual
			  interface and dummy devices

			config QTI_PHY_IO
				bool "I2C, CCI or SPI interface"
				help
				  Use real devices attached on I2C/CCI or SPI physical interface.

			config QTI_VIRT_IO
				bool "Virtual interface"
				help
				  Use Virtual interface for dummy devices.
				  This driver not return data or acknowledge.
				  May be useful for diagnostic purposes.
		endchoice

		if (QTI_VIRT_IO)
			config QTI_FSENSOR_ADDR
				hex "Front Sensor ID register"
				range 0x0 0xFFFF
				default "0x300b"
				help
				  The address of register contains the sensor id.
				  This value will used for virtual device matching.

			config QTI_FSENSOR_DATA
				hex "Front Sensor ID"
				range 0x0 0xFFFF
				default "0x5675"
				help
				  The value in ID register
				  This value will used for virtual device matching.

			if (QTI_FSENSOR_ADDR != 0)
				config QTI_FSENSOR_ID
					hex "Sensor Slave address"
					range 0x0 0xFF
					default "0x6c"
					help
					  The Sensor address on CCI/I2C bus
					  This value will used for virtual device matching.
			endif

			config QTI_RSENSOR_ADDR
				hex "Rear Sensor ID register"
				range 0x0 0xFFFF
				default "0x300b"
				help
				  The address of register contains the sensor id
				  This value will used for virtual device matching.

			config QTI_RSENSOR_DATA
				hex "Rear Sensor ID"
				range 0x0 0xFFFF
				default "0x885a"
				help
				  The value in ID register
				  This value will used for virtual device matching.

			if (QTI_RSENSOR_ADDR != 0)
				config QTI_RSENSOR_ID
					hex "Sensor Slave address"
					range 0x0 0xFF
					default "0x20"
					help
					  The Sensor address on CCI/I2C bus
					  This value will used for virtual device matching.
			endif
		endif

		if (QTI_PHY_IO || QTI_VIRT_IO)
			config QTI_CCI
				bool "Qualcomm CCI driver"
				default y
				help
				  Say Y here to enable selecting module
				  Support for the synchronous QUP based I2C interface

			config QTI_I2C
				bool "Qualcomm I2C driver"
				default y
				help
				  Say Y here to enable selecting module
				  Support for the synchronous GENI based I2C interface

			config QTI_SPI
				bool "Qualcomm SPI_GENI driver"
				default y
				help
				  Say Y here to enable selecting module
				  Support for the GENI based Serial Peripheral Interface
		endif

	endif

endif
```

## kernel-chromebook-5.4/drivers/pkglist/Kconfig
```kconfig
config PKGLIST
	tristate "Package list for emulated 'SD card' file system for Android"
	depends on CONFIGFS_FS || !CONFIGFS_FS
	help
	  Pkglist presents an interface for Android's emulated sdcard layer.
	  It relates the names of packages to their package ids, so that they can be
	  given access to their app specific folders.

	  Additionally, pkglist allows configuring the gid assigned to the lower file
	  outside of package specific directories for the purpose of tracking storage
	  with quotas.

choice
	prompt "Configuration options"
	depends on PKGLIST
	help
	  Configuration options. This controls how you provide the emulated
	  SD card layer with configuration information from userspace.

config PKGLIST_USE_CONFIGFS
	bool "Use Configfs based pkglist"
	depends on CONFIGFS_FS
	help
	  Use configfs based pkglist driver for configuration information.

config PKGLIST_NO_CONFIG
	bool "None"
	help
	  This does not allow configuration of sdcardfs.
endchoice
```

## kernel-chromebook-5.4/headers/drivers/iio/common/cros_ec_sensors/Kconfig
```kconfig
# SPDX-License-Identifier: GPL-2.0-only
#
# Chrome OS Embedded Controller managed sensors library
#
config IIO_CROS_EC_SENSORS_CORE
	tristate "ChromeOS EC Sensors Core"
	depends on SYSFS && CROS_EC_SENSORHUB
	select IIO_BUFFER
	select IIO_TRIGGERED_BUFFER
	help
	  Base module for the ChromeOS EC Sensors module.
	  Contains core functions used by other IIO CrosEC sensor
	  drivers.
	  Define common attributes and sysfs interrupt handler.

config IIO_CROS_EC_SENSORS
	tristate "ChromeOS EC Contiguous Sensors"
	depends on IIO_CROS_EC_SENSORS_CORE
	help
	  Module to handle 3d contiguous sensors like
	  Accelerometers, Gyroscope and Magnetometer that are
	  presented by the ChromeOS EC Sensor hub.
	  Creates an IIO device for each functions.

config IIO_CROS_EC_SENSORS_LID_ANGLE
	tristate "ChromeOS EC Sensor for lid angle"
	depends on IIO_CROS_EC_SENSORS_CORE
	help
	  Module to report the angle between lid and base for some
	  convertible devices.
	  This module is loaded when the EC can calculate the angle between the base
	  and the lid.

config IIO_CROS_EC_ACTIVITY
	tristate "ChromeOS EC Activity Sensors"
	depends on IIO_CROS_EC_SENSORS_CORE
	help
	  Module to handle activity events detections presented by the ChromeOS
	  EC Sensor hub.
	  Activities can be simple (low/no motion) or more complex (riding train).
	  They are being reported by physical devices or the EC itself.
	  Creates an IIO device to manage all activities.

config IIO_CROS_EC_SENSORS_RING
	tristate "ChromeOS EC Sensors Ring"
	depends on IIO_CROS_EC_SENSORS || IIO_CROS_EC_LIGHT_PROX
	depends on MFD_CROS_EC_DEV
	help
	  Add support for handling sensor events FIFO produced by
	  the sensor hub.
	  A single device with a buffer will collect all samples produced
	  by the sensors managed by the CroEC sensor hub.

config IIO_CROS_EC_SENSORS_SYNC
	tristate "ChromeOS EC Counter Sensors"
	depends on IIO_CROS_EC_SENSORS_CORE
	help
	  Module to handle synchronisation sensors presented by the ChromeOS EC
	  Sensor hub.
	  Synchronisation sensors are counter sensors that are triggered when
	  events occurs from other subsystems. They are use to synchronised
	  those subsystem with existing MEMS sensors, like gyroscope.
```

## kernel-chromebook/Documentation/devicetree/bindings/display/panel/innolux,p079zca.txt
```
Innolux P079ZCA 7.85" 768x1024 TFT LCD panel
Innolux P097PFG 9.7" 1536x2048 TFT LCD panel

Required properties:
- compatible: should be one of the following.
    -"innolux,p079zca" for Innolux 7.9" P079ZCA 768*1024 panel
    -"innolux,p097pfg" for Innolux 9.7" P097PFG 1536*2048 panel
- reg: DSI virtual channel of the peripheral
- enable-gpios: panel enable gpio

Optional properties:
- backlight: phandle of the backlight device attached to the panel
- power-supply: phandle of the regulator that provides the supply voltage
- avdd-supply: phandle of the regulator that provides positive voltage
- avee-supply: phandle of the regulator that provides negative voltage

Example:

	&mipi_dsi {
		panel {
			compatible = "innolux,p079zca";
			reg = <0>;
			power-supply = <...>;
			avdd-supply = <...>;
			avee-supply = <...>;
			backlight = <&backlight>;
			enable-gpios = <&gpio1 13 GPIO_ACTIVE_HIGH>;
			status = "okay";
		};
	};
```

## kernel-chromebook/Documentation/devicetree/bindings/iio/proximity/sx932x.txt
```
Semtech's SX9320/SX9321 capacitive proximity button device driver

Required properties:
	- compatible: must be "semtech,sx9320 or sx9321"
	- reg: i2c address where to find the device
	- interrupt-parent : should be the phandle for the interrupt controller
	- interrupts : the sole interrupt generated by the device

	Refer to interrupt-controller/interrupts.txt for generic
	interrupt client node bindings.

Example:

sx9310@28 {
	compatible = "semtech,sx9320";
	reg = <0x28>;
	interrupt-parent = <&gpio2>;
	interrupts = <16 IRQ_TYPE_LEVEL_LOW>;
};

Driver supports ACPI bindings. We can store registers configuration obtained
from per-model SAR sensor calibration. Refer to the data sheet for meaning.

ACPI name is STH9320 or STH9321.

Example:
    chip drivers/i2c/generic
            register "hid" = ""STH9321""
            register "name" = ""SEMTECH SX9321""
            register "desc" = ""SAR Proximity Sensor""
            register "irq" = "ACPI_IRQ_LEVEL_LOW(GPP_A18_IRQ)"
            register "device_present_gpio" = "GPP_B20"
            device i2c 28 on end
    end
```

## kernel-chromebook/Documentation/devicetree/bindings/media/i2c/dongwoon,dw9714.txt
```
Dongwoon Anatech DW9714 voice coil lens driver

DW9174 is a 10-bit DAC with current sink capability. It is intended for
controlling voice coil lenses.

Mandatory properties:

- compatible: "dongwoon,dw9714"
- reg: I²C slave address
```
