// SPDX-License-Identifier: GPL-2.0
/*
 * Google Kukui (and derivatives) da7219-rt1015 sound card.
 *
 * Copyright 2020 Google LLC.
 */

#include "mt8183-kukui-audio-da7219.dtsi"
#include "mt8183-kukui-audio-rt1015.dtsi"

&sound {
	compatible = "mediatek,mt8183_da7219_rt1015";
};
