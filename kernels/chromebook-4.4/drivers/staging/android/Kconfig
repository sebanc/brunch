## kernels/chromebook-5.4/drivers/mtd/spi-nor/Kconfig
```kconfig
# SPDX-License-Identifier: GPL-2.0-only
menuconfig MTD_SPI_NOR
	tristate "SPI-NOR device support"
	depends on MTD
	depends on MTD && SPI_MASTER
	select SPI_MEM
	help
	  This is the framework for the SPI NOR which can be used by the SPI
	  device drivers and the SPI-NOR device driver.

if MTD_SPI_NOR

config MTD_SPI_NOR_USE_4K_SECTORS
	bool "Use small 4096 B erase sectors"
	default y
	help
	  Many flash memories support erasing small (4096 B) sectors. Depending
	  on the usage this feature may provide performance gain in comparison
	  to erasing whole blocks (32/64 KiB).
	  Changing a small part of the flash's contents is usually faster with
	  small sectors. On the other hand erasing should be faster when using
	  64 KiB block instead of 16 × 4 KiB sectors.

	  Please note that some tools/drivers/filesystems may not work with
	  4096 B erase size (e.g. UBIFS requires 15 KiB as a minimum).
choice
	prompt "Software write protection at boot"
	default MTD_SPI_NOR_SWP_DISABLE_ON_VOLATILE

config MTD_SPI_NOR_SWP_DISABLE
	bool "Disable SWP on any flashes (legacy behavior)"
	help
	  This option disables the software write protection on any SPI
	  flashes at boot-up.

	  Depending on the flash chip this either clears the block protection
	  bits or does a "Global Unprotect" command.

	  Don't use this if you intent to use the software write protection
	  of your SPI flash. This is only to keep backwards compatibility.

config MTD_SPI_NOR_SWP_DISABLE_ON_VOLATILE
	bool "Disable SWP on flashes w/ volatile protection bits"
	help
	  Some SPI flashes have volatile block protection bits, ie. after a
	  power-up or a reset the flash is software write protected by
	  default.

	  This option disables the software write protection for these kind
	  of flashes while keeping it enabled for any other SPI flashes
	  which have non-volatile write protection bits.

	  If the software write protection will be disabled depending on
	  the flash either the block protection bits are cleared or a
	  "Global Unprotect" command is issued.

	  If you are unsure, select this option.

config MTD_SPI_NOR_SWP_KEEP
	bool "Keep software write protection as is"
	help
	  If you select this option the software write protection of any
	  SPI flashes will not be changed. If your flash is software write
	  protected or will be automatically software write protected after
	  power-up you have to manually unlock it before you are able to
	  write to it.

endchoice

config SPI_ASPEED_SMC
	tristate "Aspeed flash controllers in SPI mode"
	depends on ARCH_ASPEED || COMPILE_TEST
	depends on HAS_IOMEM && OF
	help
	  This enables support for the Firmware Memory controller (FMC)
	  in the Aspeed AST2500/AST2400 SoCs when attached to SPI NOR chips,
	  and support for the SPI flash memory controller (SPI) for
	  the host firmware. The implementation only supports SPI NOR.

config SPI_CADENCE_QUADSPI
	tristate "Cadence Quad SPI controller"
	depends on OF && (ARM || ARM64 || COMPILE_TEST)
	help
	  Enable support for the Cadence Quad SPI Flash controller.

	  Cadence QSPI is a specialized controller for connecting an SPI
	  Flash over 1/2/4-bit wide bus. Enable this option if you have a
	  device with a Cadence QSPI controller and want to access the
	  Flash as an MTD device.

config SPI_HISI_SFC
	tristate "Hisilicon SPI-NOR Flash Controller(SFC)"
	depends on ARCH_HISI || COMPILE_TEST
	depends on HAS_IOMEM
	help
	  This enables support for hisilicon SPI-NOR flash controller.

config SPI_MTK_QUADSPI
	tristate "MediaTek Quad SPI controller"
	depends on HAS_IOMEM
	help
	  This enables support for the Quad SPI controller in master mode.
	  This controller does not support generic SPI. It only supports
	  SPI NOR.

config SPI_NXP_SPIFI
	tristate "NXP SPI Flash Interface (SPIFI)"
	depends on OF && (ARCH_LPC18XX || COMPILE_TEST)
	depends on HAS_IOMEM
	help
	  Enable support for the NXP LPC SPI Flash Interface controller.

	  SPIFI is a specialized controller for connecting serial SPI
	  Flash. Enable this option if you have a device with a SPIFI
	  controller and want to access the Flash as a mtd device.

config SPI_INTEL_SPI
	tristate

config SPI_INTEL_SPI_PCI
	tristate "Intel PCH/PCU SPI flash PCI driver (DANGEROUS)"
	depends on X86 && PCI
	select SPI_INTEL_SPI
	help
	  This enables PCI support for the Intel PCH/PCU SPI controller in
	  master mode. This controller is present in modern Intel hardware
	  and is used to hold BIOS and other persistent settings. Using
	  this driver it is possible to upgrade BIOS directly from Linux.

	  Say N here unless you know what you are doing. Overwriting the
	  SPI flash may render the system unbootable.

	  To compile this driver as a module, choose M here: the module
	  will be called intel-spi-pci.

config SPI_INTEL_SPI_PLATFORM
	tristate "Intel PCH/PCU SPI flash platform driver (DANGEROUS)"
	depends on X86
	select SPI_INTEL_SPI
	help
	  This enables platform support for the Intel PCH/PCU SPI
	  controller in master mode. This controller is present in modern
	  Intel hardware and is used to hold BIOS and other persistent
	  settings. Using this driver it is possible to upgrade BIOS
	  directly from Linux.

	  Say N here unless you know what you are doing. Overwriting the
	  SPI flash may render the system unbootable.

	  To compile this driver as a module, choose M here: the module
	  will be called intel-spi-platform.

endif # MTD_SPI_NOR
```

## kernels/chromebook-5.4/headers/drivers/media/platform/camx/cam_lrme/Kconfig
```kconfig
config QTI_LRME
	bool "Qualcomm LRME driver"
	default n
	depends on (QTI_CAMERA_SYNC && QTI_CAMERA_SMMU && QTI_CAMERA_CRM)
	help
	  Say Y here to enable selecting module
	  Support for the LRME engine
```

## kernels/chromebook-5.4/headers/drivers/media/platform/camx/cam_sensor_module/cam_sensor_io/Kconfig
```kconfig
config QTI_CCI
	bool "Qualcomm CCI driver"
	default y
	help
	  Say Y here to enable selecting module
	  Support for the synchronous QUP based I2C interface

config QTI_I2C
	bool "Qualcomm I2C driver"
	default y
	help
	  Say Y here to enable selecting module
	  Support for the synchronous GENI based I2C interface

config QTI_SPI
	bool "Qualcomm SPI_GENI driver"
	default y
	help
	  Say Y here to enable selecting module
	  Support for the GENI based Serial Peripheral Interface
```

## kernels/kernel-4.19/Documentation/devicetree/bindings/media/i2c/ov8856.txt
```
* Omnivision OV8856 MIPI CSI-2 sensor

Required Properties:
- compatible: Shall be "ovti,ov8856"
- reg: I2C bus address of the device. Depending on how the sensor is wired,
       it shall be <0x10>.
- clocks: Reference to the xvclk input clock.
- clock-names: Shall be "xvclk".
- clock-frequency: Frequency of the xclk clock.
- dovdd-supply: Digital I/O voltage supply, 1.8 volts
- avdd-supply: Analog voltage supply, 2.8 volts
- dvdd-supply: Digital core voltage supply, 1.5 volts
- reset-gpios: High active reset gpio

The device node shall contain one 'port' child node with
an 'endpoint' subnode. For further reading on port node refer to
Documentation/devicetree/bindings/media/video-interfaces.txt.

Required Properties on endpoint:
- data-lanes: check ../video-interfaces.txt
- link-frequencies: check ../video-interfaces.txt
- remote-endpoint: check ../video-interfaces.txt

Example:

&i2c1 {
	ov8856: camera-sensor@10 {
		compatible = "ovti,ov8856";
		reg = <0x10>;
		pinctrl-names = "default";
		pinctrl-0 = <&clk_24m_cam>;

		clocks = <&cru SCLK_TESTCLKOUT1>;
		clock-names = "xvclk";
		clock-frequency = <19200000>;

		avdd-supply = <&mt6358_vcama2_reg>;
		dvdd-supply = <&mt6358_vcamd_reg>;
		dovdd-supply = <&mt6358_vcamio_reg>;
		reset-gpios = <&pio 111 GPIO_ACTIVE_HIGH>;

		port {
			/* MIPI CSI-2 bus endpoint */
			wcam_out: endpoint {
				remote-endpoint = <&mipi_in_wcam>;
				data-lanes = <1 2 3 4>;
				link-frequencies = /bits/ 64 <360000000 180000000>;
			};
		};
	};
};
```

## kernels/kernel-4.19/Documentation/devicetree/bindings/power/mtk-svs.txt
```
* Mediatek Smart Voltage Scaling (MTK SVS)

This describes the device tree binding for the MTK SVS controller (bank)
which helps provide the optimized CPU/GPU/CCI voltages. This device also
needs thermal data to calculate thermal slope for accurately compensate
the voltages when temperature change.

Required properties:
- compatible:
  - "mediatek,mt8183-svs" : For MT8183 family of SoCs
- reg: Address range of the MTK SVS controller.
- interrupts: IRQ for the MTK SVS controller.
- clocks, clock-names: Clocks needed for the svs controller. required
                       clocks are:
		       "main_clk": Main clock needed for register access
- nvmem-cells: Phandle to the calibration data provided by a nvmem device.
- nvmem-cell-names: Should be "svs-calibration-data" and "calibration-data"

Subnodes:
- svs_cpu_little: SVS bank device node of little CPU
  compatible: "mediatek,mt8183-svs-cpu-little"
  operating-points-v2: OPP table hooked by SVS little CPU bank.
		       SVS will optimze this OPP table voltage part.
  vcpu-little-supply: PMIC buck of little CPU
- svs_cpu_big: SVS bank device node of big CPU
  compatible: "mediatek,mt8183-svs-cpu-big"
  operating-points-v2: OPP table hooked by SVS big CPU bank.
		       SVS will optimze this OPP table voltage part.
  vcpu-big-supply: PMIC buck of big CPU
- svs_cci: SVS bank device node of CCI
  compatible: "mediatek,mt8183-svs-cci"
  operating-points-v2: OPP table hooked by SVS CCI bank.
		       SVS will optimze this OPP table voltage part.
  vcci-supply: PMIC buck of CCI
- svs_gpu: SVS bank device node of GPU
  compatible: "mediatek,mt8183-svs-gpu"
  operating-points-v2: OPP table hooked by SVS GPU bank.
		       SVS will optimze this OPP table voltage part.
  vgpu-spply: PMIC buck of GPU

Example:

	svs: svs@1100b000 {
		compatible = "mediatek,mt8183-svs";
		reg = <0 0x1100b000 0 0x1000>;
		interrupts = <GIC_SPI 127 IRQ_TYPE_LEVEL_LOW 0>;
		clocks = <&infracfg CLK_INFRA_THERM>;
		clock-names = "main_clk";
		nvmem-cells = <&svs_calibration>, <&thermal_calibration>;
		nvmem-cell-names = "svs-calibration-data", "calibration-data";

		svs_cpu_little: svs_cpu_little {
			compatible = "mediatek,mt8183-svs-cpu-little";
			operating-points-v2 = <&cluster0_opp>;
		};

		svs_cpu_big: svs_cpu_big {
			compatible = "mediatek,mt8183-svs-cpu-big";
			operating-points-v2 = <&cluster1_opp>;
		};

		svs_cci: svs_cci {
			compatible = "mediatek,mt8183-svs-cci";
			operating-points-v2 = <&cci_opp>;
		};

		svs_gpu: svs_gpu {
			compatible = "mediatek,mt8183-svs-gpu";
			power-domains = <&scpsys MT8183_POWER_DOMAIN_MFG_2D>;
			operating-points-v2 = <&gpu_opp_table>;
		};
	};

	&svs_cpu_little {
		vcpu-little-supply = <&mt6358_vproc12_reg>;
	};

	&svs_cpu_big {
		vcpu-big-supply = <&mt6358_vproc11_reg>;
	};

	&svs_cci {
		vcci-supply = <&mt6358_vproc12_reg>;
	};

	&svs_gpu {
		vgpu-spply = <&mt6358_vgpu_reg>;
	};
```

## kernels/kernel-5.10/fs/esdfs/Kconfig
```kconfig
config ESD_FS
	tristate "Emulated 'SD card' file system for Android (EXPERIMENTAL)"
	depends on PKGLIST
	depends on USER_NS
	help
	  Esdfs is a wrapfs-based file system, designed to implement the
	  Android "sdcard" FUSE-backed file system from within the kernel.
```

## kernels/kernel-5.10/fs/incfs/Kconfig
```kconfig
config INCREMENTAL_FS
	tristate "Incremental file system support"
	depends on BLOCK
	depends on X86 || ARM64_4K_PAGES
	select DECOMPRESS_LZ4
	select DECOMPRESS_ZSTD
	select CRYPTO_SHA256
	help
	  Incremental FS is a read-only virtual file system that facilitates execution
	  of programs while their binaries are still being lazily downloaded over the
	  network, USB or pigeon post.

	  To compile this file system support as a module, choose M here: the
	  module will be called incrementalfs.
```

## kernels/kernel-chromebook-4.4/Documentation/devicetree/bindings/drm/bridge/anx7688.txt
```
Analogix ANX7688 SlimPort (Single-Chip Transmitter for DP over USB-C)
---------------------------------------------------------------------

The ANX7688 is a single-chip mobile transmitter to support 4K 60 frames per
second (4096x2160p60) or FHD 120 frames per second (1920x1080p120) video
resolution from a smartphone or tablet with full function USB-C.

This binding only describes the HDMI to DP display bridge.

Required properties:

 - compatible          : "analogix,anx7688"
 - reg                 : I2C address of the device (fixed at 0x2c)

Optional properties:

 - Video port for HDMI input, using the DT bindings defined in [1].

[1]: Documentation/devicetree/bindings/media/video-interfaces.txt

Example:

	anx7688: anx7688@2c {
		compatible = "analogix,anx7688";
		reg = <0x2c>;

		port {
			anx7688_in: endpoint {
				remote-endpoint = <&hdmi0_out>;
			};
		};
	};
```

## kernels/kernel-chromebook-4.4/Documentation/devicetree/bindings/leds/backlight/pwm-backlight.txt
```
pwm-backlight bindings

Required properties:
  - compatible: "pwm-backlight"
  - pwms: OF device-tree PWM specification (see PWM binding[0])
  - brightness-levels: Array of distinct brightness levels. Typically these
      are in the range from 0 to 255, but any range starting at 0 will do.
      The actual brightness level (PWM duty cycle) will be interpolated
      from these values. 0 means a 0% duty cycle (darkest/off), while the
      last value in the array represents a 100% duty cycle (brightest).
  - default-brightness-level: the default brightness level (index into the
      array defined by the "brightness-levels" property)
  - power-supply: regulator for supply voltage

Optional properties:
  - pwm-names: a list of names for the PWM devices specified in the
               "pwms" property (see PWM binding[0])
  - enable-gpios: contains a single GPIO specifier for the GPIO which enables
                  and disables the backlight (see GPIO binding[1])
  - pwm-delay-us: delay between setting an initial (non-zero) PWM value and
                  enabling the backlight, and also the delay between disabling
                  the backlight and setting PWM value to 0.
  - brightness-levels-scale: this can be used instead of 'brightness-levels',
                             to describe a linear range of brightness levels.
                             So rather than specifying 'brightness-levels = <0
                             1 2 ... 65535>', one can simply say
                             'brightness-levels-scale = <0x10000>'. Note:
                             upstream maintainers haven't liked this sort of
                             property, since they'd prefer we describe the
                             levels in terms of a curve (e.g., parabolic) to
                             represent perceived luminance (?), but we've
                             always exposed the linear range instead, so rather
                             than unnecessarily bloating device trees, let's do
                             the simple thing.

[0]: Documentation/devicetree/bindings/pwm/pwm.txt
[1]: Documentation/devicetree/bindings/gpio/gpio.txt

Example:

	backlight {
		compatible = "pwm-backlight";
		pwms = <&pwm 0 5000000>;
		brightness-levels = <0 4 8 16 32 64 128 255>;
		default-brightness-level = <6>;
		power-supply = <&vdd_bl_reg>;
		enable-gpios = <&gpio 58 0>;
		pwm-delay-us = <10000>;
	};
```
