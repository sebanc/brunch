## external-drivers/backport-iwlwifi-core56/drivers/net/wireless/intel/iwlwifi/Kconfig.noupstream
```kconfig
config IWLXVT
	tristate "Enable XVT op_mode"
	depends on IWLWIFI
	select IWLWIFI_DEVICE_TESTMODE
	select IWLWIFI_SUPPORT_DEBUG_OVERRIDES
	help
	  This option enables the xVT operation mode. xVT mode supports
	  special debug and testing operations that are not supported in
	  the standard operation modes, and is used for verification
	  purposes.
	  xVT mode does not support the standard WiFi operations, and
	  does not communicate with the user mode through the nl80211.

	  Enabling this options allows to fully control the HW using
	  an external tool in user space.

	  Say Y if you have the user space application and want
	  to execute debug and testing flows on the HW.

config IWLWIFI_NUM_CHANNELS
	int "number of supported concurrent channels"
	range 1 2
	default 2
	depends on IWLMVM

config IWLWIFI_THERMAL_DEBUGFS
	bool "enable thermal debug write and read support"
	depends on IWLWIFI_DEBUGFS
	default y
	help
	  Enable thermal settings debugfs entries that can be used to change
	  the temperatures and other parameters for testing, This code isn't
	  intended for upstream, hence the config option. You shouldn't turn it off.

config IWLWIFI_DEVICE_TESTMODE
	bool "enable generic netlink testmode support"
	depends on IWLWIFI
	default y if IWLMVM
	select IWLWIFI_SUPPORT_DEBUG_OVERRIDES

config IWLWIFI_SUPPORT_DEBUG_OVERRIDES
	depends on IWLWIFI
	bool "enable default value override (for debugging)"

config IWLWIFI_FORCE_OFDM_RATE
	bool "force transmit to OFDM low rate"
	depends on IWLMVM
	help
	  This option force the FW to transmit OFDM rate.

	  If unsure say N, Say Y if you have this code and want to transmit OFDM low rate.

config IWLMVM_P2P_OPPPS_TEST_WA
	bool "Use WA to pass P2P OPPPS certification test"
	depends on IWLMVM
	---help---
	  This option enables a WA to pass P2P OPPPS certification test.
	  This test verifies P2P client power management behavior when
	  connected to P2P GO that advertises OPPPS. Since P2P client power
	  management is not supported currently by FW a special WA is required.
	  Send zeroed quota on P2P client MAC if power save is enabled from
	  user space to mimic power management behavior. Update quota to normal
	  value otherwise.

config IWLMVM_VENDOR_CMDS
	bool "enable vendor commands"
	depends on IWLMVM
	default y
	help
	  This option enables support for vendor commands, including some
	  that don't have their own Kconfig option. Other Kconfig options
	  depend on this one as well.

	  This option mostly exists for non-upstream tagging, so best
	  leave it set to Y.

config IWLMVM_VENDOR_TCM_EVENTS
	bool "enable TCM vendor events"
	depends on IWLMVM_VENDOR_CMDS
	default y
	help
	  This option enables vendor TCM events to userspace that can
	  be used to adjust certain parameters depending on the
	  traffic conditions.  These events can become rather noisy
	  with standard wpa_supplicant, since it prints out 3 debug
	  messages every time the event is received (as an unknown
	  event).  When used with standard wpa_supplicant, it is
	  recommended to disable this option.

config IWLMVM_TDLS_PEER_CACHE
	bool "enable TDLS peer caching and traffic monitoring"
	depends on IWLMVM_VENDOR_CMDS
	default y
	help
	  This option enables (vendor) commands from userspace to monitor
	  traffic to and from specific peers on the same BSS. These peers
	  might be TDLS peers, or candidates to become such.

config IWLWIFI_DISALLOW_OLDER_FW
	bool "disallow fallback to older firmware images"
	depends on IWLWIFI
	help
	  This Kconfig option allows disabling fallback to older firmware images
	  to ensure tight coupling between driver and firmware releases. When
	  enabled, the dbg-cfg framework can still override this setting.

config IWLWIFI_NUM_STA_INTERFACES
	int "number of supported concurrent station interfaces"
	range 1 2
	default 1
	depends on IWLMVM

config REJECT_NONUPSTREAM_NL80211
	bool "reject non-upstreamed nl80211 commands"
	depends on CFG80211
	help
	  Say Y to disable non-upstream commands.
```

## external-drivers/backport-iwlwifi-core64/Kconfig.sources
```kconfig
# this has the configuration for the backport code
source "$BACKPORT_DIR/compat/Kconfig"

# these are copied from the kernel
source "$BACKPORT_DIR/net/wireless/Kconfig"
source "$BACKPORT_DIR/net/mac80211/Kconfig"
source "$BACKPORT_DIR/drivers/net/wireless/Kconfig"
#source "$BACKPORT_DIR/drivers/net/usb/Kconfig"

#source "$BACKPORT_DIR/drivers/ssb/Kconfig"
#source "$BACKPORT_DIR/drivers/bcma/Kconfig"

#source "$BACKPORT_DIR/drivers/usb/class/Kconfig"

#source "$BACKPORT_DIR/drivers/staging/Kconfig"
```

## external-drivers/backport-iwlwifi-core76/drivers/net/wireless/Kconfig
```kconfig
# SPDX-License-Identifier: GPL-2.0-only
#
# Wireless LAN device configuration
#

menuconfig WLAN
	bool "Wireless LAN"
	depends on !S390
	depends on NET
	select WIRELESS
	default y
	help
	  This section contains all the pre 802.11 and 802.11 wireless
	  device drivers. For a complete list of drivers and documentation
	  on them refer to the wireless wiki:

	  https://wireless.wiki.kernel.org/en/users/Drivers

if WLAN

#source "drivers/net/wireless/admtek/Kconfig"
#source "drivers/net/wireless/ath/Kconfig"
#source "drivers/net/wireless/atmel/Kconfig"
#source "drivers/net/wireless/broadcom/Kconfig"
#source "drivers/net/wireless/cisco/Kconfig"
source "drivers/net/wireless/intel/Kconfig"
#source "drivers/net/wireless/intersil/Kconfig"
#source "drivers/net/wireless/marvell/Kconfig"
#source "drivers/net/wireless/mediatek/Kconfig"
#source "drivers/net/wireless/microchip/Kconfig"
#source "drivers/net/wireless/purelifi/Kconfig"
#source "drivers/net/wireless/ralink/Kconfig"
#source "drivers/net/wireless/realtek/Kconfig"
#source "drivers/net/wireless/rsi/Kconfig"
#source "drivers/net/wireless/silabs/Kconfig"
#source "drivers/net/wireless/st/Kconfig"
#source "drivers/net/wireless/ti/Kconfig"
#source "drivers/net/wireless/zydas/Kconfig"
#source "drivers/net/wireless/quantenna/Kconfig"

config PCMCIA_RAYCS
	depends on n
	tristate "Aviator/Raytheon 2.4GHz wireless support"
	depends on m
	depends on PCMCIA
	depends on WIRELESS_EXT
	depends on WEXT_SPY
	depends on WEXT_PRIV
	help
	  Say Y here if you intend to attach an Aviator/Raytheon PCMCIA
	  (PC-card) wireless Ethernet networking card to your computer.
	  Please read the file
	  <file:Documentation/networking/device_drivers/wifi/ray_cs.rst> for
	  details.

	  To compile this driver as a module, choose M here: the module will be
	  called ray_cs.  If unsure, say N.

config PCMCIA_WL3501
	depends on n
	tristate "Planet WL3501 PCMCIA cards"
	depends on m
	depends on CFG80211 && PCMCIA
	depends on WIRELESS_EXT
	depends on WEXT_SPY
	help
	  A driver for WL3501 PCMCIA 802.11 wireless cards made by Planet.
	  It has basic support for Linux wireless extensions and initial
	  micro support for ethtool.

config MAC80211_HWSIM
	tristate "Simulated radio testing tool for mac80211"
	depends on m
	depends on MAC80211
	depends on !KERNEL_4_12
	help
	  This driver is a developer testing tool that can be used to test
	  IEEE 802.11 networking stack (mac80211) functionality. This is not
	  needed for normal wireless LAN usage and is only for testing. See
	  Documentation/networking/mac80211_hwsim for more information on how
	  to use this tool.

	  To compile this driver as a module, choose M here: the module will be
	  called mac80211_hwsim.  If unsure, say N.

config USB_NET_RNDIS_WLAN
	depends on !KERNEL_4_6
	depends on n
	tristate "Wireless RNDIS USB support"
	depends on m
	depends on USB
	depends on CFG80211
	depends on USB_NET_DRIVERS
	depends on USB_USBNET
	depends on USB_NET_CDCETHER
	depends on USB_NET_RNDIS_HOST
	help
	  This is a driver for wireless RNDIS devices.
	  These are USB based adapters found in devices such as:

	  Buffalo WLI-U2-KG125S
	  U.S. Robotics USR5421
	  Belkin F5D7051
	  Linksys WUSB54GSv2
	  Linksys WUSB54GSC
	  Asus WL169gE
	  Eminent EM4045
	  BT Voyager 1055
	  Linksys WUSB54GSv1
	  U.S. Robotics USR5420
	  BUFFALO WLI-USB-G54

	  All of these devices are based on Broadcom 4320 chip which is the
	  only wireless RNDIS chip known to date.

	  If you choose to build a module, it'll be called rndis_wlan.

config VIRT_WIFI
	depends on n
	tristate "Wifi wrapper for ethernet drivers"
	depends on m
	depends on CFG80211
	help
	  This option adds support for ethernet connections to appear as if they
	  are wifi connections through a special rtnetlink device.

endif # WLAN
```

## external-drivers/backport-iwlwifi-core79/compat/Kconfig
```kconfig
#
# backport Kconfig
#
# Some options are user-selectable ("BPAUTO_USERSEL_*")
#
# Most options, however, follow a few different schemes:
#
# A) An option that is selected by drivers ("select FOO") will be
#    changed to "select BPAUTO_FOO" (if the option BPAUTO_FOO
#    exists). The option BPAUTO_FOO then controls setting of the
#    BPAUTO_BUILD_FOO option, which is a module, like this:
#
# config BPAUTO_BUILD_FOO
#	tristate
#	# or bool
#
#	# not possible on kernel < X.Y, build will fail if any
#	# drivers are allowed to build on kernels < X.Y
#	depends on KERNEL_X_Y
#
#	# don't build the backport code if FOO is in the kernel
#	# already, but only if the kernel version is also >= X.Z;
#	# this is an example of backporting where the version of
#	# the FOO subsystem that we need is only available from
#	# kernel version X.Z
#	depends on !FOO || KERNEL_X_Z
#
#	# build if driver needs it (it selects BPAUTO_FOO)
#	default m if BPAUTO_FOO
#
#	# or for build-testing (BPAUTO_USERSEL_BUILD_ALL is enabled)
#	default m if BPAUTO_USERSEL_BUILD_ALL
#
# config BPAUTO_FOO
#	bool
#
# This only works as-is if the kernel code is usable on any version,
# otherwise the "&& !FOO" part needs to be different.
#
#
# B) An option for code always present on some kernels (e.g. KFIFO).
#    This simply depends on/sets the default based on the version:
#
# config BPAUTO_BUILD_KFIFO
#	def_bool y
#	depends on KERNEL_2_6_36
#
#
# C) similarly, a kconfig symbol for an option, e.g.
#    BPAUTO_OPTION_SOME_FIX (no examples provided) check git log
#
#
# Variations are obviously possible.
#

config BP_MODULES
	option modules
	bool
	default MODULES

	help
	This symbol is necessary for the newer kconf tool, it looks
	for the "option modules" to control the 'm' state.

config BPAUTO_BUILD_NLATTR
	def_bool y
	depends on KERNEL_5_2
	#c-file lib/nlattr.c

config BPAUTO_USERSEL_BUILD_ALL
	bool "Build all compat code"
	help
	  This option selects all the compat code options
	  that would otherwise only be selected by drivers.

	  It's only really useful for compat testing, so
	  you probably shouldn't enable it.

config BPAUTO_WANT_DEV_COREDUMP
	bool

config BPAUTO_RHASHTABLE
	bool
	# current API of rhashtable was introduced in version 4.9
	# (the one including rhltable)
	depends on KERNEL_4_9
	# not very nice - but better than always having it
	default y if BACKPORTED_MAC80211
	#h-file linux/rhashtable.h
	#h-file linux/rhashtable-types.h
	#c-file lib/rhashtable.c

config BPAUTO_BUCKET_LOCKS
	bool
	# the API of bucket_locks that we need was introduced in version 4.16
	depends on KERNEL_4_16
	default y if BPAUTO_RHASHTABLE
	#c-file lib/bucket_locks.c

config BPAUTO_REFCOUNT
	bool
	default y
	depends on KERNEL_4_11
	#h-file linux/refcount.h
	#c-file lib/refcount.c

config BPAUTO_SYSTEM_DATA_VERIFICATION
	bool

config BPAUTO_BUILD_SYSTEM_DATA_VERIFICATION
	bool
	default y if BPAUTO_SYSTEM_DATA_VERIFICATION
	depends on (KERNEL_4_7 || !SYSTEM_DATA_VERIFICATION) && CRYPTO_HASH_INFO
	select BPAUTO_ASN1_DECODER
	select BPAUTO_PUBLIC_KEY
	select BPAUTO_PKCS7
	#h-file linux/oid_registry.h
	#c-file lib/oid_registry.c

config BPAUTO_PUBLIC_KEY
	bool
	#h-file crypto/public_key.h

config BPAUTO_ASN1_DECODER
	bool
	#h-file linux/asn1_decoder.h
	#c-file lib/asn1_decoder.c

config BPAUTO_PKCS7
	bool
	#h-file crypto/pkcs7.h

config BPAUTO_CRYPTO_LIB_ARC4
	bool

config BPAUTO_BUILD_CRYPTO_LIB_ARC4
	bool
	default y if BPAUTO_CRYPTO_LIB_ARC4
	depends on !(CRYPTO_LIB_ARC4=y || CRYPTO_LIB_ARC4=m)
	#h-file crypto/arc4.h
	#c-file lib/crypto/arc4.c
```
