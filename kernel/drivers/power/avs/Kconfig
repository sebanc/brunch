## kernel/drivers/power/avs/Kconfig
```kconfig
# SPDX-License-Identifier: GPL-2.0-only
menuconfig POWER_AVS
	bool "Adaptive Voltage Scaling class support"
	help
	  AVS is a power management technique which finely controls the
	  operating voltage of a device in order to optimize (i.e. reduce)
	  its power consumption.
	  At a given operating point the voltage is adapted depending on
	  static factors (chip manufacturing process) and dynamic factors
	  (temperature depending performance).
	  AVS is also called SmartReflex on OMAP devices.

	  Say Y here to enable Adaptive Voltage Scaling class support.

config ROCKCHIP_IODOMAIN
        tristate "Rockchip IO domain support"
        depends on POWER_AVS && ARCH_ROCKCHIP && OF
        help
          Say y here to enable support io domains on Rockchip SoCs. It is
          necessary for the io domain setting of the SoC to match the
          voltage supplied by the regulators.

config MTK_SVS
	bool "MediaTek Smart Voltage Scaling(SVS)"
	depends on POWER_AVS && MTK_EFUSE
	depends on THERMAL = y || THERMAL = n
	help
	  The SVS engine is a piece of hardware which is used to calculate
	  optimized voltage values of several power domains, e.g.
	  CPU clusters/GPU/CCI, according to chip process corner, temperatures,
	  and other factors. Then DVFS driver could apply those optimized voltage
	  values to reduce power consumption.
```

## kernels/4.19/Documentation/devicetree/bindings/devfreq/rk3288_dmc.txt
```
* Rockchip rk3288 DMC (Dynamic Memory Controller) device

Required properties:
- compatible: "rockchip,rk3288-dmc", "syscon"
- rockchip,cru: this driver should access cru regs, so need get cru here
- rockchip,grf: this driver should access grf regs, so need get grf here
- rockchip,pmu: this driver should access pmu regs, so need get pmu here
- rockchip,service_bus: this driver should access service bus regs
- rockchip,sgrf: this driver should access sgrf regs, so need get sgrf here
- rockchip,sram: a handle to 16K of sram to use for ddr frequency changes.
- reg: dynamic ram protocol controller(PCTL) address and phy controller(PHYCTL)
       address
- clock: must include clock specifiers corresponding to entries in the
         clock-names property.
- clock-names: names of the clocks we need
    Must contain:
      pclk_ddrupctl0: support clock for access protocol controller registers
                      of channel 0
      pclk_publ0: support clock for access phy controller registers of channel 0
      pclk_ddrupctl1: support clock for access protocol controller registers
                      of channel 1
      pclk_publ1: support clock for access phy controller registers of channel 1
      arm_clk: for get arm frequency
- logic-supply: this driver should adjust VDD_LOGIC according to dmc frequency,
                so need get logic-supply here
- rockchip,odt-disable-freq: if ddr clock frequency low than odt-disable-freq,
                             this driver should disable DDR ODT
- rockchip,dll-disable-freq: if ddr clock frequency low than dll-disable-freq,
                             this driver should disable DDR DLL
- rockchip,sr-enable-freq: if ddr clock frequency high than sr-enable-freq,
                           this driver should enable the automatic self refresh
                           function
- rockchip,pd-enable-freq: if ddr clock frequency high than pd-enable-freq,
                           this driver should enable the automatic power down
                           function
- rockchip,auto-self-refresh-cnt: Self Refresh idle period. Memories are placed
                                  into Self-Refresh mode if the NIF is idle in
                                  Access state for:
                                     auto-self-refresh-cnt * 32 * n_clk cycles
                                  The automatic self refresh function is
                                  disabled when auto-self-refresh-cnt=0.
- rockchip,auto-power-down-cnt: Power-down idle period. Memories are placed
                                into power-down mode if the NIF is idle for
                                auto-power-down-cnt n_clk cycles. The
                                automatic power down function is disabled
                                when auto-power-down-cnt=0.
- rockchip,ddr-speed-bin: DDR3 type, AC timing parameters from the memory
                          data-sheet
        0.DDR3_800D (5-5-5)
        1.DDR3_800E (6-6-6)
        2.DDR3_1066E (6-6-6)
        3.DDR3_1066F (7-7-7)
        4.DDR3_1066G (8-8-8)
        5.DDR3_1333F (7-7-7)
        6.DDR3_1333G (8-8-8)
        7.DDR3_1333H (9-9-9)
        8.DDR3_1333J (10-10-10)
        9.DDR3_1600G (8-8-8)
        10.DDR3_1600H (9-9-9)
        11.DDR3_1600J (10-10-10)
        12.DDR3_1600K (11-11-11)
        13.DDR3_1866J (10-10-10)
        14.DDR3_1866K (11-11-11)
        15.DDR3_1866L (12-12-12)
        16.DDR3_1866M (13-13-13)
        17.DDR3_2133K (11-11-11)
        18.DDR3_2133L (12-12-12)
        19.DDR3_2133M (13-13-13)
        20.DDR3_2133N (14-14-14)
        21.DDR3_DEFAULT
      rockchip,trcd: tRCD,AC timing parameters from the memory data-sheet
      rockchip,trp: tRP,AC timing parameters from the memory data-sheet

Optional properties:
- rockchip,dmc-disable-freq: set ddr frequency to dmc-disable-freq when
  disable dmc
- #cooling-cells = <2>: to allow ddr frequency to help cool the device
  the two cells will be min and max.

Required sub-nodes:
- operating-points


Example:
	dmc: dmc@ff610000 {
		compatible = "rockchip,rk3288-dmc", "syscon";
		reg = <0x0 0xff610000 0x0 0x3fc
		       0x0 0xff620000 0x0 0x294
		       0x0 0xff630000 0x0 0x3fc
		       0x0 0xff640000 0x0 0x294>;
		rockchip,cru = <&cru>;
		rockchip,grf = <&grf>;
		rockchip,pmu = <&pmu>;
		rockchip,service_bus = <&service_bus>;
		rockchip,sgrf = <&sgrf>;
		rockchip,sram = <&ddr_sram>;
		clocks = <&cru PCLK_DDRUPCTL0>, <&cru PCLK_PUBL0>,
			 <&cru PCLK_DDRUPCTL1>, <&cru PCLK_PUBL1>,
			 <&cru ARMCLK>;
		clock-names = "pclk_ddrupctl0", "pclk_publ0",
			      "pclk_ddrupctl1", "pclk_publ1",
			      "arm_clk";
	};

	&dmc {
		logic-supply = <&vdd_logic>;

		rockchip,odt-disable-freq = <333000000>;
		rockchip,dll-disable-freq = <333000000>;
		rockchip,sr-enable-freq = <333000000>;
		rockchip,auto-self-refresh-cnt = <0>;
		rockchip,auto-power-down-cnt = <64>;
		rockchip,ddr-speed-bin = <21>;
		rockchip,trcd = <10>;
		rockchip,trp = <10>;

		rockchip,dmc-disable-freq = <433000000>;

		#cooling-cells = <2>;

		operating-points = <
			/* KHz    uV */
			200000 1050000
			333000 1100000
			433000 1125000
			533000 1150000
		>;
	};
```

## kernels/4.19/Documentation/devicetree/bindings/display/bridge/anx7625.yaml
```yaml
# SPDX-License-Identifier: (GPL-2.0 OR BSD-2-Clause)
# Copyright 2019 Analogix Semiconductor, Inc.
%YAML 1.2
---
$id: "http://devicetree.org/schemas/display/bridge/anx7625.yaml#"
$schema: "http://devicetree.org/meta-schemas/core.yaml#"

title: Analogix ANX7625 SlimPort (4K Mobile HD Transmitter)

maintainers:
  - Xin Ji <xji@analogixsemi.com>

description: |
  The ANX7625 is an ultra-low power 4K Mobile HD Transmitter
  designed for portable devices.

properties:
  "#address-cells": true
  "#size-cells": true

  compatible:
    items:
      - const: analogix,anx7625

  reg:
    maxItems: 1

  panel-flags:
    description: indicate the panel is internal or external.
    maxItems: 1

  interrupts:
    maxItems: 1

  enable-gpios:
    description: used for power on chip control, POWER_EN pin D2.
    maxItems: 1

  reset-gpios:
    description: used for reset chip control, RESET_N pin B7.
    maxItems: 1

  port@0:
    type: object
    description:
      A port node pointing to MIPI DSI host port node.

  port@1:
    type: object
    description:
      A port node pointing to MIPI DPI host port node.

  port@2:
    type: object
    description:
      A port node pointing to panel port node.

required:
  - "#address-cells"
  - "#size-cells"
  - compatible
  - reg
  - port@0
  - port@2

example:
  - |
    anx7625_bridge: encoder@58 {
        compatible = "analogix,anx7625";
        reg = <0x58>;
        status = "okay";
        panel-flags = <1>;
        enable-gpios = <&pio 45 GPIO_ACTIVE_HIGH>;
        reset-gpios = <&pio 73 GPIO_ACTIVE_HIGH>;
        #address-cells = <1>;
        #size-cells = <0>;

        port@0 {
          reg = <0>;
          anx_1_in: endpoint {
            remote-endpoint = <&mipi_dsi>;
          };
        };

        port@2 {
          reg = <2>;
          anx_1_out: endpoint {
            remote-endpoint = <&panel_in>;
          };
        };
    };
```

## kernels/4.19/Documentation/devicetree/bindings/display/bridge/anx7688.yaml
```yaml
# SPDX-License-Identifier: GPL-2.0
%YAML 1.2
---
$id: http://devicetree.org/schemas/display/bridge/anx7688.yaml#
$schema: http://devicetree.org/meta-schemas/core.yaml#

title: Analogix ANX7688 SlimPort (Single-Chip Transmitter for DP over USB-C)

maintainers:
  - Nicolas Boichat <drinkcat@chromium.org>

description: |
  The ANX7688 is a single-chip mobile transmitter to support 4K 60 frames per
  second (4096x2160p60) or FHD 120 frames per second (1920x1080p120) video
  resolution from a smartphone or tablet with full function USB-C.

  This binding only describes the HDMI to DP display bridge.

properties:
  compatible:
    const: analogix,anx7688

  reg:
    maxItems: 1
    description: I2C address of the device

  ports:
    type: object

    properties:
      port@0:
        type: object
        description: |
          Video port for HDMI input

      port@1:
        type: object
        description: |
          Video port for eDP output

    required:
      - port@0

required:
  - compatible
  - reg
  - ports

examples:
  - |
    anx7688: anx7688@2c {
      compatible = "analogix,anx7688";
      reg = <0x2c>;

      port {
        anx7688_in: endpoint {
          remote-endpoint = <&hdmi0_out>;
        };
      };
    };
```

## kernels/4.19/Documentation/devicetree/bindings/display/panel/simple-panel.txt
```
Simple display panel
====================

panel node
----------

Required properties:
- power-supply: See panel-common.txt

Optional properties:
- ddc-i2c-bus: phandle of an I2C controller used for DDC EDID probing
- enable-gpios: GPIO pin to enable or disable the panel
- backlight: phandle of the backlight device attached to the panel
- no-hpd: This panel is supposed to communicate that it's ready via HPD
  (hot plug detect) signal, but the signal isn't hooked up so we should
  hardcode the max delay from the panel spec when powering up the panel.

panel-timing subnode
--------------------

This optional subnode is for devices which require a mode differing
from the panel's "typical" display timing.

Format information on the panel-timing subnode can be found in
display-timing.txt.


Example:

	panel: panel {
		compatible = "cptt,claa101wb01";
		ddc-i2c-bus = <&panelddc>;

		power-supply = <&vdd_pnl_reg>;
		enable-gpios = <&gpio 90 0>;

		backlight = <&backlight>;

		panel-timing {
			clock-frequency = <266604720>;
			hactive = <2400>;
			hfront-porch = <48>;
			hback-porch = <84>;
			hsync-len = <32>;
			vactive = <1600>;
			vfront-porch = <3>;
			vback-porch = <120>;
			vsync-len = <10>;
		};
	};
```

## kernels/4.19/Documentation/devicetree/bindings/input/cros-cbas.yaml
```yaml
# SPDX-License-Identifier: GPL-2.0
%YAML 1.2
---
$id: http://devicetree.org/schemas/input/cros-cbas.yaml#
$schema: http://devicetree.org/meta-schemas/core.yaml#

title: ChromeOS Hammer's Base Attached Switch

maintainers:
  - Dmitry Torokhov <dmitry.torokhov@gmail.com>

description:
  This device is used to signal when a detachable base is attached to a
  Chrome OS tablet. The node for this device must be under a cros-ec node
  like google,cros-ec-spi or google,cros-ec-i2c.

properties:
  compatible:
    const: google,cros-cbas

required:
  - compatible
```

## kernels/4.19/Documentation/devicetree/bindings/media/mediatek,mt8183-dip.txt
```
* Mediatek Digital Image Processor (DIP)

Digital Image Processor (DIP) unit in Mediatek ISP system is responsible for
image content adjustment according to the tuning parameters. DIP can process
the image form memory buffer and output the processed image to multiple output
buffers. Furthermore, it can support demosaicing and noise reduction on the
images.

Required properties:
- compatible: "mediatek,mt8183-dip"
- reg: Physical base address and length of the function block register space
- interrupts: interrupt number to the cpu
- iommus: should point to the respective IOMMU block with master port as
  argument, see Documentation/devicetree/bindings/iommu/mediatek,iommu.txt
  for details.
- mediatek,mdp3: should point to the respective mdp block. DIP hardware
  connects to MDP and we can get the processed image with both effect of the
  two blocks.
- mediatek,larb: must contain the local arbiters in the current SoCs, see
  Documentation/devicetree/bindings/memory-controllers/mediatek,smi-larb.txt
  for details.
- mediatek,scp: should point to the scp node since the we use SCP
  coprocessor to control DIP hardware
- clocks: must contain the local arbiters 5 (LARB5) and DIP clock
- clock-names: must contain "larb5" and "dip"

Example:
	dip: dip@15022000 {
		compatible = "mediatek,mt8183-dip";
		mediatek,larb = <&larb5>;
		mediatek,mdp3 = <&mdp_rdma0>;
		mediatek,scp = <&scp>;
		iommus = <&iommu M4U_PORT_CAM_IMGI>;
		reg = <0 0x15022000 0 0x6000>;
		interrupts = <GIC_SPI 268 IRQ_TYPE_LEVEL_LOW>;
		clocks = <&imgsys CLK_IMG_LARB5>,
			 <&imgsys CLK_IMG_DIP>;
		clock-names = "larb5",
			      "dip";
		};
```

## kernels/4.19/Documentation/devicetree/bindings/media/mediatek,mt8183-fd.txt
```
* Mediatek Face Detection Unit (FD)

Face Detection (FD) unit is a typical memory-to-memory HW device.
It provides hardware accelerated face detection function, and it
is able to detect different poses of faces. FD will writre result
of detected face into memory as output.

Required properties:
- compatible: "mediatek,mt8183-fd"
- mediatek,scp : the node of system control processor (SCP), see
  Documentation/devicetree/bindings/remoteproc/mtk,scp.txt for details.
- iommus: should point to the 3 entries:  M4U_PORT_CAM_FDVT_RP,
  M4U_PORT_CAM_FDVT_WR and M4U_PORT_CAM_FDVT_RB.  (Please see
  Documentation/devicetree/bindings/iommu/mediatek,iommu.txt for details.)
- reg: Physical base address and length of the register space.
- interrupts: interrupt number to the cpu.
- clocks : must contain the FDVT clock, see
  Documentation/devicetree/bindings/clock/clock-bindings.txt for details.
- clock-names: must be "fd".
- power-domain: must be "MT8183_POWER_DOMAIN_ISP".

Example:
	fd: fd@1502b000 {
		compatible = "mediatek,mt8183-fd";
		mediatek,scp = <&scp>;
		iommus = <&iommu M4U_PORT_CAM_FDVT_RP>,
			 <&iommu M4U_PORT_CAM_FDVT_WR>,
			 <&iommu M4U_PORT_CAM_FDVT_RB>;
		reg = <0 0x1502b000 0 0x1000>;
		interrupts = <GIC_SPI 269 IRQ_TYPE_LEVEL_LOW>;
		clocks = <&imgsys CLK_IMG_FDVT>;
		clock-names = "fd";
		power-domains = <&scpsys MT8183_POWER_DOMAIN_ISP>;
	};
```
