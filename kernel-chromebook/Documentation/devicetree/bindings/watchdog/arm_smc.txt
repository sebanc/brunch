## kernel-chromebook/Documentation/devicetree/bindings/watchdog/arm_smc.txt
```
ARM Secure Monitor Call based watchdog

Required properties:
- compatible: must be "arm,smc-watchdog".

Optional properties:
- timeout-sec: initial watchdog timeout in seconds.
	If unset, will select maximum possible timeout.

Example:
	watchdog {
		compatible = "arm,smc-watchdog";
		timeout-sec = <15>;
	};
```

## kernel-chromebook/drivers/gpu/drm/bridge/Kconfig
```kconfig
config DRM_BRIDGE
	def_bool y
	depends on DRM
	help
	  Bridge registration and lookup framework.

config DRM_PANEL_BRIDGE
	def_bool y
	depends on DRM_BRIDGE
	depends on DRM_KMS_HELPER
	select DRM_PANEL
	help
	  DRM bridge wrapper of DRM panels

menu "Display Interface Bridges"
	depends on DRM && DRM_BRIDGE

config DRM_ANALOGIX_ANX78XX
	tristate "Analogix ANX78XX bridge"
	select DRM_KMS_HELPER
	select REGMAP_I2C
	---help---
	  ANX78XX is an ultra-low Full-HD SlimPort transmitter
	  designed for portable devices. The ANX78XX transforms
	  the HDMI output of an application processor to MyDP
	  or DisplayPort.

config DRM_DW_HDMI
	tristate
	select DRM_KMS_HELPER

config DRM_DW_HDMI_AHB_AUDIO
	tristate "Synopsis Designware AHB Audio interface"
	depends on DRM_DW_HDMI && SND
	select SND_PCM
	select SND_PCM_ELD
	select SND_PCM_IEC958
	help
	  Support the AHB Audio interface which is part of the Synopsis
	  Designware HDMI block.  This is used in conjunction with
	  the i.MX6 HDMI driver.


config DRM_NXP_PTN3460
	tristate "NXP PTN3460 DP/LVDS bridge"
	depends on OF
	select DRM_KMS_HELPER
	select DRM_PANEL
	---help---
	  NXP PTN3460 eDP-LVDS bridge chip driver.

config DRM_PARADE_PS8622
	tristate "Parade eDP/LVDS bridge"
	depends on OF
	select DRM_PANEL
	select DRM_KMS_HELPER
	select BACKLIGHT_LCD_SUPPORT
	select BACKLIGHT_CLASS_DEVICE
	---help---
	  Parade eDP-LVDS bridge chip driver.

config DRM_GENERIC_GPIO_MUX
	tristate "Generic GPIO-controlled mux"
	depends on DRM
	depends on OF
	depends on GPIOLIB
	select DRM_KMS_HELPER
	---help---
	  This bridge driver models a GPIO-controlled display mux with one
	  input, 2 outputs (e.g. an HDMI mux). The hardware decides which output
	  is active, reports it as a GPIO, and the driver redirects calls to the
	  appropriate downstream bridge (if any).

config DRM_PARADE_PS8640
	tristate "Parade PS8640 MIPI DSI to eDP Converter"
	depends on DRM
	depends on OF
	select DRM_KMS_HELPER
	select DRM_MIPI_DSI
	select DRM_PANEL
	---help---
	  Choose this option if you have PS8640 for display
	  The PS8640 is a high-performance and low-power
	  MIPI DSI to eDP converter

source "drivers/gpu/drm/bridge/analogix/Kconfig"

config DRM_ANALOGIX_ANX7688
	tristate "Analogix ANX7688 bridge"
	depends on DRM
	select DRM_KMS_HELPER
	---help---
	  ANX7688 is a transmitter to support DisplayPort over USB-C for
	  smartphone and tablets.
	  This driver only supports the HDMI to DP component of the chip.

source "drivers/gpu/drm/bridge/synopsys/Kconfig"

endmenu
```

## kernel-chromebook/drivers/iio/counter/Kconfig
```kconfig
#
# Counter devices
#
# When adding new entries keep the list in alphabetical order

menu "Counters"

config IIO_CROS_EC_SENSORS_SYNC
	tristate "ChromeOS EC Counter Sensors"
	depends on IIO_CROS_EC_SENSORS_CORE
	help
	  Module to handle synchronisation sensors presented by the ChromeOS EC
	  Sensor hub.
	  Synchronisation sensors are counter sensors that are triggered when
	  events occurs from other subsystems. They are use to synchronised
	  those subsystem with existing MEMS sensors, like gyroscope.

endmenu
```

## kernel-chromebook/headers/drivers/gpu/drm/img-rogue/Kconfig
```kconfig
config DRM_POWERVR_ROGUE_1_10
	tristate "PowerVR Rogue v1.10"
	depends on ARM64 || METAG
	depends on HAS_IOMEM
	depends on DRM
	depends on SYNC_FILE
	select DRM_KMS_HELPER
	select GPU_TRACEPOINTS
	select PM_DEVFREQ
	select DEVFREQ_GOV_SIMPLE_ONDEMAND
	select PM_OPP
	select DEVFREQ_THERMAL
	help
	  Driver for PowerVR Rogue graphics hardware 1.10.

	  Say Y here if your SoC contains a PowerVR Rogue GPU. For more
	  information, see <https://www.imgtec.com/graphics-processors/>.

config DRM_POWERVR_ROGUE_DEBUG
	bool "Enable PowerVR Rogue debug features"
	depends on DRM_POWERVR_ROGUE_1_10
	default n
	help
	  Add additional debug features to the PowerVR Rogue driver.

config DRM_POWERVR_ROGUE_PDUMP
	bool "Enable PowerVR Rogue PDUMP tracing."
	depends on DRM_POWERVR_ROGUE_1_10
	default n
	help
	  Enable PDUMP.
```

## kernel-chromebook/headers/drivers/net/wireless/ar10k/Kconfig
```kconfig
config AR10K
	tristate "Atheros 802.11ac wireless PCI cards support"

	depends on PCI
	depends on HAS_DMA
	# competing implementations; only one must be enabled to avoid conflicts
	depends on ATH10K=n
	select FW_LOADER
	select NEW_LEDS
	select LEDS_CLASS
	select LEDS_TRIGGERS
	select ATH_COMMON

	# this is because we don't depend on mac80211
	depends on CFG80211

	# things mac80211 select
        select CRYPTO
        select CRYPTO_ARC4
        select CRYPTO_AES
        select CRYPTO_CCM
        select CRC32
        select AVERAGE

	depends on m
```

## kernel-chromebook/headers/drivers/usb/host/mausb/Kconfig
```kconfig
# SPDX-License-Identifier: GPL-2.0
#
# Kernel configuration file for MA-USB Host driver.
#
# Copyright (c) 2019 - 2020 DisplayLink (UK) Ltd.
#

config USB_HOST_MAUSB
	tristate "Media Agnostic (MA) USB Host Driver"
	help
	  This is a Media Agnostic (MA) USB Host driver which enables host
	  communication via MA USB protocol stack.

	  If this driver is compiled as a module, it will be named mausb_host.
```

## kernel/Documentation/devicetree/bindings/display/bridge/gpio-mux.yaml
```yaml
# SPDX-License-Identifier: GPL-2.0
%YAML 1.2
---
$id: http://devicetree.org/schemas/display/bridge/gpio-mux.yaml#
$schema: http://devicetree.org/meta-schemas/core.yaml#

title: Generic display mux (1 input, 2 outputs)

maintainers:
  - Nicolas Boichat <drinkcat@chromium.org>

description: |
  This bindings describes a simple display (e.g. HDMI) mux, that has 1
  input, and 2 outputs. The mux status is controlled by hardware, and
  its status is read back using a GPIO.

properties:
  compatible:
    const: gpio-display-mux

  detect-gpios:
    maxItems: 1
    description: GPIO that indicates the active output

  ports:
    type: object

    properties:
      port@0:
        type: object
        description: |
          Video port for input.

      port@1:
        type: object
        description: |
          2 video ports for output.
          The reg value in the endpoints matches the GPIO status: when
          GPIO is asserted, endpoint with reg value <1> is selected.

    required:
      - port@0
      - port@1

required:
  - compatible
  - detect-gpios
  - ports

examples:
  - |
    hdmi_mux: hdmi_mux {
      compatible = "gpio-display-mux";
      status = "okay";
      detect-gpios = <&pio 36 GPIO_ACTIVE_HIGH>;
      pinctrl-names = "default";
      pinctrl-0 = <&hdmi_mux_pins>;
      ddc-i2c-bus = <&hdmiddc0>;

      ports {
        #address-cells = <1>;
        #size-cells = <0>;

        port@0 { /* input */
          reg = <0>;

          hdmi_mux_in: endpoint {
            remote-endpoint = <&hdmi0_out>;
          };
        };

        port@1 { /* output */
          reg = <1>;

          #address-cells = <1>;
          #size-cells = <0>;

          hdmi_mux_out_anx: endpoint@0 {
            reg = <0>;
            remote-endpoint = <&anx7688_in>;
          };

          hdmi_mux_out_hdmi: endpoint@1 {
            reg = <1>;
            remote-endpoint = <&hdmi_connector_in>;
          };
        };
      };
    };
```

## kernel/Documentation/devicetree/bindings/display/bridge/ps8640.txt
```
ps8640-bridge bindings

Required properties:
	- compatible: "parade,ps8640"
	- reg: first page address of the bridge.
	- sleep-gpios: OF device-tree gpio specification for PD pin.
	- reset-gpios: OF device-tree gpio specification for reset pin.
	- vdd12-supply: OF device-tree regulator specification for 1.2V power.
	- vdd33-supply: OF device-tree regulator specification for 3.3V power.
	- ports: The device node can contain video interface port nodes per
		 the video-interfaces bind[1]. For port@0,set the reg = <0> as
		 ps8640 dsi in and port@1,set the reg = <1> as ps8640 eDP out.

Optional properties:
	- mode-sel-gpios: OF device-tree gpio specification for mode-sel pin.
[1]: Documentation/devicetree/bindings/media/video-interfaces.txt

Example:
	edp-bridge@18 {
		compatible = "parade,ps8640";
		reg = <0x18>;
		sleep-gpios = <&pio 116 GPIO_ACTIVE_LOW>;
		reset-gpios = <&pio 115 GPIO_ACTIVE_LOW>;
		mode-sel-gpios = <&pio 92 GPIO_ACTIVE_HIGH>;
		vdd12-supply = <&ps8640_fixed_1v2>;
		vdd33-supply = <&mt6397_vgp2_reg>;

		ports {
			#address-cells = <1>;
			#size-cells = <0>;
			port@0 {
				reg = <0>;
				ps8640_in: endpoint {
					remote-endpoint = <&dsi0_out>;
				};
			};
			port@1 {
				reg = <1>;
				ps8640_out: endpoint {
					remote-endpoint = <&panel_in>;
				};
			};
		};
	};
```

## kernel/Documentation/devicetree/bindings/display/mediatek/mediatek,display.txt
```
Mediatek Display Device
============================

The Mediatek Display Device provides power control to the system.

Required Properties:

- compatible: Should be one of:
	- "mediatek,mt8183-display"

The Display Device power name are defined in
include\dt-bindings\power\mt*-power.h


Example:

display_components: dispsys@14000000 {
	compatible = "mediatek,mt8183-display";
	reg = <0 0x14000000 0 0x1000>;
	power-domains = <&scpsys MT8183_POWER_DOMAIN_DISP>;
};
```

## kernel/Documentation/devicetree/bindings/display/msm/gpu.txt
```
Qualcomm adreno/snapdragon GPU

Required properties:
- compatible: "qcom,adreno-XYZ.W", "qcom,adreno" or
	      "amd,imageon-XYZ.W", "amd,imageon"
    for example: "qcom,adreno-306.0", "qcom,adreno"
  Note that you need to list the less specific "qcom,adreno" (since this
  is what the device is matched on), in addition to the more specific
  with the chip-id.
  If "amd,imageon" is used, there should be no top level msm device.
- reg: Physical base address and length of the controller's registers.
- interrupts: The interrupt signal from the gpu.
- clocks: device clocks (if applicable)
  See ../clocks/clock-bindings.txt for details.
- clock-names: the following clocks are required by a3xx, a4xx and a5xx
  cores:
  * "core"
  * "iface"
  * "mem_iface"
  For GMU attached devices the GPU clocks are not used and are not required. The
  following devices should not list clocks:
   - qcom,adreno-630.2
- iommus: optional phandle to an adreno iommu instance
- operating-points-v2: optional phandle to the OPP operating points
- interconnects: optional phandle to an interconnect provider.  See
  ../interconnect/interconnect.txt for details.
- qcom,gmu: For GMU attached devices a phandle to the GMU device that will
  control the power for the GPU. Applicable targets:
    - qcom,adreno-630.2
- zap-shader: For a5xx and a6xx devices this node contains a memory-region that
  points to reserved memory to store the zap shader that can be used to help
  bring the GPU out of secure mode.
- firmware-name: optional property of the 'zap-shader' node, listing the
  relative path of the device specific zap firmware.

Example 3xx/4xx/a5xx:

/ {
	...

	gpu: qcom,kgsl-3d0@4300000 {
		compatible = "qcom,adreno-320.2", "qcom,adreno";
		reg = <0x04300000 0x20000>;
		reg-names = "kgsl_3d0_reg_memory";
		interrupts = <GIC_SPI 80 0>;
		clock-names =
		    "core",
		    "iface",
		    "mem_iface";
		clocks =
		    <&mmcc GFX3D_CLK>,
		    <&mmcc GFX3D_AHB_CLK>,
		    <&mmcc MMSS_IMEM_AHB_CLK>;
	};
};

Example a6xx (with GMU):

/ {
	...

	gpu@5000000 {
		compatible = "qcom,adreno-630.2", "qcom,adreno";
		#stream-id-cells = <16>;

		reg = <0x5000000 0x40000>, <0x509e000 0x10>;
		reg-names = "kgsl_3d0_reg_memory", "cx_mem";

		/*
		 * Look ma, no clocks! The GPU clocks and power are
		 * controlled entirely by the GMU
		 */

		interrupts = <GIC_SPI 300 IRQ_TYPE_LEVEL_HIGH>;

		iommus = <&adreno_smmu 0>;

		operating-points-v2 = <&gpu_opp_table>;

		interconnects = <&rsc_hlos MASTER_GFX3D &rsc_hlos SLAVE_EBI1>;

		gpu_opp_table: opp-table {
			compatible = "operating-points-v2";

			opp-430000000 {
				opp-hz = /bits/ 64 <430000000>;
				opp-level = <RPMH_REGULATOR_LEVEL_SVS_L1>;
				opp-peak-kBps = <5412000>;
			};

			opp-355000000 {
				opp-hz = /bits/ 64 <355000000>;
				opp-level = <RPMH_REGULATOR_LEVEL_SVS>;
				opp-peak-kBps = <3072000>;
			};

			opp-267000000 {
				opp-hz = /bits/ 64 <267000000>;
				opp-level = <RPMH_REGULATOR_LEVEL_LOW_SVS>;
				opp-peak-kBps = <3072000>;
			};

			opp-180000000 {
				opp-hz = /bits/ 64 <180000000>;
				opp-level = <RPMH_REGULATOR_LEVEL_MIN_SVS>;
				opp-peak-kBps = <1804000>;
			};
		};

		qcom,gmu = <&gmu>;

		zap-shader {
			memory-region = <&zap_shader_region>;
			firmware-name = "qcom/LENOVO/81JL/qcdxkmsuc850.mbn"
		};
	};
};
```
