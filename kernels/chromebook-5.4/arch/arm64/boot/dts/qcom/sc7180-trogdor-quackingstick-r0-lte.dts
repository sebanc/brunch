// SPDX-License-Identifier: (GPL-2.0+ OR MIT)
/*
 * Google Quackingstick board device tree source
 *
 * Copyright 2021 Google LLC.
 *
 * SKU: 0x600 => 1536
 *  - bits 11..8: Panel ID: 0x6 (AUO)
 */

#include "sc7180-trogdor-quackingstick-r0.dts"
#include "sc7180-trogdor-lte-sku.dtsi"

/ {
	model = "Google Quackingstick (rev0+) with LTE";
	compatible = "google,quackingstick-sku1536", "qcom,sc7180";
};
