// SPDX-License-Identifier: (GPL-2.0 OR MIT)
/*
 * Copyright 2021 Google LLC
 */

/dts-v1/;
#include "mt8183-kukui-jacuzzi-cerise.dtsi"
#include "mt8183-kukui-audio-ts3a227e-rt1015p.dtsi"

/ {
	model = "Google stern board";
	compatible = "google,cerise-rev3-sku1", "google,cerise", "mediatek,mt8183";
};

&mt6358codec {
	mediatek,dmic-mode = <0>; /* two-wire */
};

&touchscreen {
	status = "okay";

	compatible = "hid-over-i2c";
	reg = <0x10>;
	interrupt-parent = <&pio>;
	interrupts = <155 IRQ_TYPE_LEVEL_LOW>;
	pinctrl-names = "default";
	pinctrl-0 = <&touchscreen_pins>;

	post-power-on-delay-ms = <10>;
	hid-descr-addr = <0x0001>;
};

&qca_wifi {
	qcom,ath10k-calibration-variant = "GO_STERN";
};
