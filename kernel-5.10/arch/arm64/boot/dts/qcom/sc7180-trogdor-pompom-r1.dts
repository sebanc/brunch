// SPDX-License-Identifier: (GPL-2.0+ OR MIT)
/*
 * Google Pompom board device tree source
 *
 * Copyright 2020 Google LLC.
 */

/dts-v1/;

#include "sc7180-trogdor-pompom.dtsi"

/ {
	model = "Google Pompom (rev1)";
	compatible = "google,pompom-rev1", "qcom,sc7180";
};

&usb_hub {
	 vdd-supply = <&pp3300_l7c>;
};
