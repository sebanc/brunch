## kernels/kernel-chromebook-5.4/Documentation/devicetree/bindings/soc/mediatek/mtk-svs.yaml
```yaml
# SPDX-License-Identifier: (GPL-2.0-only OR BSD-2-Clause)
%YAML 1.2
---
$id: http://devicetree.org/schemas/soc/mediatek/mtk-svs.yaml#
$schema: http://devicetree.org/meta-schemas/core.yaml#

title: Introduce MTK SVS engine

maintainers:
  - Matthias Brugger <matthias.bgg@gmail.com>
  - Kevin Hilman <khilman@kernel.org>
  - Nishanth Menon <nm@ti.com>

description: |+
  The Smart Voltage Scaling(SVS) engine is a piece of hardware
  which has several controllers(banks) for calculating suitable
  voltage to different power domains(CPU/GPU/CCI) according to
  chip process corner, temperatures and other factors. Then DVFS
  driver could apply SVS bank voltage to PMIC/Buck.

properties:
  compatible:
    enum:
      - mediatek,mt8183-svs
      - mediatek,mt8192-svs

  reg:
    description: Address range of the MTK SVS controller.
    maxItems: 1

  interrupts:
    description: IRQ for the MTK SVS controller.
    maxItems: 1

  clocks:
    description: Main clock for MTK SVS controller to work.

  clock-names:
    const: main

  nvmem-cells:
    maxItems: 2
    description:
      Phandle to the calibration data provided by a nvmem device.

  nvmem-cell-names:
    items:
      - const: svs-calibration-data
      - const: t-calibration-data

  resets:
    description:
      svs reset control.

  reset-names:
    items:
      - const: svs_rst

required:
  - compatible
  - reg
  - interrupts
  - clocks
  - clock-names
  - nvmem-cells
  - nvmem-cell-names

additionalProperties: false

examples:
  - |
    #include <dt-bindings/clock/mt8183-clk.h>
    #include <dt-bindings/interrupt-controller/arm-gic.h>
    #include <dt-bindings/interrupt-controller/irq.h>

    soc {
        #address-cells = <2>;
        #size-cells = <2>;

        svs@1100b000 {
            compatible = "mediatek,mt8183-svs";
            reg = <0 0x1100b000 0 0x1000>;
            interrupts = <GIC_SPI 127 IRQ_TYPE_LEVEL_LOW>;
            clocks = <&infracfg CLK_INFRA_THERM>;
            clock-names = "main";
            nvmem-cells = <&svs_calibration>, <&thermal_calibration>;
            nvmem-cell-names = "svs-calibration-data", "t-calibration-data";
        };
    };
```

## kernels/kernel-chromebook-5.4/Documentation/devicetree/bindings/thermal/mediatek-thermal-lvts.yaml
```yaml
# SPDX-License-Identifier: (GPL-2.0-only OR BSD-2-Clause)
%YAML 1.2
---
$id: http://devicetree.org/schemas/thermal/mediatek-thermal-lvts.yaml#
$schema: http://devicetree.org/meta-schemas/core.yaml#

title: Mediatek SoC LVTS thermal controller (DTS) binding

maintainers:
  - Yu-Chia Chang <ethan.chang@mediatek.com>
  - Michael Kao <michael.kao@mediatek.com>

properties:
  compatible:
    const: mediatek,mt6873-lvts

  reg:
    maxItems: 1

  interrupts:
    maxItems: 1

  clocks:
    maxItems: 1

  clock-names:
    items:
      - const: lvts_clk

  "#thermal-sensor-cells":
    const: 0

required:
  - "#thermal-sensor-cells"
  - compatible
  - reg
  - interrupts
  - clocks
  - clock-names

additionalProperties: false

examples:
  - |
    #include <dt-bindings/thermal/thermal.h>
    #include <dt-bindings/interrupt-controller/arm-gic.h>
    #include <dt-bindings/clock/mt8192-clk.h>
    dts: lvts@1100b000 {
        compatible = "mediatek,mt6873-lvts";
        reg = <0x1100b000 0x1000>;
        clocks = <&infracfg CLK_INFRA_THERM>;
        clock-names = "lvts_clk";
        #thermal-sensor-cells = <0>;
        interrupts = <GIC_SPI 147 IRQ_TYPE_LEVEL_HIGH>;
    };

    thermal-zones {
        cpu_thermal: cpu-thermal {
            polling-delay-passive = <0>;
            polling-delay = <0>;

            thermal-sensors = <&dts>;
            trips {
                cpu_alert1: cpu-alert1 {
                    temperature = <85000>;
                    hysteresis = <0>;
                    type = "passive";
                };

                cpu_crit: cpu-crit {
                    temperature = <120000>;
                    hysteresis = <0>;
                    type = "critical";
                };
            };

            cooling-maps {
            };
        };
    };
...
```

## kernels/kernel-chromebook-5.4/headers/drivers/misc/intel/gna/Kconfig
```kconfig
#
# Intel(R) Gaussian & Neural Accelerator (Intel(R) GNA)
#

config INTEL_GNA
	tristate "Intel(R) Gaussian & Neural Accelerator (Intel(R) GNA)"
	depends on X86 && PCI
	help
	  This option enables the Intel(R) Gaussian & Neural Accelerator
	  (Intel(R) GNA) driver: intel_gna.
	  User space interface is defined in include/uapi/misc/intel/gna.h, while
	  information about functionality is in
	  Documentation/misc-devices/intel/gna.rst
```

## kernels/kernel-macbook/Documentation/devicetree/bindings/media/mediatek,camisp.txt
```
* Mediatek Image Signal Processor Pass 1 (ISP P1)

The Pass 1 unit of Mediatek's camera ISP system grabs the sensor data out
from the sensor interface, applies ISP effects from tuning data and outputs
the image data and statistics data to DRAM. Furthermore, Pass 1 unit has
the ability to output two different resolutions frames at the same time to
increase the performance of the camera application.

Required properties:
- compatible: Must be "mediatek,mt8183-camisp" for MT8183.
- reg: Physical base address of the camera function block register and
  length of memory mapped region. Must contain an entry for each entry
  in reg-names.
- reg-names: Must include the following entries:
  "cam_sys": Camera base function block
  "cam_uni": Camera UNI function block
  "cam_a": Camera ISP P1 hardware unit A
  "cam_b": Camera ISP P1 hardware unit B
  "cam_c": Camera ISP P1 hardware unit C
- interrupts: Must contain an entry for each entry in interrupt-names.
- interrupt-names : Must include the following entries:
  "cam_uni": Camera UNI interrupt
  "cam_a": Camera unit A interrupt
  "cam_b": Camera unit B interrupt
  "cam_c": Camera unit C interrupt
- iommus: Shall point to the respective IOMMU block with master port
  as argument, see Documentation/devicetree/bindings/iommu/mediatek,iommu.txt
  for details.
- clocks: A list of phandle and clock specifier pairs as listed
  in clock-names property, see
  Documentation/devicetree/bindings/clock/clock-bindings.txt for details.
- clock-names: Must be "camsys_cam_cgpdn" and "camsys_camtg_cgpdn".
- mediatek,larb: Must contain the local arbiters in the current SoCs, see
  Documentation/devicetree/bindings/memory-controllers/mediatek,smi-larb.txt
  for details.
- power-domains: a phandle to the power domain, see
  Documentation/devicetree/bindings/power/power_domain.txt for details.
- mediatek,scp : The node of system control processor (SCP), see
  Documentation/devicetree/bindings/remoteproc/mtk,scp.txt for details.

Example:
SoC specific DT entry:

	camisp: camisp@1a000000 {
		compatible = "mediatek,mt8183-camisp";
		reg = <0 0x1a000000 0 0x1000>,
				<0 0x1a003000 0 0x1000>,
				<0 0x1a004000 0 0x2000>,
				<0 0x1a006000 0 0x2000>,
				<0 0x1a008000 0 0x2000>;
		reg-names = "cam_sys",
				"cam_uni",
				"cam_a",
				"cam_b",
				"cam_c";
		interrupts = <GIC_SPI 253 IRQ_TYPE_LEVEL_LOW>,
				<GIC_SPI 254 IRQ_TYPE_LEVEL_LOW>,
				<GIC_SPI 255 IRQ_TYPE_LEVEL_LOW>,
				<GIC_SPI 256 IRQ_TYPE_LEVEL_LOW>;
		interrupt-names = "cam_uni",
				"cam_a",
				"cam_b",
				"cam_c";
		iommus = <&iommu M4U_PORT_CAM_IMGO>;
		clocks = <&camsys CLK_CAM_CAM>,
				<&camsys CLK_CAM_CAMTG>;
		clock-names = "camsys_cam_cgpdn",
				"camsys_camtg_cgpdn";
		mediatek,larb = <&larb3>,
				<&larb6>;
		power-domains = <&scpsys MT8183_POWER_DOMAIN_CAM>;
		mediatek,scp = <&scp>;
	};
```

## kernels/kernel-macbook/drivers/media/platform/camx/cam_sensor_module/Kconfig
```kconfig
config QTI_SENSORS
	bool "Qualcomm sensor drivers"
	default y
	depends on (QTI_CAMERA_SYNC && QTI_CAMERA_SMMU && QTI_CAMERA_CRM)
	help
	  Say Y here to enable selecting module
	  Support for the Sensors and Actuator etc

if QTI_SENSORS
	source "drivers/media/platform/camx/cam_sensor_module/cam_eeprom/Kconfig"
	source "drivers/media/platform/camx/cam_sensor_module/cam_actuator/Kconfig"
	source "drivers/media/platform/camx/cam_sensor_module/cam_sensor_io/Kconfig"

	config QTI_CCI
		bool "Qualcomm CCI driver"
		default y
		help
		  Say Y here to enable selecting module
		  Support for the synchronous QUP based I2C interface

	config QTI_I2C
		bool "Qualcomm I2C driver"
		default y
		help
		  Say Y here to enable selecting module
		  Support for the synchronous GENI based I2C interface

	config QTI_SPI
		bool "Qualcomm SPI_GENI driver"
		default y
		help
		  Say Y here to enable selecting module
		  Support for the GENI based Serial Peripheral Interface
endif
```

## kernels/kernel-macbook/headers/drivers/media/platform/camx/cam_cpas/Kconfig
```kconfig
config QTI_CPAS
	bool "Qualcomm CPAS driver"
	default y
	depends on (QTI_CAMERA_SYNC && QTI_CAMERA_SMMU && QTI_CAMERA_CRM)
	depends on QCOM_CLK_RPMH
	depends on INTERCONNECT_QCOM_SC7180
	help
	  Say Y here to enable selecting module
	  Support for CDMx engines SW interface
```

## kernels/kernel-macbook/headers/drivers/media/platform/camx/cam_icp/Kconfig
```kconfig
config QTI_ICP_A5
	bool "Qualcomm ICP/A5 driver"
	depends on (QTI_CAMERA_SYNC && QTI_CAMERA_SMMU && QTI_CAMERA_CRM)
	default y
	help
	  Say Y here to enable selecting module
	  Support for the ICP/A5 engine
```

## kernels/kernel-macbook/headers/drivers/media/platform/camx/cam_sensor_module/cam_actuator/Kconfig
```kconfig
config QTI_ACTUATOR
	bool "Camera Actuator driver"
	default n
	help
	  Say Y here to enable selecting module
	  Support for the Camera actuator driver
```

## kernels/macbook/Documentation/devicetree/bindings/arm/mediatek/mediatek,mdp-rdma.yaml
```yaml
# SPDX-License-Identifier: (GPL-2.0-only OR BSD-2-Clause)
%YAML 1.2
---
$id: http://devicetree.org/schemas/arm/mediatek/mediatek,mdp-rdma.yaml#
$schema: http://devicetree.org/meta-schemas/core.yaml#

title: Mediatek MDP RDMA

maintainers:
  - Matthias Brugger <matthias.bgg@gmail.com>

description: |
  The mediatek MDP RDMA stands for Read Direct Memory Access.
  It provides real time data to the back-end panel driver, such as DSI,
  DPI and DP_INTF.
  It contains one line buffer to store the sufficient pixel data.
  RDMA device node must be siblings to the central MMSYS_CONFIG node.
  For a description of the MMSYS_CONFIG binding, see
  Documentation/devicetree/bindings/arm/mediatek/mediatek,mmsys.yaml for details.

properties:
  compatible:
    oneOf:
      - items:
          - const: mediatek,mt8195-vdo1-rdma

  reg:
    maxItems: 1

  interrupts:
    maxItems: 1

  power-domains:
    description: A phandle and PM domain specifier as defined by bindings of
      the power controller specified by phandle. See
      Documentation/devicetree/bindings/power/power-domain.yaml for details.

  clocks:
    items:
      - description: RDMA Clock

  iommus:
    description:
      This property should point to the respective IOMMU block with master port as argument,
      see Documentation/devicetree/bindings/iommu/mediatek,iommu.yaml for details.

  mediatek,gce-client-reg:
    description:
      The register of display function block to be set by gce. There are 4 arguments,
      such as gce node, subsys id, offset and register size. The subsys id that is
      mapping to the register of display function blocks is defined in the gce header
      include/include/dt-bindings/gce/<chip>-gce.h of each chips.
    $ref: /schemas/types.yaml#/definitions/phandle-array
    maxItems: 1

required:
  - compatible
  - reg
  - power-domains
  - clocks
  - iommus

additionalProperties: false

examples:
  - |

    vdo1_rdma0: vdo1_rdma@1c104000 {
        compatible = "mediatek,mt8195-vdo1-rdma";
        reg = <0 0x1c104000 0 0x1000>;
        interrupts = <GIC_SPI 495 IRQ_TYPE_LEVEL_HIGH 0>;
        clocks = <&vdosys1 CLK_VDO1_MDP_RDMA0>;
        power-domains = <&spm MT8195_POWER_DOMAIN_VDOSYS1>;
        iommus = <&iommu_vdo M4U_PORT_L2_MDP_RDMA0>;
        mediatek,gce-client-reg = <&gce0 SUBSYS_1c10XXXX 0x4000 0x1000>;
    };
```

## kernels/macbook/Documentation/devicetree/bindings/devfreq/mt8183-cci.yaml
```yaml
# SPDX-License-Identifier: (GPL-2.0-only OR BSD-2-Clause)
%YAML 1.2
---
$id: http://devicetree.org/schemas/devfreq/mt8183-cci.yaml#
$schema: http://devicetree.org/meta-schemas/core.yaml#

title: CCI_DEVFREQ driver for MT8183.

maintainers:
  - Andrew-sh.Cheng <andrew-sh.cheng@mediatek.com>

description: |
  This module is used to create CCI DEVFREQ.
  The performance will depend on both CCI frequency and CPU frequency.
  For MT8183, CCI co-buck with Little core.
  Contain CCI opp table for voltage and frequency scaling.

properties:
  compatible:
    const: "mediatek,mt8183-cci"

  clocks:
    maxItems: 1

  clock-names:
    const: "cci"

  operating-points-v2: true
  opp-table: true

  proc-supply:
    description:
      Phandle of the regulator that provides the supply voltage.

required:
  - compatible
  - clocks
  - clock-names
  - proc-supply

examples:
  - |
    #include <dt-bindings/clock/mt8183-clk.h>
    cci: cci {
      compatible = "mediatek,mt8183-cci";
      clocks = <&apmixedsys CLK_APMIXED_CCIPLL>;
      clock-names = "cci";
      operating-points-v2 = <&cci_opp>;
      proc-supply = <&mt6358_vproc12_reg>;
    };
```

## kernels/macbook/Documentation/devicetree/bindings/display/mediatek/mediatek,dp.yaml
```yaml
# SPDX-License-Identifier: (GPL-2.0-only OR BSD-2-Clause)
%YAML 1.2
---
$id: http://devicetree.org/schemas/display/mediatek/mediatek,dp.yaml#
$schema: http://devicetree.org/meta-schemas/core.yaml#

title: Mediatek Display Port Controller

maintainers:
  - CK Hu <ck.hu@mediatek.com>
  - Jitao shi <jitao.shi@mediatek.com>

description: |
  Device tree bindings for the Mediatek (embedded) Display Port controller
  present on some Mediatek SoCs.

properties:
  compatible:
    enum:
      - mediatek,mt8195-dp-tx

  reg:
    maxItems: 1

  interrupts:
    maxItems: 1

  clocks:
    items:
      - description: faxi clock

  clock-names:
    items:
      - const: faxi

  power-domains:
    maxItems: 1

  ports:
    $ref: /schemas/graph.yaml#/properties/ports
    properties:
      port@0:
        $ref: /schemas/graph.yaml#/properties/port
        description: Input endpoint of the controller, usually dp_intf

      port@1:
        $ref: /schemas/graph.yaml#/properties/port
        description: Output endpoint of the controller

required:
  - compatible
  - reg
  - interrupts
  - ports

additionalProperties: false

examples:
  - |
    #include <dt-bindings/interrupt-controller/arm-gic.h>
    #include <dt-bindings/power/mt8195-power.h>
    edp_tx: edp_tx@1c500000 {
        compatible = "mediatek,mt8195-dp-tx";
        reg = <0 0x1c500000 0 0x8000>;
        interrupts = <GIC_SPI 676 IRQ_TYPE_LEVEL_HIGH 0>;
        power-domains = <&spm MT8195_POWER_DOMAIN_EPD_TX>;
        pinctrl-names = "default";
        pinctrl-0 = <&edp_pin>;

        ports {
            #address-cells = <1>;
            #size-cells = <0>;

            port@0 {
                reg = <0>;
                edp_in: endpoint {
                    remote-endpoint = <&dp_intf0_out>;
                };
            };
            port@1 {
                reg = <1>;
                edp_out: endpoint {
                	remote-endpoint = <&panel_in>;
                };
            };
        };
    };
```
