// SPDX-License-Identifier: (GPL-2.0 OR MIT)
/*
 * Copyright 2021 Google LLC
 */

/dts-v1/;
#include "mt8183-kukui-jacuzzi.dtsi"

&cpu_thermal {
        sustainable-power = <4500>; /* milliwatts */
};

&mmc1_pins_uhs {
	pins_clk {
		drive-strength = <MTK_DRIVE_6mA>;
	};
};

&i2c2 {
    i2c-scl-internal-delay-ns = <13200>;
};
