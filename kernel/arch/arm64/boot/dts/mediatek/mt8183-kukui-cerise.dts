// SPDX-License-Identifier: (GPL-2.0 OR MIT)
/*
 * Copyright 2020 Google LLC
 */

/dts-v1/;
#include "mt8183-kukui-jacuzzi.dtsi"
#include "mt8183-kukui-audio-da7219.dtsi"

/ {
	model = "Google cerise board";
	compatible = "google,cerise", "mediatek,mt8183";
};

&cpu_thermal {
	sustainable-power = <4500>; /* milliwatts */
};

&mt6358codec {
	mediatek,dmic-mode = <1>; /* one-wire */
};

&touchscreen {
	status = "disabled";
};
