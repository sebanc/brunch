// SPDX-License-Identifier: (GPL-2.0 OR MIT)
/*
 * Copyright 2021 Google LLC
 */

/dts-v1/;
#include "mt8183-kukui-munna.dtsi"
#include "mt8183-kukui-audio-da7219-rt1015p.dtsi"

/ {
	model = "Google munna rev0 sku0 board";
	compatible = "google,munna-rev0-sku0",
		"google,munna", "mediatek,mt8183";
};

&qca_wifi {
	qcom,ath10k-calibration-variant = "GO_FENNEL14";
};

&mmc1_pins_uhs {
	pins_clk {
		drive-strength = <MTK_DRIVE_6mA>;
	};
};
