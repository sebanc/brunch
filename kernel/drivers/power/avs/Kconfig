## kernels/4.19/Documentation/devicetree/bindings/media/mediatek-seninf.txt
```
* Mediatek seninf MIPI-CSI2 host driver

Seninf MIPI-CSI2 host driver is a HW camera interface controller. It support a widely adopted,
simple, high-speed protocol primarily intended for point-to-point image and video
transmission between cameras and host devices.

Required properties:
  - compatible: "mediatek,mt8183-seninf"
  - reg: Must contain an entry for each entry in reg-names.
  - reg-names: Must include the following entries:
    "base_reg": seninf registers base
    "rx_reg": Rx analog registers base
  - interrupts: interrupt number to the cpu.
  - clocks : clock name from clock manager
  - clock-names: must be CLK_CAM_SENINF and CLK_TOP_MUX_SENINF.
    It is the clocks of seninf

Example:
	seninf: seninf@1a040000 {
		compatible = "mediatek,mt8183-seninf";
		reg = <0 0x1a040000 0 0x8000>,
		      <0 0x11C80000 0 0x6000>;
		reg-names = "base_reg", "rx_reg";
		interrupts = <GIC_SPI 251 IRQ_TYPE_LEVEL_LOW>;
		power-domains = <&scpsys MT8183_POWER_DOMAIN_CAM>;
		clocks = <&camsys CLK_CAM_SENINF>,
			 <&topckgen CLK_TOP_MUX_SENINF>;
		clock-names = "CLK_CAM_SENINF", "CLK_TOP_MUX_SENINF";
	}
```

## kernels/4.19/Documentation/devicetree/bindings/net/broadcom-bluetooth.txt
```
Broadcom Bluetooth Chips
---------------------

This documents the binding structure and common properties for serial
attached Broadcom devices.

Serial attached Broadcom devices shall be a child node of the host UART
device the slave device is attached to.

Required properties:

 - compatible: should contain one of the following:
   * "brcm,bcm43438-bt"
   * "brcm,bcm43540-bt"

Optional properties:

 - max-speed: see Documentation/devicetree/bindings/serial/slave-device.txt
 - shutdown-gpios: GPIO specifier, used to enable the BT module
 - device-wakeup-gpios: GPIO specifier, used to wakeup the controller
 - host-wakeup-gpios: GPIO specifier, used to wakeup the host processor
 - clocks: clock specifier if external clock provided to the controller
 - clock-names: should be "extclk"
 - brcm,bt-pcm-int-params: configure PCM parameters via a 5-byte array
    - sco-routing: 0 = PCM, 1 = Transport, 2 = Codec, 3 = I2S
    - pcm-interface-rate: 128KBps, 256KBps, 512KBps, 1024KBps, 2048KBps
    - pcm-frame-type: short, long
    - pcm-sync-mode: slave, master
    - pcm-clock-mode: slave, master


Example:

&uart2 {
       pinctrl-names = "default";
       pinctrl-0 = <&uart2_pins>;

       bluetooth {
               compatible = "brcm,bcm43438-bt";
               max-speed = <921600>;
               brcm,bt-pcm-int-params = [01 02 00 01 01];
       };
};
```

## kernels/4.19/Documentation/devicetree/bindings/sram/rockchip-ddr-sram.txt
```
Rockchip SRAM for DDR frequency changes:
----------------------------------------

In order to change the frequency that SDRAM is running at we need a
bit of space (16K) in SRAM to contain the code for the frequency change.

Therefore a reserved section sub-node has to be added to the mmio-sram
declaration.

Required sub-node properties:
- compatible : should be "rockchip,rk3288-ddr-sram"

The rest of the properties should follow the generic mmio-sram discription
found in Documentation/devicetree/bindings/sram/sram.txt

Example:

	bus_intmem@ff700000 {
		compatible = "mmio-sram";
		reg = <0x0 0xff700000 0x0 0x18000>;
		#address-cells = <1>;
		#size-cells = <1>;
		ranges = <0 0x0 0xff700000 0x18000>;

		ddr_sram: ddr-sram@1000 {
			compatible = "rockchip,rk3288-ddr-sram";
			reg = <0x1000 0x4000>;
		};
	};
```

## kernels/4.19/headers/drivers/gpu/drm/img-rogue/Kconfig
```kconfig
config DRM_POWERVR_ROGUE_1_13
	tristate "PowerVR Rogue"
	depends on ARM64
	depends on HAS_IOMEM
	depends on DRM
	depends on SYNC_FILE
	depends on DRM_KMS_HELPER
	depends on PM_DEVFREQ
	depends on DEVFREQ_GOV_SIMPLE_ONDEMAND
	depends on PM_OPP
	depends on DEVFREQ_THERMAL
	help
	  Driver for PowerVR Rogue graphics hardware 1.13.

	  Say Y here if your SoC contains a PowerVR Rogue GPU. For more
	  information, see <https://www.imgtec.com/graphics-processors/>.

config DRM_POWERVR_ROGUE_1_10
	tristate "PowerVR Rogue"
	depends on ARM64
	depends on HAS_IOMEM
	depends on DRM
	depends on SYNC_FILE
	depends on DRM_KMS_HELPER
	depends on PM_DEVFREQ
	depends on DEVFREQ_GOV_SIMPLE_ONDEMAND
	depends on PM_OPP
	depends on DEVFREQ_THERMAL
	help
	  Driver for PowerVR Rogue graphics hardware 1.10.

	  Say Y here if your SoC contains a PowerVR Rogue GPU. For more
	  information, see <https://www.imgtec.com/graphics-processors/>.

config DRM_POWERVR_ROGUE_DEBUG
	bool "Enable PowerVR Rogue debug features"
	depends on DRM_POWERVR_ROGUE_1_10 || DRM_POWERVR_ROGUE_1_13
	default n
	help
	  Add additional debug features to the PowerVR Rogue driver.

config DRM_POWERVR_ROGUE_PDUMP
	bool "Enable PowerVR Rogue PDUMP tracing."
	depends on DRM_POWERVR_ROGUE_1_10 || DRM_POWERVR_ROGUE_1_13
	default n
	help
	  Enable PDUMP.
```

## kernels/4.19/headers/security/container/Kconfig
```kconfig
config SECURITY_CONTAINER_MONITOR
	bool "Monitor containerized processes"
	depends on SECURITY
	depends on VSOCKETS=y
	select SECURITYFS
	help
	  Instrument the Linux kernel to collect more information about containers
	  and identify security threats.

config SECURITY_CONTAINER_MONITOR_DEBUG
    bool "Enable debug pr_devel logs"
	depends on SECURITY_CONTAINER_MONITOR
	help
	  Define DEBUG for CSM files to compile verbose debugging messages.

	  Only for debugging/testing do not enable for production.
```

## kernels/5.10/headers/drivers/gpu/drm/evdi/Kconfig
```kconfig
#
# Copyright (c) 2015 - 2018 DisplayLink (UK) Ltd.
#
# This file is subject to the terms and conditions of the GNU General Public
# License v2. See the file COPYING in the main directory of this archive for
# more details.
#

config DRM_EVDI
	tristate "Extensible Virtual Display Interface"
	depends on DRM
	select DRM_KMS_HELPER
	help
		This is a KMS interface driver allowing user-space programs to
		register a virtual display (that imitates physical monitor) and
		retrieve contents (as a frame buffer) that system renders on it.
		Say M/Y to add support for these devices via DRM/KMS interfaces.
```

## kernels/5.4/drivers/gpu/drm/bridge/analogix/Kconfig
```kconfig
# SPDX-License-Identifier: GPL-2.0-only
config DRM_ANALOGIX_DP
	tristate
	depends on DRM

config ANALOGIX_ANX7625
	tristate "Analogix MIPI to DP interface support"
	help
		ANX7625 is an ultra-low power 4K mobile HD transmitter designed
		for portable devices. It converts MIPI/DPI to DisplayPort1.3 4K.
```

## kernels/chromebook-4.4/Documentation/devicetree/bindings/drm/bridge/gpio-mux.txt
```
Generic display mux (1 input, 2 outputs)
----------------------------------------

This bindings describes a simple display (e.g. HDMI) mux, that has 2
inputs, and 1 output. The mux status is controlled by hardware, and
its status is read back using a GPIO.

Required properties:

 - compatible          : "gpio-display-mux"
 - detect-gpios        : GPIO that indicates the active output

 - Video port for input, using the DT bindings defined in [1].
 - 2 video port for output, using the DT bindings defined in [1].
   The reg value in the endpoints matches the GPIO status: when
   GPIO is asserted, endpoint with reg value <1> is selected,.

[1]: Documentation/devicetree/bindings/media/video-interfaces.txt

Example:

	hdmi_mux: hdmi_mux {
		compatible = "gpio-display-mux";
		status = "okay";
		detect-gpios = <&pio 36 GPIO_ACTIVE_HIGH>;
		pinctrl-names = "default";
		pinctrl-0 = <&hdmi_mux_pins>;
		ddc-i2c-bus = <&hdmiddc0>;

		ports {
			#address-cells = <1>;
			#size-cells = <0>;

			port@0 { /* input */
				reg = <0>;

				hdmi_mux_in: endpoint {
					remote-endpoint = <&hdmi0_out>;
				};
			};

			port@1 { /* output */
				reg = <1>;

				#address-cells = <1>;
				#size-cells = <0>;

				hdmi_mux_out_anx: endpoint@0 {
					reg = <0>;
					remote-endpoint = <&anx7688_in>;
				};

				hdmi_mux_out_hdmi: endpoint@1 {
					reg = <1>;
					remote-endpoint = <&hdmi_connector_in>;
				};
			};
		};
	};
```

## kernels/chromebook-4.4/Documentation/devicetree/bindings/extcon/extcon-cros-ec.txt
```
ChromeOS EC Type-C Extcon device

On CrOS systems with USB Type C ports, the ChromeOS Embedded Controller is
able to detect the state of external accessories such as display adapters
or USB devices when said accessories are attached or detatched.

The node for this device must be under a cros-ec node like google,cros-ec-spi
or google,cros-ec-i2c.

Required properties:
- compatible:		Should be "google,extcon-cros-ec".
- google,usb-port-id:	Specifies the USB port ID to use.

Example:
	cros-ec@0 {
		compatible = "google,cros-ec-i2c";

		...

		extcon {
			compatible = "google,extcon-cros-ec";
			google,usb-port-id = <0>;
		};
	}
```

## kernels/chromebook-4.4/Documentation/devicetree/bindings/iio/proximity/sx9310.txt
```
Semtech's SX9310 capacitive proximity button device driver

Required properties:
	- compatible: must be "semtech,sx9310"
	- reg: i2c address where to find the device
	- interrupt-parent : should be the phandle for the interrupt controller
	- interrupts : the sole interrupt generated by the device

	Refer to interrupt-controller/interrupts.txt for generic
	interrupt client node bindings.

Example:

sx9310@28 {
	compatible = "semtech,sx9310";
	reg = <0x28>;
	interrupt-parent = <&gpio2>;
	interrupts = <16 IRQ_TYPE_LEVEL_LOW>;
};

Driver supports ACPI bindings. We can store registers configuration obtained
from per-model SAR sensor calibration. Refer to the data sheet for meaning.

ACPI name is STH9310.

Example:

ACPI:
		device pci 15.1 on
			chip drivers/i2c/sx9310
				register "desc" = ""Left SAR Proximity Sensor""
				register "irq" = "ACPI_IRQ_LEVEL_LOW(GPP_D9_IRQ)"
				register "speed" = "I2C_SPEED_FAST_PLUS"
				register "uid" = "1"
				register "reg_prox_ctrl0" = "0x10"
				register "reg_prox_ctrl1" = "0x00"
				register "reg_prox_ctrl2" = "0x84"
				register "reg_prox_ctrl3" = "0x0e"
				register "reg_prox_ctrl4" = "0x07"
				register "reg_prox_ctrl5" = "0xc6"
				register "reg_prox_ctrl6" = "0x20"
				register "reg_prox_ctrl7" = "0x0d"
				register "reg_prox_ctrl8" = "0x8d"
				register "reg_prox_ctrl9" = "0x43"
				register "reg_prox_ctrl10" = "0x11"
				register "reg_prox_ctrl11" = "0x00"
				register "reg_prox_ctrl12" = "0x00"
				register "reg_prox_ctrl13" = "0x00"
				register "reg_prox_ctrl14" = "0x00"
				register "reg_prox_ctrl15" = "0x00"
				register "reg_prox_ctrl16" = "0x00"
				register "reg_prox_ctrl17" = "0x00"
				register "reg_prox_ctrl18" = "0x00"
				register "reg_prox_ctrl19" = "0x00"
				register "reg_sar_ctrl0" = "0x50"
				register "reg_sar_ctrl1" = "0x8a"
				register "reg_sar_ctrl2" = "0x3c"
				device i2c 28 on end
			end
		end # I2C #1
```

## kernels/chromebook-4.4/Documentation/devicetree/bindings/iommu/rockchip,iommu.txt
```
Rockchip IOMMU
==============

A Rockchip DRM iommu translates io virtual addresses to physical addresses for
its master device.  Each slave device is bound to a single master device, and
shares its clocks, power domain and irq.

Required properties:
- compatible      : Should be "rockchip,iommu"
- reg             : Address space for the configuration registers
- interrupts      : Interrupt specifier for the IOMMU instance
- interrupt-names : Interrupt name for the IOMMU instance
- #iommu-cells    : Should be <0>.  This indicates the iommu is a
                    "single-master" device, and needs no additional information
                    to associate with its master device.  See:
                    Documentation/devicetree/bindings/iommu/iommu.txt
Optional properties:
- clocks : A list of master clocks requires for the IOMMU to be accessible
           by the host CPU. The number of clocks depends on the master
           block and might as well be zero. See [1] for generic clock
           bindings description.

[1] Documentation/devicetree/bindings/clock/clock-bindings.txt

Optional properties:
- rockchip,disable-mmu-reset : Don't use the mmu reset operation.
			       Some mmu instances may produce unexpected results
			       when the reset operation is used.

Example:

	vopl_mmu: iommu@ff940300 {
		compatible = "rockchip,iommu";
		reg = <0xff940300 0x100>;
		interrupts = <GIC_SPI 16 IRQ_TYPE_LEVEL_HIGH>;
		interrupt-names = "vopl_mmu";
		clocks = <&cru ACLK_VOP1>, <&cru DCLK_VOP1>, <&cru HCLK_VOP1>;
		#iommu-cells = <0>;
	};
```

## kernels/chromebook-4.4/Documentation/devicetree/bindings/misc/throttler.txt
```
Throttler driver

The Throttler is used for non-thermal throttling of system components like
CPUs or devfreq devices.

Required properties:
- throttler-opps	Array of OPP-v2 phandles with the OPPs used for
			throttling.

Example:
	throttler {
		 throttler-opps = <&cpu0_opp03, &cpu1_opp02, &gpu_opp03>;
	};
```

## kernels/chromebook-4.4/Documentation/devicetree/bindings/net/wireless/qcom,ath10k.txt
```
* Qualcomm Atheros ath10k wireless devices

For ath10k devices the calibration data can be provided through Device
Tree. The node is a child node of the PCI controller.

Required properties:
-compatible : Should be "qcom,ath10k"

Optional properties:
- qcom,ath10k-calibration-variant: string to search for in the board-2.bin
				   variant list with the same bus and device
				   specific ids
- qcom,ath10k-calibration-data : calibration data as an array, the
				 length can vary between hw versions


Example:

pci {
	pcie@0 {
		reg = <0 0 0 0 0>;
		#interrupt-cells = <1>;
		#size-cells = <2>;
		#address-cells = <3>;
		device_type = "pci";

		ath10k@0,0 {
			reg = <0 0 0 0 0>;
			device_type = "pci";
			qcom,ath10k-calibration-data = [ 01 02 03 ... ];
		};
	};
};
```

## kernels/chromebook-4.4/Documentation/devicetree/bindings/pci/pci.txt
```
PCI bus bridges have standardized Device Tree bindings:

PCI Bus Binding to: IEEE Std 1275-1994
http://www.devicetree.org/open-firmware/bindings/pci/pci2_1.pdf

And for the interrupt mapping part:

Open Firmware Recommended Practice: Interrupt Mapping
http://www.devicetree.org/open-firmware/practice/imap/imap0_9d.pdf

Additionally to the properties specified in the above standards a host bridge
driver implementation may support the following properties:

- linux,pci-domain:
   If present this property assigns a fixed PCI domain number to a host bridge,
   otherwise an unstable (across boots) unique number will be assigned.
   It is required to either not set this property at all or set it for all
   host bridges in the system, otherwise potentially conflicting domain numbers
   may be assigned to root buses behind different host bridges.  The domain
   number for each host bridge in the system must be unique.
- max-link-speed:
   If present this property specifies PCI gen for link capability.  Host
   drivers could add this as a strategy to avoid unnecessary operation for
   unsupported link speed, for instance, trying to do training for
   unsupported link speed, etc.  Must be '4' for gen4, '3' for gen3, '2'
   for gen2, and '1' for gen1. Any other values are invalid.
- pcie-reset-suspend:
   If present this property defines whether the PCIe Reset signal (referred to
   as PERST#) should be asserted when the system enters low-power suspend modes
   (e.g., S3). Depending on the form factor, the associated PCIe
   electromechanical specification may specify a particular behavior (e.g.,
   "PERST# is asserted in advance of the power being switched off in a
   power-managed state like S3") or it may be less clear. The net result is
   that some endpoints perform better (e.g., lower power consumption) with
   PERST# asserted, and others prefer PERST# deasserted. The value must be '0'
   or '1', where '0' means do not assert PERST# and '1' means assert PERST#.
   When absent, behavior may be platform-specific.
```
