// SPDX-License-Identifier: (GPL-2.0 OR MIT)
/*
 * Copyright 2021 Google LLC
 */

/dts-v1/;
#include "mt8183-kukui-jacuzzi.dtsi"

&mmc1_pins_uhs {
	pins_clk {
		drive-strength = <MTK_DRIVE_6mA>;
	};
};
