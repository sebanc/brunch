## kernel-5.4/Documentation/devicetree/bindings/display/msm/dpu-sdm845.yaml
```yaml
# SPDX-License-Identifier: GPL-2.0-only or BSD-2-Clause
%YAML 1.2
---
$id: http://devicetree.org/schemas/display/msm/dpu-sdm845.yaml#
$schema: http://devicetree.org/meta-schemas/core.yaml#

title: Description of Qualcomm Display DPU dt properties.

maintainers:
  - Krishna Manikandan <mkrishn@codeaurora.org>

description: |
  Device tree bindings for MSM Mobile Display Subsytem(MDSS) that encapsulates
  sub-blocks like DPU display controller, DSI and DP interfaces etc. Device tree
  bindings of MDSS and DPU are mentioned for SDM845 target.

properties:
  compatible:
    items:
      - const: qcom,sdm845-mdss
  reg:
    maxItems: 1

  reg-names:
    const: mdss

  power-domains:
    maxItems: 1

  clocks:
    maxItems: 3

  clock-names:
    description: |
      Device clock names in the same order as mentioned in clocks property.
      The required clocks are mentioned below.
    items:
      - const: iface
      - const: bus
      - const: core

  interrupts:
    maxItems: 1

  interrupt-controller: true

  "#interrupt-cells":
    const: 1

  iommus:
    maxItems: 2

  "#address-cells":
    const: 2

  "#size-cells":
    const: 2

  ranges: true

  assigned-clocks:
    maxItems: 1

  assigned-clock-rates:
    maxItems: 1

patternProperties:
  "^mdp@[0-9a-f]+$":
    type: object
    description: Node containing the properties of DPU.

    properties:
      compatible:
        items:
          - const: qcom,sdm845-dpu
      reg:
        maxItems: 2

      reg-names:
        items:
          - const: mdp
          - const: vbif

      clocks:
        maxItems: 4

      clock-names:
        description: |
          Device clock names, must be in same order as clocks property.
          The following clocks are required.
        items:
          - const: iface
          - const: bus
          - const: core
          - const: vsync

      interrupts:
        maxItems: 1

      ports:
        type: object
        description: |
          Contains the list of output ports from DPU device. These ports
          connect to interfaces that are external to the DPU hardware,
          such as DSI, DP etc. Each output port contains an endpoint that
          describes how it is connected to an external interface. These
          are described by the standard properties documented in files
          mentioned below.

          Documentation/devicetree/bindings/graph.txt
          Documentation/devicetree/bindings/media/video-interfaces.txt

        properties:
          port@0:
            type: object
            description: DPU_INTF1 (DSI1)
          port@1:
            type: object
            description: DPU_INTF2 (DSI2)

      assigned-clocks:
        maxItems: 2

      assigned-clock-rates:
        maxItems: 2


required:
  - compatible
  - reg
  - reg-names
  - power-domains
  - clocks
  - clock-names
  - interrupts
  - interrupt-controller
  - iommus

additionalProperties: false

examples:
- |
    #include <dt-bindings/clock/qcom,dispcc-sdm845.h>
    #include <dt-bindings/clock/qcom,gcc-sdm845.h>
    #include <dt-bindings/interrupt-controller/arm-gic.h>

    soc: soc {
      #address-cells = <2>;
      #size-cells = <2>;

      mdss: mdss@ae00000 {
          compatible = "qcom,sdm845-mdss";
          reg = <0 0x0ae00000 0 0x1000>;
          reg-names = "mdss";
          power-domains = <&dispcc MDSS_GDSC>;

          clocks = <&gcc GCC_DISP_AHB_CLK>,
                   <&gcc GCC_DISP_AXI_CLK>,
                   <&dispcc DISP_CC_MDSS_MDP_CLK>;
          clock-names = "iface", "bus", "core";

          assigned-clocks = <&dispcc DISP_CC_MDSS_MDP_CLK>;
          assigned-clock-rates = <300000000>;

          interrupts = <GIC_SPI 83 IRQ_TYPE_LEVEL_HIGH>;
          interrupt-controller;
          #interrupt-cells = <1>;

          iommus = <&apps_smmu 0x880 0x8>,
                   <&apps_smmu 0xc80 0x8>;

          #address-cells = <2>;
          #size-cells = <2>;

          mdss_mdp: mdp@ae01000 {
                    compatible = "qcom,sdm845-dpu";
                    reg = <0 0x0ae01000 0 0x8f000>,
                          <0 0x0aeb0000 0 0x2008>;
                    reg-names = "mdp", "vbif";

                    clocks = <&dispcc DISP_CC_MDSS_AHB_CLK>,
                             <&dispcc DISP_CC_MDSS_AXI_CLK>,
                             <&dispcc DISP_CC_MDSS_MDP_CLK>,
                             <&dispcc DISP_CC_MDSS_VSYNC_CLK>;
                    clock-names = "iface", "bus", "core", "vsync";

                    assigned-clocks = <&dispcc DISP_CC_MDSS_MDP_CLK>,
                                      <&dispcc DISP_CC_MDSS_VSYNC_CLK>;
                    assigned-clock-rates = <300000000>,
                                           <19200000>;

                    interrupt-parent = <&mdss>;
                    interrupts = <0 IRQ_TYPE_LEVEL_HIGH>;

                    ports {
                           #address-cells = <1>;
                           #size-cells = <0>;

                           port@0 {
                                   reg = <0>;
                                   dpu_intf1_out: endpoint {
                                                  remote-endpoint = <&dsi0_in>;
                                   };
                           };

                           port@1 {
                                   reg = <1>;
                                   dpu_intf2_out: endpoint {
                                                  remote-endpoint = <&dsi1_in>;
                                   };
                           };
                    };
          };
      };
    };
...
```

## kernel-5.4/drivers/gpu/drm/img-rogue/Kconfig
```kconfig
config DRM_POWERVR_ROGUE_1_10
	tristate "PowerVR Rogue"
	depends on ARM64
	depends on HAS_IOMEM
	depends on DRM
	depends on SYNC_FILE
	select DRM_KMS_HELPER
	select PM_DEVFREQ
	select DEVFREQ_GOV_SIMPLE_ONDEMAND
	select PM_OPP
	select DEVFREQ_THERMAL
	help
	  Driver for PowerVR Rogue graphics hardware 1.10.

	  Say Y here if your SoC contains a PowerVR Rogue GPU. For more
	  information, see <https://www.imgtec.com/graphics-processors/>.

config DRM_POWERVR_ROGUE_DEBUG
	bool "Enable PowerVR Rogue debug features"
	depends on DRM_POWERVR_ROGUE_1_10
	default n
	help
	  Add additional debug features to the PowerVR Rogue driver.

config DRM_POWERVR_ROGUE_PDUMP
	bool "Enable PowerVR Rogue PDUMP tracing."
	depends on DRM_POWERVR_ROGUE_1_10
	default n
	help
	  Enable PDUMP.
```

## kernel-chromebook-4.4/Documentation/devicetree/bindings/chromeos-firmware.txt
```
ChromeOS Firmware

This node specifies information of ChromeOS verified-boot firmware.  The
firmware might update this node prior to booting the kernel.

Required properties:

  - write-protect-gpio : Describe the write-protect GPIO of the system.
  - nonvolatile-context-storage : Storage device type that firmware used for
    vboot nonvolatile context.  It should be one of "disk", "cros-ec", or
    "nvram". Kernel should look for the device that firmware actually used in
    the corresponding optional property below.

Optional properties:

  - recovery-switch : Describe the recovery switch GPIO of the system.
  - developer-switch : Describe the developer switch GPIO of the system.

Example:

firmware {
	chromeos {
		write-protect-gpio = <&gpd1 6 0 0x10000 0>;
		nonvolatile-context-storage = "disk";
		chromeos-vbc-blk = <&mshc_0 0 0 16>;
	};
};

Example:

firmware {
	chromeos {
		pinctrl-0 = <&fw_pins>;
		pinctrl-names = "default";
		write-protect-gpio = <&qcom_pinmux 17 1>;
		recovery-switch = <&qcom_pinmux 16 1>;
		developer-switch = <&qcom_pinmux 15 1>;
	};
};
```

## kernel-chromebook-5.4/Documentation/devicetree/bindings/cpufreq/cpufreq-mediatek-hw.yaml
```yaml
# SPDX-License-Identifier: (GPL-2.0-only OR BSD-2-Clause)
%YAML 1.2
---
$id: http://devicetree.org/schemas/cpufreq/cpufreq-mediatek-hw.yaml#
$schema: http://devicetree.org/meta-schemas/core.yaml#

title: MediaTek's CPUFREQ Bindings

maintainers:
  - Hector Yuan <hector.yuan@mediatek.com>

description:
  CPUFREQ HW is a hardware engine used by MediaTek
  SoCs to manage frequency in hardware. It is capable of controlling frequency
  for multiple clusters.

properties:
  compatible:
    const: mediatek,cpufreq-hw

  reg:
    minItems: 1
    maxItems: 2
    description: |
      Addresses and sizes for the memory of the
      HW bases in each frequency domain.

required:
  - compatible
  - reg

additionalProperties: true

examples:
  - |
    cpus {
            #address-cells = <1>;
            #size-cells = <0>;

            cpu0: cpu@0 {
                device_type = "cpu";
                compatible = "arm,cortex-a55";
                enable-method = "psci";
                performance-domains = <&performance 0>;
                reg = <0x000>;
            };

            cpu1: cpu@100 {
                device_type = "cpu";
                compatible = "arm,cortex-a55";
                enable-method = "psci";
                performance-domains = <&performance 0>;
                reg = <0x100>;
            };

            cpu2: cpu@200 {
                device_type = "cpu";
                compatible = "arm,cortex-a55";
                enable-method = "psci";
                performance-domains = <&performance 0>;
                reg = <0x200>;
            };

            cpu3: cpu@300 {
                device_type = "cpu";
                compatible = "arm,cortex-a55";
                enable-method = "psci";
                performance-domains = <&performance 0>;
                reg = <0x300>;
            };

            cpu4: cpu@400 {
                device_type = "cpu";
                compatible = "arm,cortex-a55";
                enable-method = "psci";
                performance-domains = <&performance 1>;
                reg = <0x400>;
            };

            cpu5: cpu@500 {
                device_type = "cpu";
                compatible = "arm,cortex-a55";
                enable-method = "psci";
                performance-domains = <&performance 1>;
                reg = <0x500>;
            };

            cpu6: cpu@600 {
                device_type = "cpu";
                compatible = "arm,cortex-a75";
                enable-method = "psci";
                performance-domains = <&performance 1>;
                reg = <0x600>;
            };

            cpu7: cpu@700 {
                device_type = "cpu";
                compatible = "arm,cortex-a75";
                enable-method = "psci";
                performance-domains = <&performance 1>;
                reg = <0x700>;
            };
    };

    /* ... */

    soc {
        #address-cells = <2>;
        #size-cells = <2>;

        performance: performance-controller@11bc00 {
            compatible = "mediatek,cpufreq-hw";
            reg = <0 0x0011bc10 0 0x120>, <0 0x0011bd30 0 0x120>;
            #performance-domain-cells = <1>;
        };
    };
```
