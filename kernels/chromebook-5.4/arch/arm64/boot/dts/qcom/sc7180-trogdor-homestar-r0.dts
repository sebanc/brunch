// SPDX-License-Identifier: (GPL-2.0+ OR MIT)
/*
 * Google Homestar board device tree source
 *
 * Copyright 2021 Google LLC.
 */

/dts-v1/;

#include "sc7180.dtsi"
#include "sc7180-trogdor-ti-sn65dsi86.dtsi"
#include "sc7180-trogdor-homestar.dtsi"

/ {
	model = "Google Homestar (rev0 - 1)";
	compatible = "google,homestar-rev0", "google,homestar-rev1",
		 "google,homestar-rev19", "qcom,sc7180";
};

&ap_ts {
	vdd-supply = <&pp3300_ts>;
};

&panel {
	/delete-property/hpd-gpios;
	no-hpd;
};

&sdhc_2 {
	status = "okay";
};
