/*
 * Google Gru-Scarlet Rev3+ (SKU-7) board device tree source
 *
 * Copyright 2017 Google, Inc
 *
 * This file is dual-licensed: you can use it either under the terms
 * of the GPL or the X11 license, at your option. Note that this dual
 * licensing only applies to this file, and not this project as a
 * whole.
 *
 *  a) This file is free software; you can redistribute it and/or
 *     modify it under the terms of the GNU General Public License as
 *     published by the Free Software Foundation; either version 2 of the
 *     License, or (at your option) any later version.
 *
 *     This file is distributed in the hope that it will be useful,
 *     but WITHOUT ANY WARRANTY; without even the implied warranty of
 *     MERCHANTABILITY or FITNESS FOR A PARTICULAR PURPOSE.  See the
 *     GNU General Public License for more details.
 *
 *  Or, alternatively,
 *
 *  b) Permission is hereby granted, free of charge, to any person
 *     obtaining a copy of this software and associated documentation
 *     files (the "Software"), to deal in the Software without
 *     restriction, including without limitation the rights to use,
 *     copy, modify, merge, publish, distribute, sublicense, and/or
 *     sell copies of the Software, and to permit persons to whom the
 *     Software is furnished to do so, subject to the following
 *     conditions:
 *
 *     The above copyright notice and this permission notice shall be
 *     included in all copies or substantial portions of the Software.
 *
 *     THE SOFTWARE IS PROVIDED "AS IS", WITHOUT WARRANTY OF ANY KIND,
 *     EXPRESS OR IMPLIED, INCLUDING BUT NOT LIMITED TO THE WARRANTIES
 *     OF MERCHANTABILITY, FITNESS FOR A PARTICULAR PURPOSE AND
 *     NONINFRINGEMENT. IN NO EVENT SHALL THE AUTHORS OR COPYRIGHT
 *     HOLDERS BE LIABLE FOR ANY CLAIM, DAMAGES OR OTHER LIABILITY,
 *     WHETHER IN AN ACTION OF CONTRACT, TORT OR OTHERWISE, ARISING
 *     FROM, OUT OF OR IN CONNECTION WITH THE SOFTWARE OR THE USE OR
 *     OTHER DEALINGS IN THE SOFTWARE.
 */

/dts-v1/;

#include "rk3399-gru-scarlet.dtsi"

/ {
	model = "Google Scarlet";
	compatible = "google,scarlet-rev15-sku3",  "google,scarlet-rev14-sku3",
		     "google,scarlet-rev13-sku3",  "google,scarlet-rev12-sku3",
		     "google,scarlet-rev11-sku3",  "google,scarlet-rev10-sku3",
		     "google,scarlet-rev9-sku3",  "google,scarlet-rev8-sku3",
		     "google,scarlet-rev7-sku3",  "google,scarlet-rev6-sku3",
		     "google,scarlet-rev5-sku3",  "google,scarlet-rev15",
		     "google,scarlet-rev15-sku7", "google,scarlet-rev14",
		     "google,scarlet-rev14-sku7", "google,scarlet-rev13",
		     "google,scarlet-rev13-sku7", "google,scarlet-rev12",
		     "google,scarlet-rev12-sku7", "google,scarlet-rev11",
		     "google,scarlet-rev11-sku7", "google,scarlet-rev10",
		     "google,scarlet-rev10-sku7", "google,scarlet-rev9",
		     "google,scarlet-rev9-sku7",  "google,scarlet-rev8",
		     "google,scarlet-rev8-sku7",  "google,scarlet-rev7",
		     "google,scarlet-rev7-sku7",  "google,scarlet-rev6",
		     "google,scarlet-rev6-sku7",  "google,scarlet-rev5",
		     "google,scarlet-rev5-sku7",  "google,scarlet-rev4",
		     "google,scarlet-rev4-sku7",  "google,scarlet-rev3",
		     "google,scarlet-rev3-sku7",  "google,scarlet",
		     "google,gru",  "rockchip,rk3399";
};
