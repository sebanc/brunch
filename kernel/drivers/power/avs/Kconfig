## kernels/chromebook-4.4/Documentation/devicetree/bindings/thermal/mediatek-thermal.txt
```
* Mediatek Thermal

This describes the device tree binding for the Mediatek thermal controller
which measures the on-SoC temperatures. This device does not have its own ADC,
instead it directly controls the AUXADC via AHB bus accesses. For this reason
this device needs phandles to the AUXADC. Also it controls a mux in the
apmixedsys register space via AHB bus accesses, so a phandle to the APMIXEDSYS
is also needed.

There is another hardware engine, SVS (Smart Voltage Scaling) which shares the
same block of banked registers with Mediatek thermal controller. Hence the
driver of SVS is integrated with the driver of Mediatek thermal controller. The
properties required by SVS engine are optional for Mediatek thermal controller.

Required properties:
- compatible: "mediatek,mt8173-thermal"
- reg: Address range of the thermal controller
- interrupts: IRQ for the thermal controller
- clocks, clock-names: Clocks needed for the thermal controller. required
                       clocks are:
		       "therm":	 Main clock needed for register access
		       "auxadc": The AUXADC clock
- resets: Reference to the reset controller controlling the thermal controller.
- mediatek,auxadc: A phandle to the AUXADC which the thermal controller uses
- mediatek,apmixedsys: A phandle to the APMIXEDSYS controller.
- #thermal-sensor-cells : Should be 0. See ./thermal.txt for a description.

Optional properties:
- clocks, clock-names: Clocks that are optional for the thermal controller.
	       Specify to enable SVS engine.
	       "svs_pll": The PLL clock should be switched to during
			  initialization stage of SVS engine.
	       "svs_mux": The MUX clock controls the clock input of SVS engine.
- nvmem-cells: A list of phandles to the calibration data provided by a nvmem
	       device. If unspecified default values shall be used. The SVS
	       engine will be disabled if no SVS calibration data is specified.
- nvmem-cell-names: Should be "calibration-data" and "svs-calibration-data"
- bank[0,1]-supply: Regulator for each SVS bank

Example:

	thermal: thermal@1100b000 {
		#thermal-sensor-cells = <1>;
		compatible = "mediatek,mt8173-thermal";
		reg = <0 0x1100b000 0 0x1000>;
		interrupts = <0 70 IRQ_TYPE_LEVEL_LOW>;
		clocks = <&pericfg CLK_PERI_THERM>, <&pericfg CLK_PERI_AUXADC>,
			 <&topckgen CLK_TOP_SYSPLL1_D2>, <&topckgen CLK_TOP_AXI_SEL>;
		clock-names = "therm", "auxadc", "svs_pll", "svs_mux";
		resets = <&pericfg MT8173_PERI_THERM_SW_RST>;
		reset-names = "therm";
		mediatek,auxadc = <&auxadc>;
		mediatek,apmixedsys = <&apmixedsys>;
		nvmem-cells = <&thermal_calibration_data>, <&svs-calibration>;
		nvmem-cell-names = "calibration-data", "svs-calibration-data";
		bank0-supply = <&mt6397_vpca15_reg>;
		bank1-supply = <&da9211_vcpu_reg>;
	};
```

## kernels/chromebook-4.4/drivers/gpu/drm/panel/Kconfig
```kconfig
config DRM_PANEL
	bool
	depends on DRM
	help
	  Panel registration and lookup framework.

menu "Display Panels"
	depends on DRM && DRM_PANEL

config DRM_PANEL_SIMPLE
	tristate "support for simple panels"
	depends on OF
	depends on BACKLIGHT_CLASS_DEVICE
	select VIDEOMODE_HELPERS
	help
	  DRM panel driver for dumb panels that need at most a regulator and
	  a GPIO to be powered up. Optionally a backlight can be attached so
	  that it can be automatically turned off when the panel goes into a
	  low power state.

config DRM_PANEL_INNOLUX_P079ZCA
	tristate "Innolux P079ZCA or P097PFG panel"
	depends on OF
	depends on DRM_MIPI_DSI
	depends on BACKLIGHT_CLASS_DEVICE
	help
	  Say Y here if you want to enable support for Innolux P079ZCA or
	  Innolux P097PFG panel. They provide a MIPI DSI interface to
	  the host and have a built-in LED backlight.

config DRM_PANEL_KINGDISPLAY_KD097D04
	tristate "Kingdisplay KD097D04 panel"
	depends on OF
	depends on DRM_MIPI_DSI
	depends on BACKLIGHT_CLASS_DEVICE
	help
	  Say Y here if you want to enable support for Kingdisplay KD097D04
	  TFT-LCD modules. The panel has a 1536x2048 resolution and uses
	  24 bit RGB per pixel. It provides a MIPI DSI interface to
	  the host and has a built-in LED backlight.

config DRM_PANEL_SAMSUNG_LD9040
	tristate "Samsung LD9040 RGB/SPI panel"
	depends on OF && SPI
	select VIDEOMODE_HELPERS

config DRM_PANEL_LG_LG4573
	tristate "LG4573 RGB/SPI panel"
	depends on OF && SPI
	select VIDEOMODE_HELPERS
	help
	  Say Y here if you want to enable support for LG4573 RGB panel.
	  To compile this driver as a module, choose M here.

config DRM_PANEL_SAMSUNG_S6E8AA0
	tristate "Samsung S6E8AA0 DSI video mode panel"
	depends on OF
	select DRM_MIPI_DSI
	select VIDEOMODE_HELPERS

config DRM_PANEL_SHARP_LQ101R1SX01
	tristate "Sharp LQ101R1SX01 panel"
	depends on OF
	depends on DRM_MIPI_DSI
	depends on BACKLIGHT_CLASS_DEVICE
	help
	  Say Y here if you want to enable support for Sharp LQ101R1SX01
	  TFT-LCD modules. The panel has a 2560x1600 resolution and uses
	  24 bit RGB per pixel. It provides a dual MIPI DSI interface to
	  the host and has a built-in LED backlight.

	  To compile this driver as a module, choose M here: the module
	  will be called panel-sharp-lq101r1sx01.

config DRM_PANEL_BOE_TV097QXM_NU0
	tristate "support for boe tv097qxm nu0"
	depends on OF
	depends on DRM_MIPI_DSI
	help
	  DRM panel driver for boe tv097qxm nu0

endmenu
```

## kernels/chromebook-4.4/drivers/iio/common/cros_ec_sensors/Kconfig
```kconfig
#
# Chrome OS Embedded Controller managed sensors library
#

config IIO_CROS_EC
	bool "ChromeOS EC Sensors"
	depends on MFD_CROS_EC
	help
	  Select this option to enable support for sensors connected
	  through the Embedded Controller in ChromeOS systems.

if IIO_CROS_EC

config IIO_CROS_EC_SENSORS_CORE
	tristate "ChromeOS EC Sensors Core"
	depends on SYSFS && CROS_EC_SENSORHUB
	select IIO_BUFFER
	select IIO_TRIGGERED_BUFFER

config IIO_CROS_EC_SENSORS
	tristate "ChromeOS EC Contiguous Sensors"
	depends on SYSFS && CROS_EC_SENSORHUB
	select IIO_CROS_EC_SENSORS_CORE
	help
	  Module to handle 3d contiguous sensors like
	  Accelerometers, Gyroscope and Magnetometer that are
	  presented by the ChromeOS EC Sensor hub.
	  Creates an IIO device for each functions.

config IIO_CROS_EC_LIGHT_PROX
	tristate "ChromeOS EC Light and Proximity Sensors"
	depends on SYSFS && CROS_EC_SENSORHUB
	select IIO_CROS_EC_SENSORS_CORE
	help
	  Module to handle Light and Proximity sensors
	  presented by the ChromeOS EC Sensor hub.
	  Creates an IIO device for each functions.
	  Only one source is exposed by the EC.

config IIO_CROS_EC_BARO
	tristate "ChromeOS EC Barometer Sensor"
	depends on SYSFS && CROS_EC_SENSORHUB
	select IIO_CROS_EC_SENSORS_CORE
	help
	  Module to handle Barometer sensor when
	  presented by the ChromeOS EC Sensor hub.

config IIO_CROS_EC_ACTIVITY
	tristate "ChromeOS EC Activity Sensors"
	depends on SYSFS && CROS_EC_SENSORHUB
	select IIO_CROS_EC_SENSORS_CORE
	help
	  Module to handle activity events detections presented by the ChromeOS
	  EC Sensor hub.
	  Activities can be simple (low/no motion) or more complex (riding train).
	  They are being reported by physical devices or the EC itself.
	  Creates an IIO device to manage all activities.

config IIO_CROS_EC_SENSORS_RING
	tristate "ChromeOS EC Sensors Ring"
	depends on IIO_CROS_EC_SENSORS || IIO_CROS_EC_LIGHT_PROX
	help
	  Add support for handling sensor events FIFO produced by
	  the sensor hub.
	  A single device with a buffer will collect all samples produced
	  by the sensors managed by the CroEC sensor hub.

endif
```
