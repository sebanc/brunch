## kernel-5.10/Documentation/devicetree/bindings/display/msm/dp-controller-sc7180.yaml
```yaml
# SPDX-License-Identifier: (GPL-2.0-only  OR BSD-2-Clause)
%YAML 1.2
---
$id: http://devicetree.org/schemas/display/msm/dp-controller-sc7180.yaml#
$schema: http://devicetree.org/meta-schemas/core.yaml#

title: MSM SC7180 Display Port Controller.

maintainers:
  - Chandan Uddaraju <chandanu@codeaurora.org>
  - Vara Reddy <varar@codeaurora.org>
  - Tanmay Shah <tanmay@codeaurora.org>

description: |
  Device tree bindings for DP host controller for MSM SC7180 target
  that are compatible with VESA Display Port interface specification.

allOf:
  - $ref: dp-controller.yaml#

properties:
  compatible:
    items:
      - enum:
          - qcom,sc7180-dp

  reg:
    maxItems: 1
  reg-names:
    const: dp_controller

  interrupts:
    maxItems: 1

  clocks:
    maxItems: 5

  clock-names:
    items:
      - const: core_iface
      - const: core_aux
      - const: ctrl_link
      - const: ctrl_link_iface
      - const: stream_pixel

  "#clock-cells":
    const: 1

  assigned-clocks:
    maxItems: 1
  assigned-clock-parents:
    maxItems: 1

  data-lanes:
    $ref: "/schemas/types.yaml#/definitions/uint32-array"
    minItems: 1
    maxItems: 4

  vdda-1p2-supply:
    description: phandle to vdda 1.2V regulator node.

  vdda-0p9-supply:
    description: phandle to vdda 0.9V regulator node.

  ports:
    type: object
    properties:
      "#address-cells":
        const: 1

      "#size-cells":
        const: 0

      port@0:
        type: object
      port@1:
        type: object

required:
  - compatible
  - reg
  - reg-names
  - interrupts
  - clocks
  - clock-names
  - assigned-clocks
  - assigned-clock-parents
  - vdda-1p2-supply
  - vdda-0p9-supply
  - data-lanes
  - ports

additionalProperties: false

examples:
  - |
    #include <dt-bindings/interrupt-controller/arm-gic.h>
    #include <dt-bindings/clock/qcom,dispcc-sdm845.h>
    #include <dt-bindings/clock/qcom,gcc-sdm845.h>
    msm_dp: displayport-controller@ae90000{
        compatible = "qcom,sc7180-dp";
        reg = <0 0xae90000 0 0x1400>;
        reg-names = "dp_controller";

        interrupt-parent = <&mdss>;
        interrupts = <12 0>;

        clocks = <&dispcc DISP_CC_MDSS_AHB_CLK>,
                 <&dispcc DISP_CC_MDSS_DP_AUX_CLK>,
                 <&dispcc DISP_CC_MDSS_DP_LINK_CLK>,
                 <&dispcc DISP_CC_MDSS_DP_LINK_INTF_CLK>,
                 <&dispcc DISP_CC_MDSS_DP_PIXEL_CLK>;
        clock-names = "core_iface", "core_aux",
                      "ctrl_link",
                      "ctrl_link_iface", "stream_pixel";
        #clock-cells = <1>;

        assigned-clocks = <&dispcc DISP_CC_MDSS_DP_PIXEL_CLK_SRC>;
        assigned-clock-parents = <&dp_phy 1>;

        vdda-1p2-supply = <&vreg_l3c_1p2>;
        vdda-0p9-supply = <&vreg_l4a_0p8>;

        data-lanes = <0 1>;

        ports {
            #address-cells = <1>;
            #size-cells = <0>;

            port@0 {
                reg = <0>;
                dp_in: endpoint {
                    remote-endpoint = <&dpu_intf0_out>;
                };
            };

            port@1 {
                reg = <1>;
                dp_out: endpoint {
                };
            };
        };
    };
...
```

## kernel-5.10/Documentation/devicetree/bindings/display/msm/dp-controller.yaml
```yaml
# SPDX-License-Identifier: (GPL-2.0-only  OR BSD-2-Clause)
%YAML 1.2
---
$id: http://devicetree.org/schemas/display/msm/dp-controller.yaml#
$schema: http://devicetree.org/meta-schemas/core.yaml#

title: Qualcomm Display Port Controller.

maintainers:
  - Chandan Uddaraju <chandanu@codeaurora.org>
  - Vara Reddy <varar@codeaurora.org>
  - Tanmay Shah <tanmay@codeaurora.org>

description: |
  Device tree bindings for MSM Display Port which supports DP host controllers
  that are compatible with VESA Display Port interface specification.

properties:
  compatible:
    items:
      - enum:
          - qcom,sc7180-dp

  reg:
    maxItems: 1
  reg-names:
    const: dp_controller

  interrupts:
    maxItems: 1

  clocks:
    maxItems: 5
    items:
      - description: AHB clock to enable register access
      - description: Display Port AUX clock
      - description: Display Port Link clock
      - description: Link interface clock between DP and PHY
      - description: Display Port Pixel clock

  clock-names:
    items:
      - const: core_iface
      - const: core_aux
      - const: ctrl_link
      - const: ctrl_link_iface
      - const: stream_pixel

  assigned-clocks:
    maxItems: 1
  assigned-clock-parents:
    maxItems: 1

  data-lanes:
    $ref: "/schemas/types.yaml#/definitions/uint32-array"
    minItems: 1
    maxItems: 4

  ports:
    type: object
...
```

## kernel-5.10/Documentation/devicetree/bindings/display/msm/dpu-sc7180.yaml
```yaml
# SPDX-License-Identifier: GPL-2.0-only or BSD-2-Clause
%YAML 1.2
---
$id: http://devicetree.org/schemas/display/msm/dpu-sc7180.yaml#
$schema: http://devicetree.org/meta-schemas/core.yaml#

title: Description of Qualcomm Display DPU dt properties.

maintainers:
  - Krishna Manikandan <mkrishn@codeaurora.org>

description: |
  Device tree bindings for MSM Mobile Display Subsytem(MDSS) that encapsulates
  sub-blocks like DPU display controller, DSI and DP interfaces etc. Device tree
  bindings of MDSS and DPU are mentioned for SC7180 target.

properties:
  compatible:
    items:
      - const: qcom,sc7180-mdss

  reg:
    maxItems: 1

  reg-names:
    const: mdss

  power-domains:
    maxItems: 1

  clocks:
    maxItems: 3

  clock-names:
    items:
      - const: iface
      - const: ahb
      - const: core

  interrupts:
    maxItems: 1

  interrupt-controller: true

  "#interrupt-cells":
    const: 1

  iommus:
    maxItems: 1

  "#address-cells":
    const: 2

  "#size-cells":
    const: 2

  ranges: true

  interconnects:
    description: |
      Interconnect path specifier for MDSS according to
      Documentation/devicetree/bindings/interconnect/interconnect.txt.
      An entry should contain 2 paths corresponding to 2 AXI ports representing
      source and destination ports.
    minItems: 1

  interconnect-names:
    description: |
      MDSS will have 2 port names to differentiate between the
      2 interconnect paths defined with interconnect specifier.
    items:
      - const: mdp0-mem

  assigned-clocks:
    maxItems: 1

  assigned-clock-rates:
    maxItems: 1

patternProperties:
  "^mdp@[0-9a-f]+$":
    type: object
    description: Node containing the properties of DPU.

    properties:
      compatible:
        items:
          - const: qcom,sc7180-dpu

      reg:
        maxItems: 2

      reg-names:
        items:
          - const: mdp
          - const: vbif

      clocks:
        maxItems: 6

      clock-names:
        description: |
          Device clock names, must be in same order as clocks property.
          The following clocks are required.
        items:
          - const: bus
          - const: iface
          - const: rot
          - const: lut
          - const: core
          - const: vsync

      interrupts:
        maxItems: 1

      ports:
        type: object
        description: |
          Contains the list of output ports from DPU device. These ports
          connect to interfaces that are external to the DPU hardware,
          such as DSI, DP etc. Each output port contains an endpoint that
          describes how it is connected to an external interface. These
          are described by the standard properties documented in files
          mentioned below.

          Documentation/devicetree/bindings/graph.txt
          Documentation/devicetree/bindings/media/video-interfaces.txt

        properties:
          port@0:
            type: object
            description: DPU_INTF1 (DSI1)
          port@1:
            type: object
            description: DPU_INTF2 (DSI2)
          port@2:
            type: object
            description: DPU_INTF0 (DP)

      assigned-clocks:
        maxItems: 4

      assigned-clock-rates:
        maxItems: 4

required:
  - compatible
  - reg
  - reg-names
  - power-domains
  - clocks
  - clock-names
  - interrupts
  - interrupt-controller
  - iommus

additionalProperties: false

examples:
  - |
    #include <dt-bindings/clock/qcom,dispcc-sc7180.h>
    #include <dt-bindings/clock/qcom,gcc-sc7180.h>
    #include <dt-bindings/interrupt-controller/arm-gic.h>
    #include <dt-bindings/interconnect/qcom,sdm845.h>

    soc: soc {
      #address-cells = <2>;
      #size-cells = <2>;

      mdss: mdss@ae00000 {
         compatible = "qcom,sc7180-mdss";
         reg = <0 0xae00000 0 0x1000>;
         reg-names = "mdss";
         power-domains = <&dispcc MDSS_GDSC>;

         clocks = <&gcc GCC_DISP_AHB_CLK>,
                  <&dispcc DISP_CC_MDSS_AHB_CLK>,
                  <&dispcc DISP_CC_MDSS_MDP_CLK>;

         clock-names = "iface", "ahb", "core";

         assigned-clocks = <&dispcc DISP_CC_MDSS_MDP_CLK>;
         assigned-clock-rates = <300000000>;

         interrupts = <GIC_SPI 83 IRQ_TYPE_LEVEL_HIGH>;
         interrupt-controller;
         #interrupt-cells = <1>;

         interconnects = <&mmss_noc MASTER_MDP0 &mc_virt SLAVE_EBI1>;

         interconnect-names = "mdp0-mem";

         iommus = <&apps_smmu 0x800 0x2>;

         #address-cells = <2>;
         #size-cells = <2>;

         mdp: mdp@ae01000 {
                   compatible = "qcom,sc7180-dpu";
                   reg = <0 0x0ae01000 0 0x8f000>,
                         <0 0x0aeb0000 0 0x2008>;

                   reg-names = "mdp", "vbif";

                   clocks = <&gcc GCC_DISP_HF_AXI_CLK>,
                            <&dispcc DISP_CC_MDSS_AHB_CLK>,
                            <&dispcc DISP_CC_MDSS_ROT_CLK>,
                            <&dispcc DISP_CC_MDSS_MDP_LUT_CLK>,
                            <&dispcc DISP_CC_MDSS_MDP_CLK>,
                            <&dispcc DISP_CC_MDSS_VSYNC_CLK>;
                   clock-names = "bus", "iface", "rot", "lut", "core",
                                 "vsync";
                   assigned-clocks = <&dispcc DISP_CC_MDSS_MDP_CLK>,
                                     <&dispcc DISP_CC_MDSS_VSYNC_CLK>,
                                     <&dispcc DISP_CC_MDSS_ROT_CLK>,
                                     <&dispcc DISP_CC_MDSS_ROT_CLK>;
                   assigned-clock-rates = <300000000>,
                                          <19200000>,
                                          <19200000>,
                                          <19200000>;

                   interrupt-parent = <&mdss>;
                   interrupts = <0 IRQ_TYPE_LEVEL_HIGH>;

                   ports {
                           #address-cells = <1>;
                           #size-cells = <0>;

                           port@0 {
                                   reg = <0>;
                                   dpu_intf1_out: endpoint {
                                                  remote-endpoint = <&dsi0_in>;
                                   };
                           };

                           port@2 {
                                   reg = <2>;
                                   dpu_intf0_out: endpoint {
                                                  remote-endpoint = <&dp_in>;
                                   };
                           };

                   };
         };
      };
    };
...
```

## kernel-5.10/Documentation/devicetree/bindings/display/msm/dsi-phy-sdm845.yaml
```yaml
# SPDX-License-Identifier: GPL-2.0-only or BSD-2-Clause
%YAML 1.2
---
$id: http://devicetree.org/schemas/display/msm/dsi-phy-sdm845.yaml#
$schema: http://devicetree.org/meta-schemas/core.yaml#

title: Description of Qualcomm Display DSI PHY dt properties.

maintainers:
  - Krishna Manikandan <mkrishn@codeaurora.org>

description: |
  Device tree bindings for DSI PHY for SDM845 target.

allOf:
  - $ref: dsi-phy.yaml#

properties:
  compatible:
    const: qcom,dsi-phy-10nm

  reg:
    maxItems: 3

  reg-names:
    maxItems: 3

  clocks:
    maxItems: 2

  clock-names:
    items:
      - const: iface
      - const: ref

  "#clock-cells":
    const: 1

  "#phy-cells":
    const: 0

required:
  - compatible
  - reg
  - reg-names
  - clocks
  - clock-names

unevaluatedProperties: false

examples:
  - |
     #include <dt-bindings/interrupt-controller/arm-gic.h>
     #include <dt-bindings/clock/qcom,dispcc-sdm845.h>
     #include <dt-bindings/clock/qcom,gcc-sdm845.h>
     #include <dt-bindings/clock/qcom,rpmh.h>

     mdss: mdss {
       #address-cells = <2>;
       #size-cells = <2>;

       dsi0_phy: dsi-phy@ae94400 {
               compatible = "qcom,dsi-phy-10nm";
               reg = <0 0x0ae94400 0 0x200>,
                     <0 0x0ae94600 0 0x280>,
                     <0 0x0ae94a00 0 0x1e0>;
               reg-names = "dsi_phy",
                           "dsi_phy_lane",
                           "dsi_pll";

               #clock-cells = <1>;
               #phy-cells = <0>;

               vdds-supply = <&vdda_mipi_dsi0_pll>;
               clocks = <&dispcc DISP_CC_MDSS_AHB_CLK>,
                        <&rpmhcc RPMH_CXO_CLK>;
               clock-names = "iface", "ref";

       };
     };
...
```
