/*
 * Copyright 2016 MediaTek Inc.
 * Author: Eddie Huang <eddie.huang@mediatek.com>
 *
 * This program is free software; you can redistribute it and/or modify
 * it under the terms of the GNU General Public License version 2 as
 * published by the Free Software Foundation.
 *
 * This program is distributed in the hope that it will be useful,
 * but WITHOUT ANY WARRANTY; without even the implied warranty of
 * MERCHANTABILITY or FITNESS FOR A PARTICULAR PURPOSE.  See the
 * GNU General Public License for more details.
 */

/dts-v1/;
#include "mt8173-hana.dtsi"

/ {
	model = "Mediatek Hana rev0 board";
	compatible = "google,hana-rev7", "google,hana-rev6",
			"google,hana-rev5", "google,hana-rev4",
			"google,hana-rev3", "google,hana-rev2",
			"google,hana-rev1", "google,hana-rev0",
			"google,hana", "mediatek,mt8173";
};
