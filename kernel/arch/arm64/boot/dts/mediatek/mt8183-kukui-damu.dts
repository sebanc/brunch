// SPDX-License-Identifier: (GPL-2.0 OR MIT)
/*
 * Copyright 2019 Google LLC
 */

/dts-v1/;
#include "mt8183-kukui-jacuzzi.dtsi"

/ {
	model = "Google damu board";
	compatible = "google,damu", "mediatek,mt8183";
};
