## kernels/chromebook-4.4/drivers/staging/android/Kconfig
```kconfig
menu "Android"

if ANDROID

config ASHMEM
	bool "Enable the Anonymous Shared Memory Subsystem"
	default n
	depends on SHMEM
	---help---
	  The ashmem subsystem is a new shared memory allocator, similar to
	  POSIX SHM but with different behavior and sporting a simpler
	  file-based API.

	  It is, in theory, a good memory allocator for low-memory devices,
	  because it can discard shared memory units when under memory pressure.

config ANDROID_TIMED_OUTPUT
	bool "Timed output class driver"
	default y

config ANDROID_TIMED_GPIO
	tristate "Android timed gpio driver"
	depends on GPIOLIB || COMPILE_TEST
	depends on ANDROID_TIMED_OUTPUT
	default n
        ---help---
	  Unlike generic gpio is to allow programs to access and manipulate gpio
	  registers from user space, timed output/gpio is a system to allow changing
	  a gpio pin and restore it automatically after a specified timeout.

config ANDROID_LOW_MEMORY_KILLER
	bool "Android Low Memory Killer"
	---help---
	  Registers processes to be killed when low memory conditions, this is useful
	  as there is no particular swap space on android.

	  The registered process will kills according to the priorities in android init
	  scripts (/init.rc), and it defines priority values with minimum free memory size
	  for each priority.

config ANDROID_LOW_MEMORY_KILLER_AUTODETECT_OOM_ADJ_VALUES
	bool "Android Low Memory Killer: detect oom_adj values"
	depends on ANDROID_LOW_MEMORY_KILLER
	default y
	---help---
	  Detect oom_adj values written to
	  /sys/module/lowmemorykiller/parameters/adj and convert them
	  to oom_score_adj values.

source "drivers/staging/android/ion/Kconfig"

endif # if ANDROID

endmenu
```

## kernels/chromebook-4.4/headers/drivers/gpu/drm/bridge/synopsys/Kconfig
```kconfig
config DRM_DW_MIPI_DSI
	tristate
	select DRM_KMS_HELPER
	select DRM_MIPI_DSI
	select DRM_PANEL_BRIDGE
```

## kernels/chromebook-5.4/Documentation/devicetree/bindings/arm/mediatek/mediatek,imp_iic_wrap.yaml
```yaml
# SPDX-License-Identifier: (GPL-2.0 OR BSD-2-Clause)
%YAML 1.2
---
$id: http://devicetree.org/schemas/arm/mediatek/mediatek,imp_iic_wrap.yaml#
$schema: http://devicetree.org/meta-schemas/core.yaml#

title: MediaTek IMP I2C Wrapper Controller

maintainers:
  - Weiyi Lu <weiyi.lu@mediatek.com>

description:
  The Mediatek imp i2c wrapper controller provides functional configurations and clocks to the system.

properties:
  compatible:
    items:
      - enum:
          - mediatek,mt8192-imp_iic_wrap_c
          - mediatek,mt8192-imp_iic_wrap_e
          - mediatek,mt8192-imp_iic_wrap_s
          - mediatek,mt8192-imp_iic_wrap_ws
          - mediatek,mt8192-imp_iic_wrap_w
          - mediatek,mt8192-imp_iic_wrap_n
      - const: syscon

  reg:
    maxItems: 1

  '#clock-cells':
    const: 1

required:
  - compatible
  - reg

examples:
  - |
    imp_iic_wrap_c: syscon@11007000 {
        compatible = "mediatek,mt8192-imp_iic_wrap_c", "syscon";
        reg = <0 0x11007000 0 0x1000>;
        #clock-cells = <1>;
    };

  - |
    imp_iic_wrap_e: syscon@11cb1000 {
        compatible = "mediatek,mt8192-imp_iic_wrap_e", "syscon";
        reg = <0 0x11cb1000 0 0x1000>;
        #clock-cells = <1>;
    };

  - |
    imp_iic_wrap_s: syscon@11d03000 {
        compatible = "mediatek,mt8192-imp_iic_wrap_s", "syscon";
        reg = <0 0x11d03000 0 0x1000>;
        #clock-cells = <1>;
    };

  - |
    imp_iic_wrap_ws: syscon@11d23000 {
        compatible = "mediatek,mt8192-imp_iic_wrap_ws", "syscon";
        reg = <0 0x11d23000 0 0x1000>;
        #clock-cells = <1>;
    };

  - |
    imp_iic_wrap_w: syscon@11e01000 {
        compatible = "mediatek,mt8192-imp_iic_wrap_w", "syscon";
        reg = <0 0x11e01000 0 0x1000>;
        #clock-cells = <1>;
    };

  - |
    imp_iic_wrap_n: syscon@11f02000 {
        compatible = "mediatek,mt8192-imp_iic_wrap_n", "syscon";
        reg = <0 0x11f02000 0 0x1000>;
        #clock-cells = <1>;
    };
```

## kernels/chromebook-5.4/Documentation/devicetree/bindings/arm/mediatek/mediatek,scp-adsp.yaml
```yaml
# SPDX-License-Identifier: (GPL-2.0 OR BSD-2-Clause)
%YAML 1.2
---
$id: http://devicetree.org/schemas/arm/mediatek/mediatek,scp-adsp.yaml#
$schema: http://devicetree.org/meta-schemas/core.yaml#

title: MediaTek SCP ADSP Controller

maintainers:
  - Weiyi Lu <weiyi.lu@mediatek.com>

description:
  The Mediatek scp adsp controller provides functional configurations and clocks to the system.

properties:
  compatible:
    items:
      - enum:
          - mediatek,mt8192-scp_adsp
      - const: syscon

  reg:
    maxItems: 1

  '#clock-cells':
    const: 1

required:
  - compatible
  - reg

examples:
  - |
    scp_adsp: syscon@10720000 {
        compatible = "mediatek,mt8192-scp_adsp", "syscon";
        reg = <0x10720000 0x1000>;
        #clock-cells = <1>;
    };
```

## kernels/chromebook-5.4/Documentation/devicetree/bindings/display/bridge/analogix,anx7625.yaml
```yaml
# SPDX-License-Identifier: (GPL-2.0 OR BSD-2-Clause)
# Copyright 2019 Analogix Semiconductor, Inc.
%YAML 1.2
---
$id: "http://devicetree.org/schemas/display/bridge/analogix,anx7625.yaml#"
$schema: "http://devicetree.org/meta-schemas/core.yaml#"

title: Analogix ANX7625 SlimPort (4K Mobile HD Transmitter)

maintainers:
  - Xin Ji <xji@analogixsemi.com>

description: |
  The ANX7625 is an ultra-low power 4K Mobile HD Transmitter
  designed for portable devices.

properties:
  compatible:
    items:
      - const: analogix,anx7625

  reg:
    maxItems: 1

  interrupts:
    description: used for interrupt pin B8.
    maxItems: 1

  enable-gpios:
    description: used for power on chip control, POWER_EN pin D2.
    maxItems: 1

  reset-gpios:
    description: used for reset chip control, RESET_N pin B7.
    maxItems: 1

  vdd10-supply:
    description: Regulator that provides the supply 1.0V power.

  vdd18-supply:
    description: Regulator that provides the supply 1.8V power.

  vdd33-supply:
    description: Regulator that provides the supply 3.3V power.

  analogix,lane0-swing:
    $ref: /schemas/types.yaml#/definitions/uint32-array
    maxItems: 20
    description:
      an array of swing register setting for DP tx lane0 PHY, please don't
      add this property, or contact vendor.

  analogix,lane1-swing:
    $ref: /schemas/types.yaml#/definitions/uint32-array
    maxItems: 20
    description:
      an array of swing register setting for DP tx lane1 PHY, please don't
      add this property, or contact vendor.

  analogix,hdcp-support:
    type: boolean
    description: indicate the DP tx HDCP support or not.

  ports:
    type: object

    properties:
      port@0:
        type: object
        description:
          Video port for MIPI input.

        properties:
          endpoint:
            type: object
            additionalProperties: false

            # Properties described in
            # Documentation/devicetree/bindings/media/video-interfaces.txt
            properties:
              remote-endpoint: true
              bus-type: true
              data-lanes: true

            required:
              - remote-endpoint

        required:
          - endpoint


      port@1:
        type: object
        description:
          Video port for panel or connector.

        properties:
          endpoint:
            type: object
            additionalProperties: false

            # Properties described in
            # Documentation/devicetree/bindings/media/video-interfaces.txt
            properties:
              remote-endpoint: true

            required:
              - remote-endpoint

    required:
        - port@0
        - port@1

required:
  - compatible
  - reg
  - vdd10-supply
  - vdd18-supply
  - vdd33-supply
  - ports

additionalProperties: false

examples:
  - |
    #include <dt-bindings/gpio/gpio.h>

    i2c0 {
        #address-cells = <1>;
        #size-cells = <0>;

        encoder@58 {
            compatible = "analogix,anx7625";
            reg = <0x58>;
            enable-gpios = <&pio 45 GPIO_ACTIVE_HIGH>;
            reset-gpios = <&pio 73 GPIO_ACTIVE_HIGH>;
            vdd10-supply = <&pp1000_mipibrdg>;
            vdd18-supply = <&pp1800_mipibrdg>;
            vdd33-supply = <&pp3300_mipibrdg>;

            ports {
                #address-cells = <1>;
                #size-cells = <0>;

                mipi2dp_bridge_in: port@0 {
                    reg = <0>;
                    anx7625_in: endpoint {
                        remote-endpoint = <&mipi_dsi>;
                        bus-type = <5>;
                        data-lanes = <0 1 2 3>;
                    };
                };

                mipi2dp_bridge_out: port@1 {
                    reg = <1>;
                    anx7625_out: endpoint {
                        remote-endpoint = <&panel_in>;
                    };
                };
            };
        };
    };
```

## kernels/chromebook-5.4/Documentation/devicetree/bindings/media/video/msm-cam-sync.txt
```
* Qualcomm Technologies, Inc. MSM Camera SYNC

Camera SYNC device provides synchronization of the requests.

Required properties:
- compatible :
    - "qcom,sync"

Example:

   sync: qcom,sync {
       compatible = "qcom,cam-sync";
       status = "ok";
   };
```

## kernels/chromebook-5.4/Documentation/devicetree/bindings/regulator/mt6359-regulator.yaml
```yaml
# SPDX-License-Identifier: (GPL-2.0 OR BSD-2-Clause)
%YAML 1.2
---
$id: http://devicetree.org/schemas/regulator/mt6359-regulator.yaml#
$schema: http://devicetree.org/meta-schemas/core.yaml#

title: MT6359 Regulator from MediaTek Integrated

maintainers:
  - Hsin-Hsiung Wang <hsin-hsiung.wang@mediatek.com>

description: |
  List of regulators provided by this controller. It is named
  according to its regulator type, buck_<name> and ldo_<name>.
  MT6359 regulators node should be sub node of the MT6397 MFD node.

properties:
  $nodename:
    pattern: "^pmic$"

  mt6359regulator:
    type: object
    description:
      list of regulators provided by this controller.

    patternProperties:
      "^buck_v(s1|gpu11|modem|pu|core|s2|pa|proc2|proc1|core_sshub)$":
        type: object
        $ref: "regulator.yaml#"

        properties:
          regulator-name:
            pattern: "^v(s1|gpu11|modem|pu|core|s2|pa|proc2|proc1|core_sshub)$"

        unevaluatedProperties: false

      "^ldo_v(ibr|rf12|usb|camio|efuse|xo22)$":
        type: object
        $ref: "regulator.yaml#"

        properties:
          regulator-name:
            pattern: "^v(ibr|rf12|usb|camio|efuse|xo22)$"

        unevaluatedProperties: false

      "^ldo_v(rfck|emc|a12|a09|ufs|bbck)$":
        type: object
        $ref: "regulator.yaml#"

        properties:
          regulator-name:
            pattern: "^v(rfck|emc|a12|a09|ufs|bbck)$"

        unevaluatedProperties: false

      "^ldo_vcn(18|13|33_1_bt|13_1_wifi|33_2_bt|33_2_wifi)$":
        type: object
        $ref: "regulator.yaml#"

        properties:
          regulator-name:
            pattern: "^vcn(18|13|33_1_bt|13_1_wifi|33_2_bt|33_2_wifi)$"

        unevaluatedProperties: false

      "^ldo_vsram_(proc2|others|md|proc1|others_sshub)$":
        type: object
        $ref: "regulator.yaml#"

        properties:
          regulator-name:
            pattern: "^vsram_(proc2|others|md|proc1|others_sshub)$"

        unevaluatedProperties: false

      "^ldo_v(fe|bif|io)28$":
        type: object
        $ref: "regulator.yaml#"

        properties:
          regulator-name:
            pattern: "^v(fe|bif|io)28$"

        unevaluatedProperties: false

      "^ldo_v(aud|io|aux|rf|m)18$":
        type: object
        $ref: "regulator.yaml#"

        properties:
          regulator-name:
            pattern: "^v(aud|io|aux|rf|m)18$"

        unevaluatedProperties: false

      "^ldo_vsim[12]$":
        type: object
        $ref: "regulator.yaml#"

        properties:
          regulator-name:
            pattern: "^vsim[12]$"

        required:
          - regulator-name

        unevaluatedProperties: false

additionalProperties: false

examples:
  - |
    pmic {
      mt6359regulator {
        mt6359_vgpu11_buck_reg: buck_vgpu11 {
          regulator-name = "vgpu11";
          regulator-min-microvolt = <400000>;
          regulator-max-microvolt = <1193750>;
          regulator-enable-ramp-delay = <200>;
          regulator-always-on;
          regulator-allowed-modes = <0 1 2>;
        };

        mt6359_vcamio_ldo_reg: ldo_vcamio {
          regulator-name = "vcamio";
          regulator-min-microvolt = <1700000>;
          regulator-max-microvolt = <1900000>;
        };

        mt6359_vcn18_ldo_reg: ldo_vcn18 {
          regulator-name = "vcn18";
          regulator-min-microvolt = <1800000>;
          regulator-max-microvolt = <1800000>;
          regulator-enable-ramp-delay = <240>;
        };

        mt6359_vsram_proc2_ldo_reg: ldo_vsram_proc2 {
          regulator-name = "vsram_proc2";
          regulator-min-microvolt = <500000>;
          regulator-max-microvolt = <1293750>;
          regulator-ramp-delay = <7500>;
          regulator-enable-ramp-delay = <240>;
          regulator-always-on;
        };

        mt6359_vfe28_ldo_reg: ldo_vfe28 {
          regulator-name = "vfe28";
          regulator-min-microvolt = <2800000>;
          regulator-max-microvolt = <2800000>;
          regulator-enable-ramp-delay = <120>;
        };

        mt6359_vaud18_ldo_reg: ldo_vaud18 {
          regulator-name = "vaud18";
          regulator-min-microvolt = <1800000>;
          regulator-max-microvolt = <1800000>;
          regulator-enable-ramp-delay = <240>;
        };

        mt6359_vsim1_ldo_reg: ldo_vsim1 {
          regulator-name = "vsim1";
          regulator-min-microvolt = <1700000>;
          regulator-max-microvolt = <3100000>;
          regulator-enable-ramp-delay = <480>;
        };
      };
    };
...
```

## kernels/chromebook-5.4/drivers/media/platform/camx/Kconfig
```kconfig
#
# Qualcomm camera configuration
#

menuconfig SPECTRA_CAMERA
	bool "Qualcomm Technologies, Inc. Spectra Camera"
	depends on (ARCH_QCOM)
	depends on (MEDIA_SUPPORT && MEDIA_CONTROLLER && V4L_PLATFORM_DRIVERS)
	depends on (VIDEO_DEV && VIDEO_V4L2=y)
	depends on ARM64
	depends on SC_CAMCC_7180
	help
	  Say Y here to enable selecting the video adapters for
	  Qualcomm Technologies, Inc. Spectra camera and video capture.
	  Enabling this adds support for the camera driver stack including sensor,
	  IFE and postprocessing drivers.

if SPECTRA_CAMERA

source "drivers/media/platform/camx/cam_sync/Kconfig"
source "drivers/media/platform/camx/cam_smmu/Kconfig"
source "drivers/media/platform/camx/cam_req_mgr/Kconfig"
source "drivers/media/platform/camx/cam_isp/Kconfig"
source "drivers/media/platform/camx/cam_icp/Kconfig"
source "drivers/media/platform/camx/cam_cpas/Kconfig"
source "drivers/media/platform/camx/cam_jpeg/Kconfig"
source "drivers/media/platform/camx/cam_lrme/Kconfig"
source "drivers/media/platform/camx/cam_sensor_module/Kconfig"

endif
```

## kernels/chromebook-5.4/drivers/media/platform/camx/cam_sensor_module/cam_eeprom/Kconfig
```kconfig
config QTI_EEPROM
	bool "Camera EEPROM driver"
	default y
	help
	  Say Y here to enable selecting module
	  Support for the Camera eeprom driver
```

## kernels/chromebook-5.4/drivers/media/platform/camx/cam_sync/Kconfig
```kconfig
config QTI_CAMERA_SYNC
bool "Qualcomm camera SYNC driver"
	default y
	help
	  Say Y here to enable selecting module
	  Support for camera drivers synchronization
```
